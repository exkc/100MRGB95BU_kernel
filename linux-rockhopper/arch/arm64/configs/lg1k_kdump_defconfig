## linux-rockhopper/arch/arm64/configs/lg1k_kdump_defconfig
```kconfig
# CONFIG_LOCALVERSION_AUTO is not set
CONFIG_DEFAULT_HOSTNAME="(kdump)"
# CONFIG_SWAP is not set
# CONFIG_CROSS_MEMORY_ATTACH is not set
CONFIG_NO_HZ_IDLE=y
CONFIG_HIGH_RES_TIMERS=y
CONFIG_PREEMPT=y
# CONFIG_CPU_ISOLATION is not set
CONFIG_LOG_BUF_SHIFT=12
CONFIG_LOG_CPU_MAX_BUF_SHIFT=0
CONFIG_PRINTK_SAFE_LOG_BUF_SHIFT=10
CONFIG_CC_OPTIMIZE_FOR_SIZE=y
# CONFIG_MULTIUSER is not set
# CONFIG_SYSFS_SYSCALL is not set
# CONFIG_FHANDLE is not set
# CONFIG_POSIX_TIMERS is not set
# CONFIG_BUG is not set
# CONFIG_BASE_FULL is not set
# CONFIG_FUTEX is not set
# CONFIG_EPOLL is not set
# CONFIG_SIGNALFD is not set
# CONFIG_TIMERFD is not set
# CONFIG_EVENTFD is not set
# CONFIG_SHMEM is not set
# CONFIG_AIO is not set
# CONFIG_IO_URING is not set
# CONFIG_ADVISE_SYSCALLS is not set
# CONFIG_MEMBARRIER is not set
# CONFIG_KALLSYMS is not set
# CONFIG_RSEQ is not set
CONFIG_EMBEDDED=y
# CONFIG_VM_EVENT_COUNTERS is not set
# CONFIG_COMPAT_BRK is not set
CONFIG_SLOB=y
# CONFIG_SLAB_MERGE_DEFAULT is not set
# CONFIG_ZONE_DMA32 is not set
CONFIG_ARCH_LG1K=y
CONFIG_ARM64_SECTION_BITS_27=y
CONFIG_NR_CPUS=4
CONFIG_CRASH_DUMP=y
# CONFIG_UNMAP_KERNEL_AT_EL0 is not set
# CONFIG_HARDEN_BRANCH_PREDICTOR is not set
CONFIG_HANDLE_RO_INVAL=y
# CONFIG_MITIGATE_SPECTRE_BRANCH_HISTORY is not set
# CONFIG_ARM64_TAGGED_ADDR_ABI is not set
# CONFIG_ARM64_VHE is not set
# CONFIG_EFI is not set
# CONFIG_SUSPEND is not set
CONFIG_JUMP_LABEL=y
# CONFIG_STACKPROTECTOR is not set
# CONFIG_VMAP_STACK is not set
# CONFIG_BLK_DEV_BSG is not set
# CONFIG_MQ_IOSCHED_DEADLINE is not set
# CONFIG_MQ_IOSCHED_KYBER is not set
# CONFIG_BINFMT_ELF is not set
# CONFIG_BINFMT_SCRIPT is not set
# CONFIG_SPARSEMEM_VMEMMAP is not set
# CONFIG_COMPACTION is not set
# CONFIG_FAULT_AROUND is not set
CONFIG_NET=y
CONFIG_PACKET=y
CONFIG_UNIX=y
CONFIG_INET=y
CONFIG_IP_MULTICAST=y
CONFIG_IP_PNP=y
CONFIG_IP_PNP_DHCP=y
CONFIG_IP_PNP_BOOTP=y
# CONFIG_INET_DIAG is not set
# CONFIG_IPV6 is not set
# CONFIG_WIRELESS is not set
CONFIG_DEVTMPFS=y
CONFIG_DEVTMPFS_MOUNT=y
# CONFIG_STANDALONE is not set
# CONFIG_PREVENT_FIRMWARE_BUILD is not set
# CONFIG_FW_LOADER is not set
CONFIG_BLK_DEV_RAM=y
CONFIG_BLK_DEV_RAM_COUNT=2
CONFIG_SCSI=y
# CONFIG_SCSI_PROC_FS is not set
CONFIG_BLK_DEV_SD=y
# CONFIG_SCSI_LOWLEVEL is not set
CONFIG_NETDEVICES=y
CONFIG_MACVLAN=y
CONFIG_MACVTAP=y
CONFIG_TUN=y
# CONFIG_NET_VENDOR_ALACRITECH is not set
# CONFIG_NET_VENDOR_AMAZON is not set
# CONFIG_NET_VENDOR_AMD is not set
# CONFIG_NET_VENDOR_ARASAN is not set
# CONFIG_NET_VENDOR_AQUANTIA is not set
# CONFIG_NET_VENDOR_ARC is not set
# CONFIG_NET_VENDOR_AURORA is not set
# CONFIG_NET_VENDOR_BROADCOM is not set
# CONFIG_NET_VENDOR_CADENCE is not set
# CONFIG_NET_VENDOR_CAVIUM is not set
# CONFIG_NET_VENDOR_CORTINA is not set
# CONFIG_NET_VENDOR_EZCHIP is not set
# CONFIG_NET_VENDOR_GOOGLE is not set
# CONFIG_NET_VENDOR_HISILICON is not set
# CONFIG_NET_VENDOR_HUAWEI is not set
# CONFIG_NET_VENDOR_INTEL is not set
# CONFIG_NET_VENDOR_MARVELL is not set
# CONFIG_NET_VENDOR_MICREL is not set
# CONFIG_NET_VENDOR_MICROCHIP is not set
# CONFIG_NET_VENDOR_MICROSEMI is not set
# CONFIG_NET_VENDOR_NATSEMI is not set
# CONFIG_NET_VENDOR_NETRONOME is not set
# CONFIG_NET_VENDOR_NI is not set
# CONFIG_NET_VENDOR_PENSANDO is not set
# CONFIG_NET_VENDOR_QUALCOMM is not set
# CONFIG_NET_VENDOR_RENESAS is not set
# CONFIG_NET_VENDOR_ROCKER is not set
# CONFIG_NET_VENDOR_SAMSUNG is not set
# CONFIG_NET_VENDOR_SEEQ is not set
# CONFIG_NET_VENDOR_SOLARFLARE is not set
# CONFIG_NET_VENDOR_SMSC is not set
# CONFIG_NET_VENDOR_SOCIONEXT is not set
CONFIG_STMMAC_ETH=y
# CONFIG_NET_VENDOR_SYNOPSYS is not set
# CONFIG_NET_VENDOR_VIA is not set
# CONFIG_NET_VENDOR_WIZNET is not set
CONFIG_LGE_LG1K_PHY=y
# CONFIG_USB_NET_DRIVERS is not set
# CONFIG_WLAN is not set
# CONFIG_INPUT_KEYBOARD is not set
# CONFIG_INPUT_MOUSE is not set
# CONFIG_SERIO is not set
# CONFIG_LEGACY_PTYS is not set
# CONFIG_LDISC_AUTOLOAD is not set
# CONFIG_DEVMEM is not set
# CONFIG_DEVDBG is not set
CONFIG_SERIAL_AMBA_PL011=y
CONFIG_SERIAL_AMBA_PL011_CONSOLE=y
# CONFIG_HW_RANDOM is not set
# CONFIG_RANDOM_TRUST_BOOTLOADER is not set
# CONFIG_HWMON is not set
# CONFIG_HID is not set
# CONFIG_USB_HID is not set
CONFIG_USB=y
# CONFIG_USB_DEFAULT_PERSIST is not set
CONFIG_USB_XHCI_HCD=y
CONFIG_USB_EHCI_HCD=y
CONFIG_USB_EHCI_HCD_PLATFORM=y
CONFIG_USB_STORAGE=y
# CONFIG_USB_STORAGE_SCAN_HELPER is not set
CONFIG_USB_DWC3=y
# CONFIG_USB_DWC3_OF_SIMPLE is not set
# CONFIG_VIRTIO_MENU is not set
CONFIG_STAGING=y
CONFIG_WEBOS=y
# CONFIG_SYSRQ_LOG_PRINT is not set
# CONFIG_USER_INITCALL is not set
# CONFIG_FAULT_NOTIFIER is not set
# CONFIG_GPU_INFO is not set
# CONFIG_MRI_HELPER is not set
# CONFIG_BLOCK_DUMP_MSG is not set
CONFIG_KERNEL_MODE_ONLY=y
CONFIG_KDUMP_LG1K=y
# CONFIG_IOMMU_SUPPORT is not set
# CONFIG_LG_BUILTIN_KDRIVER is not set
# CONFIG_FILE_LOCKING is not set
# CONFIG_DNOTIFY is not set
# CONFIG_INOTIFY_USER is not set
CONFIG_VFAT_FS=y
CONFIG_FAT_DEFAULT_IOCHARSET="utf8"
CONFIG_NTFS_IOMAP_FS=y
CONFIG_PROC_VMCORE_DEVICE_DUMP=y
# CONFIG_PROC_SYSCTL is not set
# CONFIG_PROC_PAGE_MONITOR is not set
# CONFIG_MISC_FILESYSTEMS is not set
# CONFIG_NETWORK_FILESYSTEMS is not set
CONFIG_NLS_DEFAULT="utf-8"
CONFIG_NLS_CODEPAGE_437=y
CONFIG_NLS_ASCII=y
CONFIG_NLS_UTF8=y
CONFIG_EXFAT_FS=y
CONFIG_PRINTK_TIME=y
# CONFIG_ENABLE_MUST_CHECK is not set
# CONFIG_DEBUG_MISC is not set
# CONFIG_SCHED_DEBUG is not set
# CONFIG_DEBUG_PREEMPT is not set
CONFIG_RCU_CPU_STALL_TIMEOUT=60
# CONFIG_FTRACE is not set
# CONFIG_RUNTIME_TESTING_MENU is not set
```

## linux-rockhopper/arch/arm64/ekp/Kconfig
```kconfig
menuconfig EKP
	bool "Enhanced Kernel Protection"
	depends on MMU && HAVE_ARM_SMCCC && !JUMP_LABEL
	depends on ARM64_4K_PAGES
	depends on !NUMA && !KVM && !HUGETLBFS && !BPF_JIT
	depends on !TRANSPARENT_HUGEPAGE
	select STRICT_KERNEL_RWX
	select RODATA_FULL_DEFAULT_ENABLED
	help
	  This option allows you to enable support for EKP (Enhanced Kernel
	  Protection). This is to protect MMU page tables for mitigating
	  malicious attacks to detour the kernel memory access permissions
	  such as read-only for kernel '.text', '.rodata', or PXN (Privilege
	  Execute-Never) for user address spaces.

if EKP

config EKP_FORCE_ENABLE
	bool "Enable EKP by force"
	default n
	help
	  Say Y if you want to force EKP to be enabled no matter what value
	  is set to kernel parameter "ekp_enabled".

	  *** You MUST enable this on the production kernel. ***

config EKP_SYSMEM_PHYS_BASE
	hex "Physical memory base address"
	default 0x00000000
	help
	  This option defines the physical memory base base address.
	  This information is used for romempool test bit mechanism.

config EKP_MAX_MEMBLOCK_COUNT
	int "kernel memory block max count for passing to ekp-fw"
	default 100
	help
	  Defines the maximum count of memory block structures
	  to be passed to "ekp-fw"

source "arch/arm64/ekp/fw/Kconfig"

config EKP_CRED_PROTECTION
	bool "Make task credentials read-only"
	default n
	help
	  Credential is a key structure which has lots of security
	  informations such as UID/GID and security capabilities.
	  When this option is enabled, EKP makes credentials read-only
	  to prevent any modifications from malicious attacks.

config EKP_CRED_TAG
	bool "Cred pointer tag"
	depends on EKP_CRED_PROTECTION
	default n
	help
	  It is necessary to check whether the cred pointer has been
	  tampered with by a hacker. Tagging can be confirmed and
	  error checked using the tgid of task_struct.

config EKP_CRED_OVERRIDE
	bool "Cred override protection(experimental)"
	depends on EKP_CRED_PROTECTION
	default n
	help
	  The usage pattern of CRED's override/revert function
	  is very diverse. In order to apply a mechanism to protect
	  overridden cred, the logic analysis must be performed clearly
	  before changing it to default y.

config EKP_MODULE_PROTECTION
	depends on MODULES && STRICT_MODULE_RWX
	depends on !LIVEPATCH
	def_bool y
	help
	  This option applies W^X mappings on LKM memory spaces forcedly.
	  The EKP firmware binary can detect that the mapping information
	  is changed by the outside by marking the corresponding mapping.

config EKP_FAULT_NOTIFIER
	bool "Fault Notifier to pass the reason of EKP violation"
	depends on FAULT_NOTIFIER
	default n
	help
	  If you want to pass the reason of EKP violation to the Fault
	  Manager using Fault Notifier, then say Y.

source "arch/arm64/ekp/debug/Kconfig"

endif # EKP
```

## linux-rockhopper/arch/arm64/ekp/debug/Kconfig
```kconfig
menuconfig EKP_DEBUG
	bool "EKP Debug & Test Features"
	default n

if EKP_DEBUG

config EKP_KERNEL_DEBUG_IN_ISE
	bool "Print kernel data/messages in ISE for debugging (EXPERIMENTAL)"
	default n

config EKP_DEBUGFS
	bool "Enable EKP Debug Filesystem"
	select DEBUG_FS
	default n

config EKP_DEBUGFS_PTDUMP_CORE
	def_bool n

config EKP_DEBUGFS_CHECK_PROT_CORE
	def_bool n

config EKP_DEBUGFS_SYSINFO
	bool "Export kernel/user information via debugfs"
	depends on EKP_DEBUGFS
	default n

config EKP_DEBUGFS_PTDUMP
	bool "Export kernel/user page-table layout via debugfs"
	depends on EKP_DEBUGFS_SYSINFO
	select EKP_DEBUGFS_PTDUMP_CORE
	default n

config EKP_DEBUGFS_CHECK_PROT
	bool "Check the attributes for protection of page tables"
	depends on EKP_DEBUGFS_SYSINFO
	select EKP_DEBUGFS_PTDUMP_CORE
	select EKP_DEBUGFS_CHECK_PROT_CORE
	default n

config EKP_DEBUGFS_TEST_HELPERS
	bool "Allow to test EKP behaviors"
	depends on EKP_DEBUGFS
	default n
	help
	  This option creates debugfs entries to test EKP behaviors.

	  *** You MUST __NOT__ enable this on the production kernel. ***

config EKP_DEBUGFS_TEST_AGAINST_ATTACK
	bool "Test EKP against attacks (!! SECURITY ALERT !!)"
	depends on EKP_DEBUGFS_TEST_HELPERS
	default n
	help
	  This option creates debugfs entries to test the defense behavior
	  of EKP against security attacks.

	  *** You MUST __NOT__ enable this on the production kernel. ***

endif # EKP_DEBUG
```

## linux-rockhopper/arch/arm64/ekp/fw/Kconfig
```kconfig
config EKP_ISE_FIRMWARE
	string "EKP ISE firmware binary path"
	default "arch/arm64/ekp/fw/hise.bin"
	help
	  This option allows EKP ISE firmware 'blobs' to be built into
	  the kernel. If you don't specify the location of EKP ISE
	  firmware binary, EKP won't be enabled.
```

## linux-rockhopper/drivers/clk/lg1k/Kconfig
```kconfig
config COMMON_CLK_AIOPLLSS
	tristate "Clock driver for AIOPLLSS-based LG1K SoCs"
	default y if ARCH_LG1K
	help
	  This driver supports clocking subsystem on LG Electronics LG1k SoCs
	  with integrated AIOPLLSS.

config COMMON_CLK_LG1K
	tristate "Clock driver for LG1K SoCs"
	default y if ARCH_LG1K
	select LG1K_PMS
	help
	  This driver supports clocking subsystem on LG Electronics LG1k SoCs.

config COMMON_CLK_LG1313
	tristate "Clock driver for LG1313 CPU-PLL"
	default y if ARCH_LG1K
	help
	  This driver supports clocking subsystem on LGE DTV SoC LG1313.
```

## linux-rockhopper/drivers/gpu/drm/lg1k/Kconfig
```kconfig
config DRM_LG1K
        tristate "DRM Support for lg1k TV display"
        depends on DRM && OF && ARCH_LG1K
        depends on COMMON_CLK
        select DRM_GEM_DMA_HELPER
        select DRM_FB_DMA_HELPER
        select DRM_KMS_HELPER
        help
          Choose this option if you support LG1K DRM.
```

## linux-rockhopper/drivers/media/platform/lg1k/Kconfig
```kconfig
config CEC_LG1K
	bool "cec controller drivers for LG1K DTV SoCs"
	depends on V4L_PLATFORM_DRIVERS
	select CEC_CORE
	help
	  Select this to enable the cec controller drivers for LG1K
	  DTV SoCs. Currently supports LG1211, LG1212, LG1313, and
	  LG1314.

config VIDEO_LG1K
	bool "V4L2 video driver for LG1k DTV SoCs"
	select V4L2_MEM2MEM_DEV
	select VIDEOBUF2_DMA_CONTIG
	help
	  Enable v4l2 video driver for LG1k DTV SoCs.
```

## linux-rockhopper/drivers/phy/lg1k/Kconfig
```kconfig
# SPDX-License-Identifier: GPL-2.0-only
#
# Phy drivers for LG DTV platforms
#
config PHY_LG1K_USB
	tristate
	depends on HAS_IOMEM
	select GENERIC_PHY
	help
	  Enable this to support the USB PHY driver for LG DTV SoCs.

config PHY_LG1K_USB2_NSI
	tristate "LG1K USB 2.0 Nanosilicon PHY driver"
	depends on HAS_IOMEM
	depends on USB_OHCI_HCD_PLATFORM || USB_OHCI_HCD_PLATFORM || USB_DWC2
	select GENERIC_PHY
	select PHY_LG1K_USB
	help
	  Enable this to support the USB 2.0 PHY driver for LG DTV SoCs.
	  This PHY is based on Nanosilicon USB 2.0 PHY.

config PHY_LG1K_USB3_NSI
	tristate "LG1K USB 3.0 Nanosilicon PHY driver"
	depends on HAS_IOMEM
	depends on USB_XHCI_PLATFORM
	select GENERIC_PHY
	select PHY_LG1K_USB
	help
	  Enable this to support the USB 3.0 PHY driver for LG DTV SoCs.
	  This PHY is based on Nanosilicon USB 3.0 PHY.
```

## linux-rockhopper/fs/ntfs/Kconfig
```kconfig
# SPDX-License-Identifier: GPL-2.0-only
config NTFS_FS
	tristate "NTFS file system support"
	select FS_IOMAP
	select NLS
	help
	  NTFS is the file system of Microsoft Windows NT, 2000, XP and 2003.

	  Saying Y or M here enables read support.  There is partial, but
	  safe, write support available.  For write support you must also
	  say Y to "NTFS write support" below.

	  There are also a number of user-space tools available, called
	  ntfsprogs.  These include ntfsundelete and ntfsresize, that work
	  without NTFS support enabled in the kernel.

	  This is a rewrite from scratch of Linux NTFS support and replaced
	  the old NTFS code starting with Linux 2.5.11.  A backport to
	  the Linux 2.4 kernel series is separately available as a patch
	  from the project web site.

	  For more information see <file:Documentation/filesystems/ntfs.txt>
	  and <http://www.linux-ntfs.org/>.

	  To compile this file system support as a module, choose M here: the
	  module will be called ntfs.

	  If you are not using Windows NT, 2000, XP or 2003 in addition to
	  Linux on your computer it is safe to say N.

config NTFS_DEBUG
	bool "NTFS debugging support"
	depends on NTFS_FS
	help
	  If you are experiencing any problems with the NTFS file system, say
	  Y here.  This will result in additional consistency checks to be
	  performed by the driver as well as additional debugging messages to
	  be written to the system log.  Note that debugging messages are
	  disabled by default.  To enable them, supply the option debug_msgs=1
	  at the kernel command line when booting the kernel or as an option
	  to insmod when loading the ntfs module.  Once the driver is active,
	  you can enable debugging messages by doing (as root):
	  echo 1 > /proc/sys/fs/ntfs-debug
	  Replacing the "1" with "0" would disable debug messages.

	  If you leave debugging messages disabled, this results in little
	  overhead, but enabling debug messages results in very significant
	  slowdown of the system.

	  When reporting bugs, please try to have available a full dump of
	  debugging messages while the misbehaviour was occurring.

config NTFS_FS_POSIX_ACL
	bool "NTFS POSIX Access Control Lists"
	default n
	depends on NTFS_FS
	select FS_POSIX_ACL
	help
	  POSIX Access Control Lists (ACLs) support additional access rights
	  for users and groups beyond the standard owner/group/world scheme,
	  and this option selects support for ACLs specifically for ntfs
	  filesystems.
	  NOTE: this is linux only feature. Windows will ignore these ACLs.

	  If you don't know what Access Control Lists are, say N.

config NTFS_IOMAP_FS
	tristate
	select NTFS_FS
	select FS_IOMAP
	select NLS
	help
	  This config option is here only for backward compatibility. NTFS
	  filesystem is now handled by the NTFS filesystem.
```
