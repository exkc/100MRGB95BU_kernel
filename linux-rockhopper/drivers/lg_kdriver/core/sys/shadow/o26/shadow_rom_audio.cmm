;;;;;;;;;;;;;;;;;;;;;;;;;;;;;;;;;;;;;;;;;;;;;;;;;;;;;;;
;; Generating PORT CMM
;; Generating Time : 2024-07-04 
;; Modified time: 2025-04-08  ;; update FPGA optimization result for ASIC delivery
;; Project : O26
;;;;;;;;;;;;;;;;;;;;;;;;;;;;;;;;;;;;;;;;;;;;;;;;;;;;;;;
D.S ASD:0xC42084A0 %LONG 0x10001000     ;;GPU0      : 000000 (250408) <= 222222
D.S ASD:0xC42088A0 %LONG 0x10101110     ;;GPU1      : 010110 (250408) <= 110110
D.S ASD:0xC42104A0 %LONG 0x13301330     ;;GFX
D.S ASD:0xC4208CA0 %LONG 0x11101110     ;;LOWBW     : 111111(240704) <= 000000 
D.S ASD:0xC42108A0 %LONG 0x12201220     ;;TIVVMCU
D.S ASD:0xC42004A0 %LONG 0x11101110     ;;ME3X1
D.S ASD:0xC42008A0 %LONG 0x13301330     ;;FMC0
D.S ASD:0xC4200CA0 %LONG 0x12201220     ;;FMC1     :222222 (240704)<= 000000
D.S ASD:0xC42010A0 %LONG 0x12300000     ;;FMC2     :230000 (250408)<= 220000
D.S ASD:0xC42014A0 %LONG 0x11200000     ;;FMC3     :120000 (250408)<= 110000
D.S ASD:0xC42090A0 %LONG 0x10001000     ;;FMS      :000000 (250408)<= 330330
D.S ASD:0xC42018A0 %LONG 0x11101130     ;;SRE0     :110130 (250408)<= 110110
D.S ASD:0xC4201CA0 %LONG 0x13301130     ;;SRE1CCO  :330130 (250408)<= 330330
D.S ASD:0xC42094A0 %LONG 0x13201320     ;;ND0      :320320 (250408) <= 333333 (240704) <= 000000
D.S ASD:0xC42098A0 %LONG 0x11101110     ;;ND1
D.S ASD:0xC4209CA0 %LONG 0x12201220     ;;IMX0
D.S ASD:0xC420A0A0 %LONG 0x10101010     ;;IMX1     :010010 (250408) <= 110110
D.S ASD:0xC420A4A0 %LONG 0x11101110     ;;IMX2     :111111 (240704) <= 000000
D.S ASD:0xC420A8A0 %LONG 0x13301330     ;;IMX3
D.S ASD:0xC420ACA0 %LONG 0x13300000     ;;VDO0
D.S ASD:0xC420B0A0 %LONG 0x12200000     ;;VDO1
D.S ASD:0xC42020A0 %LONG 0x12200000     ;;GSC0
D.S ASD:0xC42024A0 %LONG 0x11100000     ;;GSC1
D.S ASD:0xC42028A0 %LONG 0x13300000     ;;GSC2
D.S ASD:0xC4202CA0 %LONG 0x12200000     ;;GSC3     :222222 (240704) <= 000000
D.S ASD:0xC4210CA0 %LONG 0x13301330     ;;AUD      :333333 (240704) <= 000000
D.S ASD:0xC42110A0 %LONG 0x11101110     ;;NPPTCU   :111111 (240704) <= 000000
D.S ASD:0xC42114A0 %LONG 0x13001300     ;;LNX0     :300300 (250408) <= 330330
D.S ASD:0xC42118A0 %LONG 0x12201220     ;;LNX1
D.S ASD:0xC4211CA0 %LONG 0x11101110     ;;LNX2
D.S ASD:0xC42120A0 %LONG 0x11101110     ;;VD0A
D.S ASD:0xC42124A0 %LONG 0x12201220     ;;VD0B     :222222 (240704) <= 000000 
D.S ASD:0xC42128A0 %LONG 0x12201220     ;;VD1A
D.S ASD:0xC4212CA0 %LONG 0x13001300     ;;VD1B     :300300 (250408) <= 330330


;;;;;;;;;;;;;;;;;;;;;;;;;;;;;;;;;;;;;;;;;;;;;;;;;;;;;;;
;; Generating PORT CMM by BUS_PMT
;; Generating Time : 2023-03-28 11:58:16
;; Project : O24
;;;;;;;;;;;;;;;;;;;;;;;;;;;;;;;;;;;;;;;;;;;;;;;;;;;;;;;

;;  D.S ASD:0xC40F10A0 %LONG 0x12201220		;;GPU0		: 220220 <- 222222 (230328 dongil.nam c)
;;  D.S ASD:0xC40F12A0 %LONG 0x11101110		;;GPU1		: 110110 <- 111111 (230328 dongil.nam c)
;;  D.S ASD:0xC40F14A0 %LONG 0x13331333		;;GFX		: 333333
;;  D.S ASD:0xC40F16A0 %LONG 0x10001000		;;LOWBW		: 000000
;;  D.S ASD:0xC40F18A0 %LONG 0x12221222		;;ICVENC	: 222222
;;  D.S ASD:0xC40F1AA0 %LONG 0x11131113		;;MEFMS		: 113113 <- 111111 (230328 dongil.nam c)
;;  D.S ASD:0xC40F1CA0 %LONG 0x13331333		;;FMGSSR0	: 333333
;;  D.S ASD:0xC40F1EA0 %LONG 0x10001000		;;FMGSSR1	: 000000
;;  D.S ASD:0xC40F20A0 %LONG 0x12221222		;;FMGSSR2	: 222222
;;  D.S ASD:0xC40F22A0 %LONG 0x11111111		;;FMGSSR3	: 111111
;;  D.S ASD:0xC40F24A0 %LONG 0x13331333		;;FMGSSR4	: 333333
;;  D.S ASD:0xC40F26A0 %LONG 0x11100000		;;CCO0		: 110xxx <- 111xxx (230328 dongil.nam c)
;;  D.S ASD:0xC40F28A0 %LONG 0x13330000		;;CCO1		: 333xxx 
;;  D.S ASD:0xC40F2AA0 %LONG 0x10001000		;;ND0		: 000000
;;  D.S ASD:0xC40F2CA0 %LONG 0x11111111		;;ND1		: 111111
;;  D.S ASD:0xC40F2EA0 %LONG 0x12221222		;;VDOIMXW0	: 222222
;;  D.S ASD:0xC40F30A0 %LONG 0x11111121		;;VDOIMXW1	: 111121 <- 111111 (230328 dongil.nam c)
;;  D.S ASD:0xC40F32A0 %LONG 0x10001030		;;VDOIMXW2	: 100030 <- 000000 (230328 dongil.nam c)
;;  D.S ASD:0xC40F34A0 %LONG 0x13331232		;;VDOIMXW3	: 333232 <- 333333 (230328 dongil.nam c)
;;  D.S ASD:0xC40F36A0 %LONG 0x13210000		;;IMXR01	: 321xxx <- 333xxx (230328 dongil.nam c)
;;  D.S ASD:0xC40F38A0 %LONG 0x12220000		;;IMXR23	: 222xxx <- 222xxx (230328 dongil.nam c)
;;  D.S ASD:0xC40F3AA0 %LONG 0x12201200		;;TCON		: 220200 <- 000000 (230328 dongil.nam c)
;;  D.S ASD:0xC40F3CA0 %LONG 0x11311131		;;AUD		: 111111 
;;  D.S ASD:0xC40F3EA0 %LONG 0x13331333		;;LNX0		: 333333
;;  D.S ASD:0xC40F40A0 %LONG 0x10001000		;;LNX1		: 000000
;;  D.S ASD:0xC40F42A0 %LONG 0x11121112		;;LNX2		: 112112 <- 111111 (230328 dongil.nam c)
;;  D.S ASD:0xC40F44A0 %LONG 0x11111111		;;VD0A		: 111111
;;  D.S ASD:0xC40F46A0 %LONG 0x10001000		;;VD0B		: 000000
;;  D.S ASD:0xC40F48A0 %LONG 0x12221222		;;VD1A		: 222222
;;  D.S ASD:0xC40F4AA0 %LONG 0x12221222		;;VD1B		: 222222
;;  D.S ASD:0xC40F4CA0 %LONG 0x13331333		;;VD2VMCU	: 333333
;;  D.S ASD:0xC40F4EA0 %LONG 0x11111111		;;VD2B		: 111111


;  ;;;;;;;;;;;;;;;;;;;;;;;;;;;;;;;;;;;;;;;;;;;;;;;;;;;;;;;
;  ;; Refrefence M23
;  ;;;;;;;;;;;;;;;;;;;;;;;;;;;;;;;;;;;;;;;;;;;;;;;;;;;;;;;
;  D.S ASD:0xC45030A0 %LONG 0x11001100		;;GPU       : 1
;  D.S ASD:0xC45032A0 %LONG 0x13001300		;;GFX       : 3
;  D.S ASD:0xC45034A0 %LONG 0x10001000		;;TIV       : 0
;  D.S ASD:0xC45036A0 %LONG 0x12001200		;;DBB       : 2
;  D.S ASD:0xC45038A0 %LONG 0x10001000		;;TCON      : 0
;  D.S ASD:0xC4503AA0 %LONG 0x13001300		;;LNE       : 3
;  D.S ASD:0xC4503CA0 %LONG 0x10001000		;;PQE_MCU   : 0
;  D.S ASD:0xC4503EA0 %LONG 0x13001300		;;FMC0      : 3 <- 1 211117 dongil.nam C
;  D.S ASD:0xC45040A0 %LONG 0x13001300		;;FMC1      : 3 <- 1 211117 dongil.nam C
;  D.S ASD:0xC45042A0 %LONG 0x12000000		;;CCO0      : 2
;  D.S ASD:0xC45044A0 %LONG 0x00001200		;;SRE       : 2
;  D.S ASD:0xC45046A0 %LONG 0x11001100		;;ND0       : 1
;  D.S ASD:0xC45048A0 %LONG 0x12001200		;;ME0       : 2
;  D.S ASD:0xC4504AA0 %LONG 0x11001100		;;FMS       : 1
;  D.S ASD:0xC4504CA0 %LONG 0x10001000		;;CVD       : 0
;  D.S ASD:0xC4504EA0 %LONG 0x13000000		;;VDO0      : 3
;  D.S ASD:0xC45050A0 %LONG 0x11000000		;;VDO1      : 1
;  D.S ASD:0xC45052A0 %LONG 0x12001200		;;SMX0      : 2
;  D.S ASD:0xC45054A0 %LONG 0x00001100		;;SMX1      : 1
;  D.S ASD:0xC45056A0 %LONG 0x10001000		;;DNE0      : 0
;  D.S ASD:0xC45058A0 %LONG 0x12001200		;;AUD0      : 2
;  D.S ASD:0xC4505AA0 %LONG 0x11001100		;;AUD1      : 1
;  D.S ASD:0xC4505CA0 %LONG 0x12001200		;;VDEC0_M0  : 2 <- 1 211207 sanghoon.byun C
;  D.S ASD:0xC4505EA0 %LONG 0x13001300		;;VDEC0_M1  : 3 <- 0 211207 sanghoon.byun C
;  D.S ASD:0xC45060A0 %LONG 0x10001000		;;VDEC1_M0  : 0 <- 2 211207 sanghoon.byun C
;  D.S ASD:0xC45062A0 %LONG 0x11001100		;;VDEC1_M1  : 1 <- 3 211207 sanghoon.byun C
;  D.S ASD:0xC45064A0 %LONG 0x10001000		;;VDEC_MCU  : 0

;;;;;;;;;;;;;;;;;;;;;;;;;;;;;;;;;;;;;;;;;;;;;;;;;;;;;;;
;; Refrefence O22
;;;;;;;;;;;;;;;;;;;;;;;;;;;;;;;;;;;;;;;;;;;;;;;;;;;;;;;
 ; D.S A:0xC60010A0  %LE %LONG 0x11101110 // GPU      : 1/1
 ; D.S A:0xC60012A0  %LE %LONG 0x13301330 // GFX      : 3/3
 ; D.S A:0xC60014A0  %LE %LONG 0x10001000 // TIV_venc : 0/0
 ; D.S A:0xC60014B0  %LE %LONG 0x10001000 // TIV_icod : 0/0
 ; D.S A:0xC60014B4  %LE %LONG 0x10001000 // TIV_te   : 0/0
 ; D.S A:0xC600C2A0  %LE %LONG 0x12201220 // AUD0     : 2/2
 ; D.S A:0xC600C4A0  %LE %LONG 0x11101110 // AUD1     : 1/1
 ; D.S A:0xC6001AA0  %LE %LONG 0x13001300 // DBB      : 3/0
 ; D.S A:0xC6001CA0  %LE %LONG 0x11301130 // SRNR     : 1/3
 ; D.S A:0xC6001EA0  %LE %LONG 0x12201220 // LNE      : 2/2
 ; D.S A:0xC60020A0  %LE %LONG 0x10001000 // PQE_MCU  : 0/0
 ; D.S A:0xC60022A0  %LE %LONG 0x11301130 // FMC0     : 1/3 <-1/0 201030 HoonOh
 ; D.S A:0xC60024A0  %LE %LONG 0x10201020 // FMC1     : 0/2
 ; D.S A:0xC60026A0  %LE %LONG 0x12301230 // FMC2     : 2/3
 ; D.S A:0xC60028A0  %LE %LONG 0x13001300 // FMC3     : 3/0 <-3/1 201030 HoonOh
 ; D.S A:0xC6002AA0  %LE %LONG 0x11101110 // CCO0     : 1/1 <- 2/1 201030 HoonOh
 ; D.S A:0xC6002CA0  %LE %LONG 0x12201220 // CCO1     : 2/2
 ; D.S A:0xC6002EA0  %LE %LONG 0x12201220 // SRE      : 2/2 <- 2/0 201030 HoonOh
 ; D.S A:0xC60030A0  %LE %LONG 0x11101110 // ND0      : 1/1
 ; D.S A:0xC60032A0  %LE %LONG 0x13301330 // ND1      : 3/3
 ; D.S A:0xC60034A0  %LE %LONG 0x12201220 // ME0      : 2/2
 ; D.S A:0xC60036A0  %LE %LONG 0x10001000 // ME1      : 0/0
 ; D.S A:0xC60038A0  %LE %LONG 0x10301030 // SSD      : 0/3
 ; D.S A:0xC6003AA0  %LE %LONG 0x11101110 // FMS      : 1/1
 ; D.S A:0xC6003CA0  %LE %LONG 0x12301230 // GSC0     : 2/3
 ; D.S A:0xC6003EA0  %LE %LONG 0x13301330 // GSC1     : 3/3
 ; D.S A:0xC60040A0  %LE %LONG 0x11301130 // DNE0     : 1/3
 ; D.S A:0xC60042A0  %LE %LONG 0x11301130 // DNE1     : 1/3
 ; D.S A:0xC60044A0  %LE %LONG 0x10001000 // CVD      : 0/0
 ; D.S A:0xC60046A0  %LE %LONG 0x13301330 // VDO0     : 3/3
 ; D.S A:0xC60048A0  %LE %LONG 0x12201220 // VDO1     : 2/2
 ; D.S A:0xC6004AA0  %LE %LONG 0x10001000 // VDO2     : 0/0
 ; D.S A:0xC6004CA0  %LE %LONG 0x11101110 // VDO3     : 1/1
 ; D.S A:0xC6004EA0  %LE %LONG 0x12301230 // SMX0     : 2/3
 ; D.S A:0xC60050A0  %LE %LONG 0x11101110 // SMX1     : 1/1
 ; D.S A:0xC60052A0  %LE %LONG 0x10001000 // SMX2     : 0/0
 ; D.S A:0xC60054A0  %LE %LONG 0x13301330 // SMX3     : 3/3
 ; D.S A:0xC600B0A0  %LE %LONG 0x11301130 // VDEC0_M0 : 1/3
 ; D.S A:0xC600B2A0  %LE %LONG 0x10201020 // VDEC0_M1 : 0/2
 ; D.S A:0xC600B4A0  %LE %LONG 0x12101210 // VDEC1_M0 : 2/1
 ; D.S A:0xC600B6A0  %LE %LONG 0x13001300 // VDEC1_M1 : 3/0
 ; D.S A:0xC600B8A0  %LE %LONG 0x11301130 // VDEC2_M0 : 1/3
 ; D.S A:0xC600BAA0  %LE %LONG 0x10201020 // VDEC2_M1 : 0/2
 ; D.S A:0xC600BCA0  %LE %LONG 0x12101210 // VDEC3_M0 : 2/1
 ; D.S A:0xC600BEA0  %LE %LONG 0x13001300 // VDEC3_M1 : 3/0
 ; D.S A:0xC600C0A0  %LE %LONG 0x10001000 // VDEC_MCU : 0/0
                
                
;;;;;;;;;;;;;;;;;;;;;;;;;;;;;;;;;;;;;;;;;;;;;;;;;;;;;;;
;; Refrefence E60
;;;;;;;;;;;;;;;;;;;;;;;;;;;;;;;;;;;;;;;;;;;;;;;;;;;;;;;
;; D.S A:0xC98230a0 %LE %LONG 0x12221222   // GPU 2/2/2
;; D.S A:0xC98234a0 %LE %LONG 0x11111111   // TIV 1/1/1
;; D.S A:0xC98238a0 %LE %LONG 0x10001000   // WOV 0/0/0
;; D.S A:0xC9823Ca0 %LE %LONG 0x13331333   // LGSR 3/3/3
;; D.S A:0xC98240a0 %LE %LONG 0x13331333   // LNE 3/3/3
;; D.S A:0xC98244a0 %LE %LONG 0x11111111   // VDEC0_M1 1/1/1
;; D.S A:0xC98248a0 %LE %LONG 0x13331333   // VDEC1_M1 3/3/3
;; D.S A:0xC9824Ca0 %LE %LONG 0x12111211   // VDEC2A_M1 2/1/1
;; D.S A:0xC98250a0 %LE %LONG 0x13231323   // VDEC2B_M1 3/2/3
;; D.S A:0xC98254a0 %LE %LONG 0x10001000   // VDEC3A_M1 0/0/0
;; D.S A:0xC98258a0 %LE %LONG 0x12221222   // VDEC3B_M1 2/2/2
;; D.S A:0xC98260A0 %LE %LONG 0x11111113   // FMC0 1/1/1
;; D.S A:0xC98264a0 %LE %LONG 0x13221333   // FMC2 3/2/2/3/3/3
;; D.S A:0xC98268a0 %LE %LONG 0x13331333   // FMC4 3/3/3
;; D.S A:0xC9826Ca0 %LE %LONG 0x11001111   // FMC6 1/0/0/1/1/1
;; D.S A:0xC98270a0 %LE %LONG 0x11111111   // GSC0 1/1/1
;; D.S A:0xC98274a0 %LE %LONG 0x13331333   // GSC2 3/3/3
;; D.S A:0xC98278a0 %LE %LONG 0x11111332   // GSC4 1/1/1
;; D.S A:0xC9827Ca0 %LE %LONG 0x10331033   // CCO0 0/3/3
;; D.S A:0xC98280a0 %LE %LONG 0x10001000   // SMX0 0/0/0
;; D.S A:0xC98284a0 %LE %LONG 0x12221222   // SMX2 2/2/2
;; D.S A:0xC98288a0 %LE %LONG 0x11101110   // SMX4 1/1/1
;; D.S A:0xC9828Ca0 %LE %LONG 0x10001000   // SMX6 0/0/0
;; D.S A:0xC98278a0 %LE %LONG 0x11111332   // SRE0 3/3/3
;; D.S A:0xC98290a0 %LE %LONG 0x10001000   // VDM0 0/0/0
;; D.S A:0xC98286a0 %LE %LONG 0x12221222   // VDM2 2/2/2
;; D.S A:0xC98294a0 %LE %LONG 0x10001000   // ND0 0/0/0
;; D.S A:0xC98298a0 %LE %LONG 0x12221223   // ND2 2/2/2
;; D.S A:0xC9829Ca0 %LE %LONG 0x13331330   // SSD 3/3/3
;; D.S A:0xC982A0a0 %LE %LONG 0x11111111   // FMS0 1/1/1
;; D.S A:0xC982A4a0 %LE %LONG 0x11111111   // CVD 1/1/1
;; D.S A:0xC98232a0 %LE %LONG 0x11111111   // GFX 1/1/1
;; D.S A:0xC98236a0 %LE %LONG 0x11311131   // AUD 1/3/1
;; D.S A:0xC9823Aa0 %LE %LONG 0x12221222   // DBB 2/2/2
;; D.S A:0xC9823Ea0 %LE %LONG 0x10001000   // OASR 0/0/0
;; D.S A:0xC98242a0 %LE %LONG 0x12221222   // VDEC0_M0 2/2/2
;; D.S A:0xC98246a0 %LE %LONG 0x13331333   // VDEC1_M0 3/3/3
;; D.S A:0xC9824Aa0 %LE %LONG 0x10001000   // VDEC2A_M0 0/0/0
;; D.S A:0xC9824Ea0 %LE %LONG 0x11321132   // VDEC2B_M0 1/3/2
;; D.S A:0xC98252a0 %LE %LONG 0x11111111   // VDEC3A_M0 1/1/1
;; D.S A:0xC98256a0 %LE %LONG 0x13331333   // VDEC3B_M0 3/3/3
;; D.S A:0xC9825Aa0 %LE %LONG 0x10001000   // MCU 0/0/0
;; D.S A:0xC98262a0 %LE %LONG 0x12111222   // FMC1 2/1/1/2/2/2
;; D.S A:0xC98266a0 %LE %LONG 0x10221000   // FMC3 0/2/2/0/0/0
;; D.S A:0xC9826Aa0 %LE %LONG 0x10331000   // FMC5 0/3/3/0/0/0
;; D.S A:0xC9826Ea0 %LE %LONG 0x12001222   // FMC7 2/0/0/2/2/2
;; D.S A:0xC98272a0 %LE %LONG 0x12221222   // GSC1 2/2/2
;; D.S A:0xC98276a0 %LE %LONG 0x10001000   // GSC3 0/0/0
;; D.S A:0xC9827Aa0 %LE %LONG 0x12221001   // GSC5 2/2/2
;; D.S A:0xC9827Ea0 %LE %LONG 0x12221222   // CCO1 2/2/2
;; D.S A:0xC98282a0 %LE %LONG 0x11111111   // SMX1 1/1/1
;; D.S A:0xC9823Ca0 %LE %LONG 0x13331333   // SMX3 3/3/3
;; D.S A:0xC98298a0 %LE %LONG 0x12221223   // SMX5 2/2/2
;; D.S A:0xC9828Ea0 %LE %LONG 0x13331333   // SMX7 3/3/3
;; D.S A:0xC9827Aa0 %LE %LONG 0x12221001   // SRE1 0/0/0
;; D.S A:0xC98292a0 %LE %LONG 0x11111111   // VDM1 1/1/1
;; D.S A:0xC9828Aa0 %LE %LONG 0x13331333   // VDM3 3/3/3
;; D.S A:0xC98296a0 %LE %LONG 0x11111111   // ND1 1/1/1
;; D.S A:0xC9829Aa0 %LE %LONG 0x11101110   // ME0 1/1/1
;; D.S A:0xC9829Ea0 %LE %LONG 0x12221223   // ME1 2/2/2
;; D.S A:0xC982A2a0 %LE %LONG 0x13331333   // FMS1 3/3/3
;; D.S A:0xC982A6a0 %LE %LONG 0x12221222   // OBD 2/2/2
;;;;;;;;;;;;;;;;;;;;;;;;;;;;;;;;;;;;;;;;;;;;;;;;;;;;;;;
;; Generating PRIORITY CMM 
;; Generating Time : 2024-07-15
;; Modified time: 2025-04-08  ;; update FPGA optimization result for ASIC delivery
;; Project : O26
;;;;;;;;;;;;;;;;;;;;;;;;;;;;;;;;;;;;;;;;;;;;;;;;;;;;;;;

;GPU0
D.S ASD:0xC42084D0 %LONG 0x10001000		;;MODE
D.S ASD:0xC42084D4 %LONG 0x30303030		;;M0/M1

;GPU1
D.S ASD:0xC42088D0 %LONG 0x10001000		;;MODE
D.S ASD:0xC42088D4 %LONG 0x30303030		;;M0/M1

;GFX
D.S ASD:0xC42104D0 %LONG 0x10001000		;;MODE
D.S ASD:0xC42104D4 %LONG 0x30303030		;;M0/M1

;LOWBW
D.S ASD:0xC4208CD0 %LONG 0x10001000		;;MODE
D.S ASD:0xC4208CD4 %LONG 0x30303030		;;M0/M1

;TIVVMCU
D.S ASD:0xC42108D0 %LONG 0x10001000		;;MODE
D.S ASD:0xC42108D4 %LONG 0x30303030		;;M0/M1

;ME3X1
D.S ASD:0xC42004D0 %LONG 0x10001000		;;MODE
D.S ASD:0xC42004D4 %LONG 0x30303030		;;M0/M1

;FMC0
D.S ASD:0xC42008D0 %LONG 0x10001000		;;MODE
D.S ASD:0xC42008D4 %LONG 0xF0F03030		;;M0/M1

;FMC1
D.S ASD:0xC4200CD0 %LONG 0x10001000		;;MODE
D.S ASD:0xC4200CD4 %LONG 0xF0F03030		;;M0/M1

;FMC2
D.S ASD:0xC42010D0 %LONG 0x10001000		;;MODE
D.S ASD:0xC42010D4 %LONG 0xF0F03030		;;M0/M1

;FMC3
D.S ASD:0xC42014D0 %LONG 0x10001000		;;MODE
D.S ASD:0xC42014D4 %LONG 0xF0F03030		;;M0/M1

;FMS
D.S ASD:0xC42090D0 %LONG 0x10001000		;;MODE
D.S ASD:0xC42090D4 %LONG 0x30303030		;;M0/M1

;SRE0
D.S ASD:0xC42018D0 %LONG 0x10001000		;;MODE
D.S ASD:0xC42018D4 %LONG 0x30303030		;;M0/M1

;SRE1CCO
D.S ASD:0xC4201CD0 %LONG 0x10001000		;;MODE
D.S ASD:0xC4201CD4 %LONG 0xF0303030		;;M0/M1

;ND0
D.S ASD:0xC42094D0 %LONG 0x10001000		;;MODE
D.S ASD:0xC42094D4 %LONG 0x30303030		;;M0/M1

;ND1
D.S ASD:0xC42098D0 %LONG 0x10001000		;;MODE
D.S ASD:0xC42098D4 %LONG 0x30303030		;;M0/M1

;IMX0
D.S ASD:0xC4209CD0 %LONG 0x10001000		;;MODE
D.S ASD:0xC4209CD4 %LONG 0x3030F0F0		;;M0/M1

;IMX1
D.S ASD:0xC420A0D0 %LONG 0x10001000		;;MODE
D.S ASD:0xC420A0D4 %LONG 0x3030F0F0		;;M0/M1

;IMX2
D.S ASD:0xC420A4D0 %LONG 0x10001000		;;MODE
D.S ASD:0xC420A4D4 %LONG 0x3030F0F0		;;M0/M1

;IMX3
D.S ASD:0xC420A8D0 %LONG 0x10001000		;;MODE
D.S ASD:0xC420A8D4 %LONG 0x3030F0F0		;;M0/M1

;VDO0
D.S ASD:0xC420ACD0 %LONG 0x10001000		;;MODE
D.S ASD:0xC420ACD4 %LONG 0x30303030		;;M0/M1

;VDO1
D.S ASD:0xC420B0D0 %LONG 0x10001000		;;MODE
D.S ASD:0xC420B0D4 %LONG 0x30303030		;;M0/M1

;GSC0
D.S ASD:0xC42020D0 %LONG 0x10001000		;;MODE
D.S ASD:0xC42020D4 %LONG 0xF0F03030		;;M0/M1

;GSC1
D.S ASD:0xC42024D0 %LONG 0x10001000		;;MODE
D.S ASD:0xC42024D4 %LONG 0xF0F03030		;;M0/M1

;GSC2
D.S ASD:0xC42028D0 %LONG 0x10001000		;;MODE
D.S ASD:0xC42028D4 %LONG 0xF0F03030		;;M0/M1

;GSC3
D.S ASD:0xC4202CD0 %LONG 0x10001000		;;MODE
D.S ASD:0xC4202CD4 %LONG 0xF0F03030		;;M0/M1

;AUD
D.S ASD:0xC4210CD0 %LONG 0x10001000		;;MODE
D.S ASD:0xC4210CD4 %LONG 0x30303030		;;M0/M1

;NPPTCU
D.S ASD:0xC42110D0 %LONG 0x10001000		;;MODE
D.S ASD:0xC42110D4 %LONG 0x30303030		;;M0/M1

;LNX0
D.S ASD:0xC42114D0 %LONG 0x10001000		;;MODE
D.S ASD:0xC42114D4 %LONG 0x30303030		;;M0/M1

;LNX1
D.S ASD:0xC42118D0 %LONG 0x10001000		;;MODE
D.S ASD:0xC42118D4 %LONG 0x30303030		;;M0/M1

;LNX2
D.S ASD:0xC4211CD0 %LONG 0x10001000		;;MODE
D.S ASD:0xC4211CD4 %LONG 0x30303030		;;M0/M1

;VD0A
D.S ASD:0xC42120D0 %LONG 0x10001000		;;MODE
D.S ASD:0xC42120D4 %LONG 0x30303030		;;M0/M1

;VD0B
D.S ASD:0xC42124D0 %LONG 0x10001000		;;MODE
D.S ASD:0xC42124D4 %LONG 0x30303030		;;M0/M1

;VD1A
D.S ASD:0xC42128D0 %LONG 0x10001000		;;MODE
D.S ASD:0xC42128D4 %LONG 0x30303030		;;M0/M1

;VD1B
D.S ASD:0xC4212CD0 %LONG 0x10001000		;;MODE
D.S ASD:0xC4212CD4 %LONG 0x30303030		;;M0/M1

;CPU_CORE
;D.S ASD:0xCA2020D0 %LONG 0x10001000		;;MODE
;D.S ASD:0xCA2020D4 %LONG 0xD0D0D0D0		;;M0/M1

;PERI_AXI
;D.S ASD:0xCA2000D0 %LONG 0x10001000		;;MODE
;D.S ASD:0xCA2000D4 %LONG 0x30303030		;;M0/M1

;PERI_AHB
;D.S ASD:0xCA2040D0 %LONG 0x10001000		;;MODE
;D.S ASD:0xCA2040D4 %LONG 0x30303030		;;M0/M1

;LZMA
;D.S ASD:0xCA2024D0 %LONG 0x10001000		;;MODE
;D.S ASD:0xCA2024D4 %LONG 0x30303030		;;M0/M1

;CPU_FAST
;D.S ASD:0xCA2028D0 %LONG 0x10001000		;;MODE
;D.S ASD:0xCA2028D4 %LONG 0xD0D0D0D0		;;M0/M1


;; ;;;;;;;;;;;;;;;;;;;;;;;;;;;;;;;;;;;;;;;;;;;;;;;;;;;;;;;
;; ;; Generating PRIORITY CMM by BUS_PMT
;; ;; Generating Time : 2021-11-11 09:31:04
;; ;; Project : O24
;; ;;;;;;;;;;;;;;;;;;;;;;;;;;;;;;;;;;;;;;;;;;;;;;;;;;;;;;;
;; 
;; ;GPU0
;; D.S ASD:0xC40F10D0 %LONG 0x10001000		;;MODE
;; D.S ASD:0xC40F10D4 %LONG 0x30303030		;;M0/M1
;; D.S ASD:0xC40F11D4 %LONG 0x30003000		;;M2
;; 
;; ;GPU1
;; D.S ASD:0xC40F12D0 %LONG 0x10001000		;;MODE
;; D.S ASD:0xC40F12D4 %LONG 0x30303030		;;M0/M1
;; D.S ASD:0xC40F13D4 %LONG 0x30003000		;;M2
;; 
;; ;GFX
;; D.S ASD:0xC40F14D0 %LONG 0x10001000		;;MODE
;; D.S ASD:0xC40F14D4 %LONG 0x30303030		;;M0/M1
;; D.S ASD:0xC40F15D4 %LONG 0x30003000		;;M2
;; 
;; ;LOWBW
;; D.S ASD:0xC40F16D0 %LONG 0x10001000		;;MODE
;; D.S ASD:0xC40F16D4 %LONG 0x30303030		;;M0/M1
;; D.S ASD:0xC40F17D4 %LONG 0x30003000		;;M2
;; 
;; ;ICVENC
;; D.S ASD:0xC40F18D0 %LONG 0x10001000		;;MODE
;; D.S ASD:0xC40F18D4 %LONG 0x30303030		;;M0/M1
;; D.S ASD:0xC40F19D4 %LONG 0x30003000		;;M2
;; 
;; ;MEFMS
;; D.S ASD:0xC40F1AD0 %LONG 0x10001000		;;MODE
;; D.S ASD:0xC40F1AD4 %LONG 0x30303030		;;M0/M1
;; D.S ASD:0xC40F1BD4 %LONG 0x30003000		;;M2
;; 
;; ;FMGSSR0
;; D.S ASD:0xC40F1CD0 %LONG 0x10001000		;;MODE
;; D.S ASD:0xC40F1CD4 %LONG 0xF0F03030		;;M0/M1
;; D.S ASD:0xC40F1DD4 %LONG 0xF0003000		;;M2
;; 
;; ;FMGSSR1
;; D.S ASD:0xC40F1ED0 %LONG 0x10001000		;;MODE
;; D.S ASD:0xC40F1ED4 %LONG 0xF0F03030		;;M0/M1
;; D.S ASD:0xC40F1FD4 %LONG 0xF0003000		;;M2
;; 
;; ;FMGSSR2
;; D.S ASD:0xC40F20D0 %LONG 0x10001000		;;MODE
;; D.S ASD:0xC40F20D4 %LONG 0xF0F03030		;;M0/M1
;; D.S ASD:0xC40F21D4 %LONG 0xF0003000		;;M2
;; 
;; ;FMGSSR3
;; D.S ASD:0xC40F22D0 %LONG 0x10001000		;;MODE
;; D.S ASD:0xC40F22D4 %LONG 0xF0F03030		;;M0/M1
;; D.S ASD:0xC40F23D4 %LONG 0xF0003000		;;M2
;; 
;; ;FMGSSR4
;; D.S ASD:0xC40F24D0 %LONG 0x10001000		;;MODE
;; D.S ASD:0xC40F24D4 %LONG 0xF0F03030		;;M0/M1
;; D.S ASD:0xC40F25D4 %LONG 0xF0003000		;;M2
;; 
;; ;CCO0
;; D.S ASD:0xC40F26D0 %LONG 0x10001000		;;MODE
;; D.S ASD:0xC40F26D4 %LONG 0x30303030		;;M0/M1
;; D.S ASD:0xC40F27D4 %LONG 0x30003000		;;M2
;; 
;; ;CCO1
;; D.S ASD:0xC40F28D0 %LONG 0x10001000		;;MODE
;; D.S ASD:0xC40F28D4 %LONG 0x30303030		;;M0/M1
;; D.S ASD:0xC40F29D4 %LONG 0x30003000		;;M2
;; 
;; ;ND0
;; D.S ASD:0xC40F2AD0 %LONG 0x10001000		;;MODE
;; D.S ASD:0xC40F2AD4 %LONG 0x30303030		;;M0/M1
;; D.S ASD:0xC40F2BD4 %LONG 0x30003000		;;M2
;; 
;; ;ND1
;; D.S ASD:0xC40F2CD0 %LONG 0x10001000		;;MODE
;; D.S ASD:0xC40F2CD4 %LONG 0x30303030		;;M0/M1
;; D.S ASD:0xC40F2DD4 %LONG 0x30003000		;;M2
;; 
;; ;VDOIMXW0
;; D.S ASD:0xC40F2ED0 %LONG 0x10001000		;;MODE
;; D.S ASD:0xC40F2ED4 %LONG 0x3030F0F0		;;M0/M1
;; D.S ASD:0xC40F2FD4 %LONG 0x3000F000		;;M2
;; 
;; ;VDOIMXW1
;; D.S ASD:0xC40F30D0 %LONG 0x10001000		;;MODE
;; D.S ASD:0xC40F30D4 %LONG 0x3030F0F0		;;M0/M1
;; D.S ASD:0xC40F31D4 %LONG 0x3000F000		;;M2
;; 
;; ;VDOIMXW2
;; D.S ASD:0xC40F32D0 %LONG 0x10001000		;;MODE
;; D.S ASD:0xC40F32D4 %LONG 0x3030F0F0		;;M0/M1
;; D.S ASD:0xC40F33D4 %LONG 0x3000F000		;;M2
;; 
;; ;VDOIMXW3
;; D.S ASD:0xC40F34D0 %LONG 0x10001000		;;MODE
;; D.S ASD:0xC40F34D4 %LONG 0x3030F0F0		;;M0/M1
;; D.S ASD:0xC40F35D4 %LONG 0x3000F000		;;M2
;; 
;; ;IMXR01
;; D.S ASD:0xC40F36D0 %LONG 0x10001000		;;MODE
;; D.S ASD:0xC40F36D4 %LONG 0x30303030		;;M0/M1
;; D.S ASD:0xC40F37D4 %LONG 0x30003000		;;M2
;; 
;; ;IMXR23
;; D.S ASD:0xC40F38D0 %LONG 0x10001000		;;MODE
;; D.S ASD:0xC40F38D4 %LONG 0x30303030		;;M0/M1
;; D.S ASD:0xC40F39D4 %LONG 0x30003000		;;M2
;; 
;; ;TCON
;; D.S ASD:0xC40F3AD0 %LONG 0x10001000		;;MODE
;; D.S ASD:0xC40F3AD4 %LONG 0x30303030		;;M0/M1
;; D.S ASD:0xC40F3BD4 %LONG 0x30003000		;;M2
;; 
;; ;AUD
;; D.S ASD:0xC40F3CD0 %LONG 0x10001000		;;MODE
;; D.S ASD:0xC40F3CD4 %LONG 0x30303030		;;M0/M1
;; D.S ASD:0xC40F3DD4 %LONG 0x30003000		;;M2
;; 
;; ;LNX0
;; D.S ASD:0xC40F3ED0 %LONG 0x10001000		;;MODE
;; D.S ASD:0xC40F3ED4 %LONG 0x30303030		;;M0/M1
;; D.S ASD:0xC40F3FD4 %LONG 0x30003000		;;M2
;; 
;; ;LNX1
;; D.S ASD:0xC40F40D0 %LONG 0x10001000		;;MODE
;; D.S ASD:0xC40F40D4 %LONG 0x30303030		;;M0/M1
;; D.S ASD:0xC40F41D4 %LONG 0x30003000		;;M2
;; 
;; ;LNX2
;; D.S ASD:0xC40F42D0 %LONG 0x10001000		;;MODE
;; D.S ASD:0xC40F42D4 %LONG 0x30303030		;;M0/M1
;; D.S ASD:0xC40F43D4 %LONG 0x30003000		;;M2
;; 
;; ;VD0A
;; D.S ASD:0xC40F44D0 %LONG 0x10001000		;;MODE
;; D.S ASD:0xC40F44D4 %LONG 0x30303030		;;M0/M1
;; D.S ASD:0xC40F45D4 %LONG 0x30003000		;;M2
;; 
;; ;VD0B
;; D.S ASD:0xC40F46D0 %LONG 0x10001000		;;MODE
;; D.S ASD:0xC40F46D4 %LONG 0x30303030		;;M0/M1
;; D.S ASD:0xC40F47D4 %LONG 0x30003000		;;M2
;; 
;; ;VD1A
;; D.S ASD:0xC40F48D0 %LONG 0x10001000		;;MODE
;; D.S ASD:0xC40F48D4 %LONG 0x30303030		;;M0/M1
;; D.S ASD:0xC40F49D4 %LONG 0x30003000		;;M2
;; 
;; ;VD1B
;; D.S ASD:0xC40F4AD0 %LONG 0x10001000		;;MODE
;; D.S ASD:0xC40F4AD4 %LONG 0x30303030		;;M0/M1
;; D.S ASD:0xC40F4BD4 %LONG 0x30003000		;;M2
;; 
;; ;VD2VMCU
;; D.S ASD:0xC40F4CD0 %LONG 0x10001000		;;MODE
;; D.S ASD:0xC40F4CD4 %LONG 0x30303030		;;M0/M1
;; D.S ASD:0xC40F4DD4 %LONG 0x30003000		;;M2
;; 
;; ;VD2B
;; D.S ASD:0xC40F4ED0 %LONG 0x10001000		;;MODE
;; D.S ASD:0xC40F4ED4 %LONG 0x30303030		;;M0/M1
;; D.S ASD:0xC40F4FD4 %LONG 0x30003000		;;M2
;; 
;; ;CPU_CORE
;; ;D.S ASD:0xCA2010D0 %LONG 0x00000000		;;MODE
;; D.S ASD:0xCA2010D4 %LONG 0xC0C0C0C0		;;M0/M1
;; D.S ASD:0xCA2011D4 %LONG 0xC000C000		;;M2
;; 
;; ;PERI_AXI
;; D.S ASD:0xCA2000D0 %LONG 0x10001000		;;MODE
;; D.S ASD:0xCA2000D4 %LONG 0x30303030		;;M0/M1
;; D.S ASD:0xCA2001D4 %LONG 0x30003000		;;M2
;; 
;; ;PERI_AHB
;; D.S ASD:0xCA2020D0 %LONG 0x10001000		;;MODE
;; D.S ASD:0xCA2020D4 %LONG 0x30303030		;;M0/M1
;; D.S ASD:0xCA2021D4 %LONG 0x30003000		;;M2
;; 
;; ;LZMA
;; D.S ASD:0xCA2012D0 %LONG 0x10001000		;;MODE
;; D.S ASD:0xCA2012D4 %LONG 0x30303030		;;M0/M1
;; D.S ASD:0xCA2013D4 %LONG 0x30003000		;;M2
;; 
;; ;CPU_FAST
;; D.S ASD:0xCA2014D0 %LONG 0x10001000		;;MODE
;; D.S ASD:0xCA2014D4 %LONG 0xC0C0C0C0		;;M0/M1
;; D.S ASD:0xCA2015D4 %LONG 0xC000C000		;;M2
;; 
;; ;;;;;;;;;;;;;;;;;;;;;;;;;;;;;;;;;;;;;;;;;;;;;;;;;;;;;;;
;; ;; Generating SUBPRIORITY CMM by BUS_PMT
;; ;; Generating Time : 2022-12-14 11:12:58
;; ;; Project : O24
;; ;;;;;;;;;;;;;;;;;;;;;;;;;;;;;;;;;;;;;;;;;;;;;;;;;;;;;;;
;; ;; 12	s0 aruser sel	0x0	"ArUser 신호의 control mode 설정
;; ;;                                 - 1'b0 : bypass
;; ;;                                 - 1'b1 : 외부에서 들어오는 User signal 을 차단하고 rf_uc_user_R_s*  
;; ;;                                    register 에 설정한 값으로 대체"
;; ;; 11:9	reserved0		
;; ;; 8	s0 awuser sel	0x0	"AwUser 신호의 control mode 설정
;; ;;                                 - 1'b0 : bypass
;; ;;                                 - 1'b1 : 외부에서 들어오는 User signal 을 차단하고 rf_uc_user_W_s*  
;; ;;                                    register 에 설정한 값으로 대체"
;; ;; 7:4	s0_aruser	0x3	Read, ArUser 신호를 대체할 값 User값
;; ;; 3:0	s0 awuser	0x3	Write, AwUser 신호를 대체할 값 User값
;; 
;; 
;; ;LOWBW0_CVI
;; D.S ASD:0xCCDE10D0 %LONG 0x00000033		;;MODE|PVALUE
;; 
;; ;LOWBW0_HDMI
;; D.S ASD:0xCCDE10D4 %LONG 0x00000033		;;MODE|PVALUE
;; 
;; ;LOWBW0_TE
;; D.S ASD:0xCCDE10D8 %LONG 0x00000033		;;MODE|PVALUE
;; 
;; ;LOWBW0_DBB
;; D.S ASD:0xCCDE10DC %LONG 0x00000000		;;MODE|PVALUE
;; 
;; ;LOWBW1_DNSR
;; D.S ASD:0xCC5510D0 %LONG 0x00000033		;;MODE|PVALUE
;; 
;; ;LOWBW1_DNNR
;; D.S ASD:0xCC5510D4 %LONG 0x00000033		;;MODE|PVALUE
;; 
;; ;LOWBW1_PMCU
;; D.S ASD:0xCC5510D8 %LONG 0x00000000		;;MODE|PVALUE
;; 
;; ;MEFMS_ME0A
;; D.S ASD:0xCC9A20D0 %LONG 0x00000033		;;MODE|PVALUE
;; 
;; ;MEFMS_ME0B
;; D.S ASD:0xCC9A20D4 %LONG 0x00000033		;;MODE|PVALUE
;; 
;; ;MEFMS_ME1
;; D.S ASD:0xCC9A20D8 %LONG 0x00000033		;;MODE|PVALUE
;; 
;; ;MEFMS_FMS
;; D.S ASD:0xCC9A20DC %LONG 0x00000033		;;MODE|PVALUE
;; 
;; ;FMGSSR_FMC0
;; D.S ASD:0xCC5310D0 %LONG 0x00000033		;;MODE|PVALUE
;; 
;; ;FMGSSR_FMC1
;; D.S ASD:0xCC5310D4 %LONG 0x00000033		;;MODE|PVALUE
;; 
;; ;FMGSSR_FMC2
;; D.S ASD:0xCC5310D8 %LONG 0x00000033		;;MODE|PVALUE
;; 
;; ;FMGSSR_FMC3
;; D.S ASD:0xCC5310DC %LONG 0x00000033		;;MODE|PVALUE
;; 
;; ;FMGSSR_GSC0
;; D.S ASD:0xCC5310E0 %LONG 0x00000033		;;MODE|PVALUE
;; 
;; ;FMGSSR_GSC1
;; D.S ASD:0xCC5310E4 %LONG 0x00000033		;;MODE|PVALUE
;; 
;; ;FMGSSR_SRE0
;; D.S ASD:0xCC5310E8 %LONG 0x00000033		;;MODE|PVALUE
;; 
;; ;FMGSSR_SRE1
;; D.S ASD:0xCC5310EC %LONG 0x00000000		;;MODE|PVALUE
;; 
;; ;IMXR01_R0
;; D.S ASD:0xCC9820D0 %LONG 0x00000033		;;MODE|PVALUE
;; 
;; ;IMXR01_R1
;; D.S ASD:0xCC9820D4 %LONG 0x00000033		;;MODE|PVALUE
;; 
;; ;IMXR23_R2
;; D.S ASD:0xCC9850D0 %LONG 0x00000033		;;MODE|PVALUE
;; 
;; ;IMXR23_R3
;; D.S ASD:0xCC9850D4 %LONG 0x00000033		;;MODE|PVALUE
;; 
;; ;VMCUVDEC_VMCU
;; D.S ASD:0xCECE10D0 %LONG 0x00000033		;;MODE|PVALUE
;; 
;; ;VMCUVDEC_VDEC
;; D.S ASD:0xCECE10D4 %LONG 0x00000000		;;MODE|PVALUE


;; ;;;;;;;;;;;;;;;;;;;;;;;;;;;;;;;;;;;;;;;;;;;;;;;;;;;
;; ;M23 FPGA BUS PRIORITY reference 
;; ;;;;;;;;;;;;;;;;;;;;;;;;;;;;;;;;;;;;;;;;;;;;;;;;;;;;
;; ;211111 bus pmt default file
;; 
;; ;GPU
;; D.S ASD:0xC45030D0 %LONG 0x00000000		;;MODE
;; D.S ASD:0xC45030D4 %LONG 0x30003000		;;M0/M1   //PRT  RD M0 Main=3, Wr M0 Main=3  
;; 
;; ;GFX
;; D.S ASD:0xC45032D0 %LONG 0x00000000		;;MODE
;; D.S ASD:0xC45032D4 %LONG 0x30003000		;;M0/M1   //PRT  RD M0 Main=3, Wr M0 Main=3
;; 
;; ;TIV
;; D.S ASD:0xC45034D0 %LONG 0x00000000		;;MODE
;; D.S ASD:0xC45034D4 %LONG 0x30003000		;;M0/M1   //PRT  RD M0 Main=3, Wr M0 Main=3
;; 
;; ;DBB
;; D.S ASD:0xC45036D0 %LONG 0x00000000		;;MODE
;; D.S ASD:0xC45036D4 %LONG 0x30003000		;;M0/M1   //PRT  RD M0 Main=3, Wr M0 Main=3
;; 
;; ;TCON
;; D.S ASD:0xC45038D0 %LONG 0x00000000		;;MODE
;; D.S ASD:0xC45038D4 %LONG 0x30003000		;;M0/M1   //PRT  RD M0 Main=3, Wr M0 Main=3
;; 
;; ;LNE
;; D.S ASD:0xC4503AD0 %LONG 0x00000000		;;MODE
;; D.S ASD:0xC4503AD4 %LONG 0x30003000		;;M0/M1   //PRT  RD M0 Main=3, Wr M0 Main=3
;; 
;; ;PQE_MCU
;; D.S ASD:0xC4503CD0 %LONG 0x00000000		;;MODE
;; D.S ASD:0xC4503CD4 %LONG 0x30003000		;;M0/M1   //PRT  RD M0 Main=3, Wr M0 Main=3
;; 
;; ;FMC0
;; D.S ASD:0xC4503ED0 %LONG 0x00000000		;;MODE
;; D.S ASD:0xC4503ED4 %LONG 0x30003000		;;M0/M1   //PRT  RD M0 Main=3, Wr M0 Main=3
;; 
;; ;FMC1
;; D.S ASD:0xC45040D0 %LONG 0x00000000		;;MODE
;; D.S ASD:0xC45040D4 %LONG 0x30003000		;;M0/M1   //PRT  RD M0 Main=3, Wr M0 Main=3
;; 
;; ;CCO0
;; D.S ASD:0xC45042D0 %LONG 0x00000000		;;MODE
;; D.S ASD:0xC45042D4 %LONG 0x30003000		;;M0/M1   //PRT  RD M0 Main=3, Wr M0 Main=3
;; 
;; ;SRE
;; D.S ASD:0xC45044D0 %LONG 0x00000000		;;MODE
;; D.S ASD:0xC45044D4 %LONG 0x30003000		;;M0/M1   //PRT  RD M0 Main=3, Wr M0 Main=3
;; 
;; ;ND0
;; D.S ASD:0xC45046D0 %LONG 0x00000000		;;MODE
;; D.S ASD:0xC45046D4 %LONG 0x30003000		;;M0/M1   //PRT  RD M0 Main=3, Wr M0 Main=3
;; 
;; ;ME0
;; D.S ASD:0xC45048D0 %LONG 0x00000000		;;MODE
;; D.S ASD:0xC45048D4 %LONG 0x30003000		;;M0/M1   //PRT  RD M0 Main=3, Wr M0 Main=3
;; 
;; ;FMS
;; D.S ASD:0xC4504AD0 %LONG 0x00000000		;;MODE
;; D.S ASD:0xC4504AD4 %LONG 0x30003000		;;M0/M1   //PRT  RD M0 Main=3, Wr M0 Main=3
;; 
;; ;CVD
;; D.S ASD:0xC4504CD0 %LONG 0x00000000		;;MODE
;; D.S ASD:0xC4504CD4 %LONG 0x30003000		;;M0/M1   //PRT  RD M0 Main=3, Wr M0 Main=3
;; 
;; ;VDO0
;; D.S ASD:0xC4504ED0 %LONG 0x00000000		;;MODE
;; D.S ASD:0xC4504ED4 %LONG 0x30003000		;;M0/M1   //PRT  RD M0 Main=3, Wr M0 Main=3
;; 
;; ;VDO1
;; D.S ASD:0xC45050D0 %LONG 0x00000000		;;MODE
;; D.S ASD:0xC45050D4 %LONG 0x30003000		;;M0/M1   //PRT  RD M0 Main=3, Wr M0 Main=3
;; 
;; ;SMX0
;; D.S ASD:0xC45052D0 %LONG 0x00000000		;;MODE
;; D.S ASD:0xC45052D4 %LONG 0x30003000		;;M0/M1   //PRT  RD M0 Main=3, Wr M0 Main=3
;; 
;; ;SMX1
;; D.S ASD:0xC45054D0 %LONG 0x00000000		;;MODE
;; D.S ASD:0xC45054D4 %LONG 0x30003000		;;M0/M1   //PRT  RD M0 Main=3, Wr M0 Main=3
;; 
;; ;DNE0
;; D.S ASD:0xC45056D0 %LONG 0x00000000		;;MODE
;; D.S ASD:0xC45056D4 %LONG 0x30003000		;;M0/M1   //PRT  RD M0 Main=3, Wr M0 Main=3
;; 
;; ;AUD0
;; D.S ASD:0xC45058D0 %LONG 0x00000000		;;MODE
;; D.S ASD:0xC45058D4 %LONG 0x30003000		;;M0/M1   //PRT  RD M0 Main=3, Wr M0 Main=3
;; 
;; ;AUD1
;; D.S ASD:0xC4505AD0 %LONG 0x00000000		;;MODE
;; D.S ASD:0xC4505AD4 %LONG 0x30003000		;;M0/M1   //PRT  RD M0 Main=3, Wr M0 Main=3
;; 
;; ;VDEC0_M0
;; D.S ASD:0xC4505CD0 %LONG 0x00000000		;;MODE
;; D.S ASD:0xC4505CD4 %LONG 0x30003000		;;M0/M1   //PRT  RD M0 Main=3, Wr M0 Main=3
;; 
;; ;VDEC0_M1
;; D.S ASD:0xC4505ED0 %LONG 0x00000000		;;MODE
;; D.S ASD:0xC4505ED4 %LONG 0x30003000		;;M0/M1   //PRT  RD M0 Main=3, Wr M0 Main=3
;; 
;; ;VDEC1_M0
;; D.S ASD:0xC45060D0 %LONG 0x00000000		;;MODE
;; D.S ASD:0xC45060D4 %LONG 0x30003000		;;M0/M1   //PRT  RD M0 Main=3, Wr M0 Main=3
;; 
;; ;VDEC1_M1
;; D.S ASD:0xC45062D0 %LONG 0x00000000		;;MODE
;; D.S ASD:0xC45062D4 %LONG 0x30003000		;;M0/M1   //PRT  RD M0 Main=3, Wr M0 Main=3
;; 
;; ;VDEC_MCU
;; D.S ASD:0xC45064D0 %LONG 0x00000000		;;MODE
;; D.S ASD:0xC45064D4 %LONG 0x30003000		;;M0/M1   //PRT  RD M0 Main=3, Wr M0 Main=3
;; 
;; ;CPU_CORE
;; D.S ASD:0xCA2010D0 %LONG 0x00000000		;;MODE
;; D.S ASD:0xCA2010D4 %LONG 0xD000D000		;;M0/M1   //PRT  RD M0 Main=D, Wr M0 Main=D
;; 
;; ;PERI_AXI
;; D.S ASD:0xCA2002D0 %LONG 0x00000000		;;MODE
;; D.S ASD:0xCA2002D4 %LONG 0x30003000		;;M0/M1   //PRT  RD M0 Main=3, Wr M0 Main=3
;; 
;; ;PERI_AHB
;; D.S ASD:0xCA2004D0 %LONG 0x00000000		;;MODE
;; D.S ASD:0xCA2004D4 %LONG 0x30003000		;;M0/M1   //PRT  RD M0 Main=3, Wr M0 Main=3
;; 
;; ;LZMA
;; D.S ASD:0xCA2012D0 %LONG 0x00000000		;;MODE
;; D.S ASD:0xCA2012D4 %LONG 0x30003000		;;M0/M1   //PRT  RD M0 Main=3, Wr M0 Main=3
;; 
;; ;CPU_FAST
;; D.S ASD:0xCA2014D0 %LONG 0x00000000		;;MODE
;; D.S ASD:0xCA2014D4 %LONG 0xD000D000		;;M0/M1   //PRT  RD M0 Main=D, Wr M0 Main=D





;O22 FPGA BUS PRIORITY 설정 
;201123 Hoon.Oh

;CPU 추가//jungdb
;CPU new priority value -> Occurs EMMC related fail.  This  must be tested @ASIC chip, expecting no error!!
;D.S A:0xCAA010D0  %LE %LONG 0x10001000  // CPU  [28]Rd BUS register/ [12]Wr BUS register
;D.S A:0xCAA010D4  %LE %LONG 0x30303030  // CPU  PRT  RD M0 Main=3,M1 Main=3, Wr M0 Main=3, Wr M1 Main =3

;CPU default vuale -> works well
;D.S A:0xCAA010D0  %LE %LONG 0x003F003F  // CPU  [28]Rd BUS register/ [12]Wr BUS register
;D.S A:0xCAA010D4  %LE %LONG 0x35353535  // CPU  PRT  RD M0 Main=3,M1 Main=3, Wr M0 Main=3, Wr M1 Main =3

 ; ;IP
 ; D.S A:0xC60010D0  %LE %LONG 0x10001000  // GPU  
 ; D.S A:0xC60010D4  %LE %LONG 0x30303030  // GPU  PRT  RD M0 Main=3,M1 Main=3, Wr M0 Main=3, Wr M1 Main =3  
 ; D.S A:0xC60012D0  %LE %LONG 0x10001000  // GFX  
 ; D.S A:0xC60012D4  %LE %LONG 0x30303030  // GFX  PRT  RD M0 Main=3,M1 Main=3, Wr M0 Main=3, Wr M1 Main =3  
 ; 
 ; D.S A:0xC60014D0  %LE %LONG 0x10001000  // TIV_venc 
 ; D.S A:0xC60014D4  %LE %LONG 0x30303030  // TIV  PRT  RD M0 Main=3,M1 Main=3, Wr M0 Main=3, Wr M1 Main =3  
 ; ;D.S A:0xC60014B0  %LE %LONG 0x10001000  // TIV_icod 
 ; D.S A:0xC60014D8  %LE %LONG 0x30303030  // TIV  PRT  RD M0 Main=3,M1 Main=3, Wr M0 Main=3, Wr M1 Main =3  
 ; ;D.S A:0xC60014B4  %LE %LONG 0x10001000  // TIV_te   
 ; D.S A:0xC60014DC  %LE %LONG 0x30303030  // TIV  PRT  RD M0 Main=3,M1 Main=3, Wr M0 Main=3, Wr M1 Main =3  
 ; 
 ; D.S A:0xC600C2D0  %LE %LONG 0x10001000  // AUD0     
 ; D.S A:0xC600C2D4  %LE %LONG 0x30303030  // AUD  PRT  RD M0 Main=3,M1 Main=3, Wr M0 Main=3, Wr M1 Main =3  
 ; D.S A:0xC600C4D0  %LE %LONG 0x10001000  // AUD1     
 ; D.S A:0xC600C4D4  %LE %LONG 0x30303030  // AUD  PRT  RD M0 Main=3,M1 Main=3, Wr M0 Main=3, Wr M1 Main =3  
 ; D.S A:0xC6001AD0  %LE %LONG 0x10001000  // DBB      
 ; D.S A:0xC6001AD4  %LE %LONG 0x30303030  // DBB  PRT  RD M0 Main=3,M1 Main=3, Wr M0 Main=3, Wr M1 Main =3  
 ; D.S A:0xC6001CD0  %LE %LONG 0x10001000  // SRNR     
 ; D.S A:0xC6001CD4  %LE %LONG 0x30303030  // SRN  PRT  RD M0 Main=3,M1 Main=3, Wr M0 Main=3, Wr M1 Main =3  
 ; D.S A:0xC6001ED0  %LE %LONG 0x10001000  // LNE      
 ; D.S A:0xC6001ED4  %LE %LONG 0x30303030  // LNE  PRT  RD M0 Main=3,M1 Main=3, Wr M0 Main=3, Wr M1 Main =3  
 ; D.S A:0xC60020D0  %LE %LONG 0x10001000  // PQE_MCU  
 ; D.S A:0xC60020D4  %LE %LONG 0x30303030  // PQE  PRT  RD M0 Main=3,M1 Main=3, Wr M0 Main=3, Wr M1 Main =3  
 ; D.S A:0xC60022D0  %LE %LONG 0x10001000  // FMC0     
 ; D.S A:0xC60022D4  %LE %LONG 0x30303030  // FMC  PRT  RD M0 Main=3,M1 Main=3, Wr M0 Main=3, Wr M1 Main =3  
 ; D.S A:0xC60024D0  %LE %LONG 0x10001000  // FMC1     
 ; D.S A:0xC60024D4  %LE %LONG 0x30303030  // FMC  PRT  RD M0 Main=3,M1 Main=3, Wr M0 Main=3, Wr M1 Main =3  
 ; D.S A:0xC60026D0  %LE %LONG 0x10001000  // FMC2     
 ; D.S A:0xC60026D4  %LE %LONG 0x30303030  // FMC  PRT  RD M0 Main=3,M1 Main=3, Wr M0 Main=3, Wr M1 Main =3  
 ; D.S A:0xC60028D0  %LE %LONG 0x10001000  // FMC3     
 ; D.S A:0xC60028D4  %LE %LONG 0x30303030  // FMC  PRT  RD M0 Main=3,M1 Main=3, Wr M0 Main=3, Wr M1 Main =3  
 ; D.S A:0xC6002AD0  %LE %LONG 0x10001000  // CCO0     
 ; D.S A:0xC6002AD4  %LE %LONG 0x30303030  // CCO  PRT  RD M0 Main=3,M1 Main=3, Wr M0 Main=3, Wr M1 Main =3  
 ; D.S A:0xC6002CD0  %LE %LONG 0x10001000  // CCO1     
 ; D.S A:0xC6002CD4  %LE %LONG 0x30303030  // CCO  PRT  RD M0 Main=3,M1 Main=3, Wr M0 Main=3, Wr M1 Main =3  
 ; D.S A:0xC6002ED0  %LE %LONG 0x10001000  // SRE      
 ; D.S A:0xC6002ED4  %LE %LONG 0x30303030  // SRE  PRT  RD M0 Main=3,M1 Main=3, Wr M0 Main=3, Wr M1 Main =3  
 ; D.S A:0xC60030D0  %LE %LONG 0x10001000  // ND0      
 ; D.S A:0xC60030D4  %LE %LONG 0x30303030  // ND0  PRT  RD M0 Main=3,M1 Main=3, Wr M0 Main=3, Wr M1 Main =3  
 ; D.S A:0xC60032D0  %LE %LONG 0x10001000  // ND1      
 ; D.S A:0xC60032D4  %LE %LONG 0x30303030  // ND1  PRT  RD M0 Main=3,M1 Main=3, Wr M0 Main=3, Wr M1 Main =3  
 ; D.S A:0xC60034D0  %LE %LONG 0x10001000  // ME0      
 ; D.S A:0xC60034D4  %LE %LONG 0x30303030  // ME0  PRT  RD M0 Main=3,M1 Main=3, Wr M0 Main=3, Wr M1 Main =3  
 ; D.S A:0xC60036D0  %LE %LONG 0x10001000  // ME1      
 ; D.S A:0xC60036D4  %LE %LONG 0x30303030  // ME1  PRT  RD M0 Main=3,M1 Main=3, Wr M0 Main=3, Wr M1 Main =3  
 ; D.S A:0xC60038D0  %LE %LONG 0x10001000  // SSD      
 ; D.S A:0xC60038D4  %LE %LONG 0x30303030  // SSD  PRT  RD M0 Main=3,M1 Main=3, Wr M0 Main=3, Wr M1 Main =3  
 ; D.S A:0xC6003AD0  %LE %LONG 0x10001000  // FMS      
 ; D.S A:0xC6003AD4  %LE %LONG 0x30303030  // FMS  PRT  RD M0 Main=3,M1 Main=3, Wr M0 Main=3, Wr M1 Main =3  
 ; D.S A:0xC6003CD0  %LE %LONG 0x10001000  // GSC0     
 ; D.S A:0xC6003CD4  %LE %LONG 0x30303030  // GSC  PRT  RD M0 Main=3,M1 Main=3, Wr M0 Main=3, Wr M1 Main =3  
 ; D.S A:0xC6003ED0  %LE %LONG 0x10001000  // GSC1     
 ; D.S A:0xC6003ED4  %LE %LONG 0x30303030  // GSC  PRT  RD M0 Main=3,M1 Main=3, Wr M0 Main=3, Wr M1 Main =3  
 ; D.S A:0xC60040D0  %LE %LONG 0x10001000  // DNE0     
 ; D.S A:0xC60040D4  %LE %LONG 0x30303030  // DNE  PRT  RD M0 Main=3,M1 Main=3, Wr M0 Main=3, Wr M1 Main =3  
 ; D.S A:0xC60042D0  %LE %LONG 0x10001000  // DNE1     
 ; D.S A:0xC60042D4  %LE %LONG 0x30303030  // DNE  PRT  RD M0 Main=3,M1 Main=3, Wr M0 Main=3, Wr M1 Main =3  
 ; D.S A:0xC60044D0  %LE %LONG 0x10001000  // CVD      
 ; D.S A:0xC60044D4  %LE %LONG 0x30303030  // CVD  PRT  RD M0 Main=3,M1 Main=3, Wr M0 Main=3, Wr M1 Main =3  
 ; D.S A:0xC60046D0  %LE %LONG 0x10001000  // VDO0     
 ; D.S A:0xC60046D4  %LE %LONG 0x30303030  // VDO  PRT  RD M0 Main=3,M1 Main=3, Wr M0 Main=3, Wr M1 Main =3  
 ; D.S A:0xC60048D0  %LE %LONG 0x10001000  // VDO1     
 ; D.S A:0xC60048D4  %LE %LONG 0x30303030  // VDO  PRT  RD M0 Main=3,M1 Main=3, Wr M0 Main=3, Wr M1 Main =3  
 ; D.S A:0xC6004AD0  %LE %LONG 0x10001000  // VDO2     
 ; D.S A:0xC6004AD4  %LE %LONG 0x30303030  // VDO  PRT  RD M0 Main=3,M1 Main=3, Wr M0 Main=3, Wr M1 Main =3  
 ; D.S A:0xC6004CD0  %LE %LONG 0x10001000  // VDO3     
 ; D.S A:0xC6004CD4  %LE %LONG 0x30303030  // VDO  PRT  RD M0 Main=3,M1 Main=3, Wr M0 Main=3, Wr M1 Main =3  
 ; D.S A:0xC6004ED0  %LE %LONG 0x10001000  // SMX0     
 ; D.S A:0xC6004ED4  %LE %LONG 0x30303030  // SMX  PRT  RD M0 Main=3,M1 Main=3, Wr M0 Main=3, Wr M1 Main =3  
 ; D.S A:0xC60050D0  %LE %LONG 0x10001000  // SMX1     
 ; D.S A:0xC60050D4  %LE %LONG 0x30303030  // SMX  PRT  RD M0 Main=3,M1 Main=3, Wr M0 Main=3, Wr M1 Main =3  
 ; D.S A:0xC60052D0  %LE %LONG 0x10001000  // SMX2     
 ; D.S A:0xC60052D4  %LE %LONG 0x30303030  // SMX  PRT  RD M0 Main=3,M1 Main=3, Wr M0 Main=3, Wr M1 Main =3  
 ; D.S A:0xC60054D0  %LE %LONG 0x10001000  // SMX3     
 ; D.S A:0xC60054D4  %LE %LONG 0x30303030  // SMX  PRT  RD M0 Main=3,M1 Main=3, Wr M0 Main=3, Wr M1 Main =3  
 ; D.S A:0xC600B0D0  %LE %LONG 0x10001000  // VDEC0_M0 
 ; D.S A:0xC600B0D4  %LE %LONG 0x30303030  // VDE  PRT  RD M0 Main=3,M1 Main=3, Wr M0 Main=3, Wr M1 Main =3  
 ; D.S A:0xC600B2D0  %LE %LONG 0x10001000  // VDEC0_M1 
 ; D.S A:0xC600B2D4  %LE %LONG 0x30303030  // VDE  PRT  RD M0 Main=3,M1 Main=3, Wr M0 Main=3, Wr M1 Main =3  
 ; D.S A:0xC600B4D0  %LE %LONG 0x10001000  // VDEC1_M0 
 ; D.S A:0xC600B4D4  %LE %LONG 0x30303030  // VDE  PRT  RD M0 Main=3,M1 Main=3, Wr M0 Main=3, Wr M1 Main =3  
 ; D.S A:0xC600B6D0  %LE %LONG 0x10001000  // VDEC1_M1 
 ; D.S A:0xC600B6D4  %LE %LONG 0x30303030  // VDE  PRT  RD M0 Main=3,M1 Main=3, Wr M0 Main=3, Wr M1 Main =3  
 ; D.S A:0xC600B8D0  %LE %LONG 0x10001000  // VDEC2_M0 
 ; D.S A:0xC600B8D4  %LE %LONG 0x30303030  // VDE  PRT  RD M0 Main=3,M1 Main=3, Wr M0 Main=3, Wr M1 Main =3  
 ; D.S A:0xC600BAD0  %LE %LONG 0x10001000  // VDEC2_M1 
 ; D.S A:0xC600BAD4  %LE %LONG 0x30303030  // VDE  PRT  RD M0 Main=3,M1 Main=3, Wr M0 Main=3, Wr M1 Main =3  
 ; D.S A:0xC600BCD0  %LE %LONG 0x10001000  // VDEC3_M0 
 ; D.S A:0xC600BCD4  %LE %LONG 0x30303030  // VDE  PRT  RD M0 Main=3,M1 Main=3, Wr M0 Main=3, Wr M1 Main =3  
 ; D.S A:0xC600BED0  %LE %LONG 0x10001000  // VDEC3_M1 
 ; D.S A:0xC600BED4  %LE %LONG 0x30303030  // VDE  PRT  RD M0 Main=3,M1 Main=3, Wr M0 Main=3, Wr M1 Main =3  
 ; D.S A:0xC600C0D0  %LE %LONG 0x10001000  // VDEC_MCU 
 ; D.S A:0xC600C0D4  %LE %LONG 0x30303030  // VDE  PRT  RD M0 Main=3,M1 Main=3, Wr M0 Main=3, Wr M1 Main =3  




; ;E60 ASIC BUS PRT 설정 
; D.S A:0xC98230D0 %LE %LONG 0x10001000   // GPU PRT 3/3
; D.S A:0xC98230D4 %LE %LONG 0x30303030
; D.S A:0xC98234D0 %LE %LONG 0x10001000   // TIV PRT 3/3
; D.S A:0xC98234D4 %LE %LONG 0x30303030
; D.S A:0xC98238D0 %LE %LONG 0x10001000   // WOV PRT 3/3
; D.S A:0xC98238D4 %LE %LONG 0x30303030
; D.S A:0xC9823CD0 %LE %LONG 0x10001000   // LGSR PRT 3/3
; D.S A:0xC9823CD4 %LE %LONG 0x30304040
; D.S A:0xC98240D0 %LE %LONG 0x10001000   // LNE PRT 3/3
; D.S A:0xC98240D4 %LE %LONG 0x30303030
; D.S A:0xC98244D0 %LE %LONG 0x10001000   // VDEC0_M1 PRT 3/3
; D.S A:0xC98244D4 %LE %LONG 0x30303030
; D.S A:0xC98248D0 %LE %LONG 0x10001000   // VDEC1_M1 PRT 3/3
; D.S A:0xC98248D4 %LE %LONG 0x30303030
; D.S A:0xC9824CD0 %LE %LONG 0x10001000   // VDEC2A_M1 PRT 3/3
; D.S A:0xC9824CD4 %LE %LONG 0x30303030
; D.S A:0xC98250D0 %LE %LONG 0x10001000   // VDEC2B_M1 PRT 3/3
; D.S A:0xC98250D4 %LE %LONG 0x30303030
; D.S A:0xC98254D0 %LE %LONG 0x10001000   // VDEC3A_M1 PRT 3/0
; D.S A:0xC98254D4 %LE %LONG 0x30300000
; D.S A:0xC98258D0 %LE %LONG 0x10001000   // VDEC3B_M1 PRT 3/3
; D.S A:0xC98258D4 %LE %LONG 0x30303030
; D.S A:0xC98260D0 %LE %LONG 0x10001000   // FMC0 PRT 7/7
; D.S A:0xC98260D4 %LE %LONG 0x70707070
; D.S A:0xC98264D0 %LE %LONG 0x10001000   // FMC2 PRT 7/7
; D.S A:0xC98264D4 %LE %LONG 0x70707070
; D.S A:0xC98268D0 %LE %LONG 0x10001000   // FMC4 PRT 7/7
; D.S A:0xC98268D4 %LE %LONG 0x70707070
; D.S A:0xC9826CD0 %LE %LONG 0x10001000   // FMC6 PRT 7/7
; D.S A:0xC9826CD4 %LE %LONG 0x70707070
; D.S A:0xC98270D0 %LE %LONG 0x10001000   // GSC0 PRT 7/7
; D.S A:0xC98270D4 %LE %LONG 0x70707070
; D.S A:0xC98274D0 %LE %LONG 0x10001000   // GSC2 PRT 7/7
; D.S A:0xC98274D4 %LE %LONG 0x70707070
; D.S A:0xC98278D0 %LE %LONG 0x10001000   // GSC4 PRT 7/7
; D.S A:0xC98278D4 %LE %LONG 0x70705050
; D.S A:0xC9827CD0 %LE %LONG 0x10001000   // CCO0 PRT 7/7
; D.S A:0xC9827CD4 %LE %LONG 0x70707070
; D.S A:0xC98280D0 %LE %LONG 0x10001000   // SMX0 PRT 4/4
; D.S A:0xC98280D4 %LE %LONG 0x40404040
; D.S A:0xC98284D0 %LE %LONG 0x10001000   // SMX2 PRT 4/4
; D.S A:0xC98284D4 %LE %LONG 0x40404040
; D.S A:0xC98288D0 %LE %LONG 0x10001000   // SMX4 PRT 4/4
; D.S A:0xC98288D4 %LE %LONG 0x40404040
; D.S A:0xC9828CD0 %LE %LONG 0x10001000   // SMX6 PRT 4/4
; D.S A:0xC9828CD4 %LE %LONG 0x40404040
; D.S A:0xC98278D0 %LE %LONG 0x10001000   // SRE0 PRT 5/5
; D.S A:0xC98278D4 %LE %LONG 0x70705050
; D.S A:0xC98290D0 %LE %LONG 0x10001000   // VDM0 PRT C/4
; D.S A:0xC98290D4 %LE %LONG 0xC0C04040
; D.S A:0xC98286D0 %LE %LONG 0x10001000   // VDM2 PRT C/4
; D.S A:0xC98286D4 %LE %LONG 0xC0C04040
; D.S A:0xC98294D0 %LE %LONG 0x10001000   // ND0 PRT C/5
; D.S A:0xC98294D4 %LE %LONG 0xC0C05050
; D.S A:0xC98298D0 %LE %LONG 0x10001000   // ND2 PRT C/5
; D.S A:0xC98298D4 %LE %LONG 0xC0C04040
; D.S A:0xC9829CD0 %LE %LONG 0x10001000   // SSD PRT 3/3
; D.S A:0xC9829CD4 %LE %LONG 0x30303030
; D.S A:0xC982A0D0 %LE %LONG 0x10001000   // FMS0 PRT 3/3
; D.S A:0xC982A0D4 %LE %LONG 0x30303030
; D.S A:0xC982A4D0 %LE %LONG 0x10001000   // CVD PRT 3/3
; D.S A:0xC982A4D4 %LE %LONG 0x30303030
; D.S A:0xC98232D0 %LE %LONG 0x10001000   // GFX PRT 3/3
; D.S A:0xC98232D4 %LE %LONG 0x30303030
; D.S A:0xC98236D0 %LE %LONG 0x10001000   // AUD PRT 3/3
; D.S A:0xC98236D4 %LE %LONG 0x30303030
; D.S A:0xC9823AD0 %LE %LONG 0x10001000   // DBB PRT 3/3
; D.S A:0xC9823AD4 %LE %LONG 0x30303030
; D.S A:0xC9823ED0 %LE %LONG 0x10001000   // OASR PRT 3/3
; D.S A:0xC9823ED4 %LE %LONG 0x30303030
; D.S A:0xC98242D0 %LE %LONG 0x10001000   // VDEC0_M0 PRT 3/3
; D.S A:0xC98242D4 %LE %LONG 0x30303030
; D.S A:0xC98246D0 %LE %LONG 0x10001000   // VDEC1_M0 PRT 3/3
; D.S A:0xC98246D4 %LE %LONG 0x30303030
; D.S A:0xC9824AD0 %LE %LONG 0x10001000   // VDEC2A_M0 PRT 3/3
; D.S A:0xC9824AD4 %LE %LONG 0x30303030
; D.S A:0xC9824ED0 %LE %LONG 0x10001000   // VDEC2B_M0 PRT 3/3
; D.S A:0xC9824ED4 %LE %LONG 0x30303030
; D.S A:0xC98252D0 %LE %LONG 0x10001000   // VDEC3A_M0 PRT 3/0
; D.S A:0xC98252D4 %LE %LONG 0x30300000
; D.S A:0xC98256D0 %LE %LONG 0x10001000   // VDEC3B_M0 PRT 3/3
; D.S A:0xC98256D4 %LE %LONG 0x30303030
; D.S A:0xC9825AD0 %LE %LONG 0x10001000   // MCU PRT 3/3
; D.S A:0xC9825AD4 %LE %LONG 0x30303030
; D.S A:0xC98262D0 %LE %LONG 0x10001000   // FMC1 PRT 7/7
; D.S A:0xC98262D4 %LE %LONG 0x70707070
; D.S A:0xC98266D0 %LE %LONG 0x10001000   // FMC3 PRT 7/7
; D.S A:0xC98266D4 %LE %LONG 0x70707070
; D.S A:0xC9826AD0 %LE %LONG 0x10001000   // FMC5 PRT 7/7
; D.S A:0xC9826AD4 %LE %LONG 0x70707070
; D.S A:0xC9826ED0 %LE %LONG 0x10001000   // FMC7 PRT 7/7
; D.S A:0xC9826ED4 %LE %LONG 0x70707070
; D.S A:0xC98272D0 %LE %LONG 0x10001000   // GSC1 PRT 7/7
; D.S A:0xC98272D4 %LE %LONG 0x70707070
; D.S A:0xC98276D0 %LE %LONG 0x10001000   // GSC3 PRT 7/7
; D.S A:0xC98276D4 %LE %LONG 0x70707070
; D.S A:0xC9827AD0 %LE %LONG 0x10001000   // GSC5 PRT 7/7
; D.S A:0xC9827AD4 %LE %LONG 0x70705050
; D.S A:0xC9827ED0 %LE %LONG 0x10001000   // CCO1 PRT 7/7
; D.S A:0xC9827ED4 %LE %LONG 0x70707070
; D.S A:0xC98282D0 %LE %LONG 0x10001000   // SMX1 PRT 4/4
; D.S A:0xC98282D4 %LE %LONG 0x40404040
; D.S A:0xC9823CD0 %LE %LONG 0x10001000   // SMX3 PRT 4/4
; D.S A:0xC9823CD4 %LE %LONG 0x30304040
; D.S A:0xC98298D0 %LE %LONG 0x10001000   // SMX5 PRT 4/4
; D.S A:0xC98298D4 %LE %LONG 0xC0C04040
; D.S A:0xC9828ED0 %LE %LONG 0x10001000   // SMX7 PRT 4/4
; D.S A:0xC9828ED4 %LE %LONG 0x40404040
; D.S A:0xC9827AD0 %LE %LONG 0x10001000   // SRE1 PRT 5/5
; D.S A:0xC9827AD4 %LE %LONG 0x70705050
; D.S A:0xC98292D0 %LE %LONG 0x10001000   // VDM1 PRT C/4
; D.S A:0xC98292D4 %LE %LONG 0xC0C04040
; D.S A:0xC9828AD0 %LE %LONG 0x10001000   // VDM3 PRT C/4
; D.S A:0xC9828AD4 %LE %LONG 0xC0C04040
; D.S A:0xC98296D0 %LE %LONG 0x10001000   // ND1 PRT C/5
; D.S A:0xC98296D4 %LE %LONG 0xC0C05050
; D.S A:0xC9829AD0 %LE %LONG 0x10001000   // ME0 PRT 3/3
; D.S A:0xC9829AD4 %LE %LONG 0x30303030
; D.S A:0xC9829ED0 %LE %LONG 0x10001000   // ME1 PRT 3/3
; D.S A:0xC9829ED4 %LE %LONG 0x30303030
; D.S A:0xC982A2D0 %LE %LONG 0x10001000   // FMS1 PRT 3/3
; D.S A:0xC982A2D4 %LE %LONG 0x30303030
; D.S A:0xC982A6D0 %LE %LONG 0x10001000   // OBD PRT 3/3
; D.S A:0xC982A6D4 %LE %LONG 0x30303030
;;;;;;;;;;;;;;;;;;;;;;;;;;;;;;;;;;;;;;;;;;;;;;;;;;;;;;;
;; Generating LIMITER CMM by BUS_PMT
;; Generating Time : 2024-10-17 17:52:04
;; Project : O26
;;;;;;;;;;;;;;;;;;;;;;;;;;;;;;;;;;;;;;;;;;;;;;;;;;;;;;;
;; FPGA limiter setting not for ASIC
;;;CPU_M0
;;D.S ASD:0xCA202C04 %LONG 0x000019DC		;;Time(us)
;;D.S ASD:0xCA202C3C %LONG 0x10007530		;;FIRST LIMITER READ_BW(MB)
;;D.S ASD:0xCA202C40 %LONG 0x10007530		;;FIRST LIMITER WRITE_BW(MB)
;;
;;;CPU_M1
;;D.S ASD:0xCA203004 %LONG 0x000019DC		;;Time(us)
;;D.S ASD:0xCA20303C %LONG 0x10007530		;;FIRST LIMITER READ_BW(MB)
;;D.S ASD:0xCA203040 %LONG 0x10007530		;;FIRST LIMITER WRITE_BW(MB)
;;
;;;GPU0
;;D.S ASD:0xC4208418 %LONG 0x000012C0		;;Time(us)
;;D.S ASD:0xC4208478 %LONG 0x30007530		;;FIRST LIMITER READ_BW(MB)
;;D.S ASD:0xC420847C %LONG 0x30007530		;;FIRST LIMITER WRITE_BW(MB)
;;
;;;GPU1
;;D.S ASD:0xC4208818 %LONG 0x000012C0		;;Time(us)
;;D.S ASD:0xC4208878 %LONG 0x30007530		;;FIRST LIMITER READ_BW(MB)
;;D.S ASD:0xC420887C %LONG 0x30007530		;;FIRST LIMITER WRITE_BW(MB)
;;
;;;AUD
;;D.S ASD:0xC4210C18 %LONG 0x000012C0		;;Time(us)
;;D.S ASD:0xC4210C78 %LONG 0x10002328		;;FIRST LIMITER READ_BW(MB)
;;
;;;LNX0
;;D.S ASD:0xC4211418 %LONG 0x000012C0		;;Time(us)
;;D.S ASD:0xC4211478 %LONG 0x30007530		;;FIRST LIMITER READ_BW(MB)
;;D.S ASD:0xC421147C %LONG 0x30007530		;;FIRST LIMITER WRITE_BW(MB)
;;
;;
;; clock gating configuration for the power saving
;; see http://jira.lge.com/issue/browse/SICDTV-15841
;; and see http://jira.lge.com/issue/browse/SCDCR-7887
;; 0xCA3A2010 0x00FFFFFF
;; 0xCA3A2014 0x000000E7
;; 0xCA3A2018 0x00000180
;; 0xCA3A201C 0x00003160
;;
D.S ASD:0xCA3A2010 %LONG 0x00FFFFFF
D.S ASD:0xCA3A2014 %LONG 0x000000E7
D.S ASD:0xCA3A2018 %LONG 0x00000180
D.S ASD:0xCA3A201C %LONG 0x00003160

;; C4TX down
;; see http://jira.lge.com/issue/browse/SCDCR-7887
D.S ASD:0xCC974024 %LONG 0x00000000

;; ADMD(analog demod to tuner) down
;; see http://jira.lge.com/issue/browse/SICDTV-15841
D.S ASD:0xCC4C40B0 %LONG 0x0000387B
D.S ASD:0xC8A35000 %LONG 0x02900C80
D.S ASD:0xC8A35004 %LONG 0x145A105E
D.S ASD:0xC8A35008 %LONG 0x350B011A
D.S ASD:0xC8A3500C %LONG 0x64310A32
