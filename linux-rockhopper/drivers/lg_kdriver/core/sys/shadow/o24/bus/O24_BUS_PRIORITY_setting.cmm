;;;;;;;;;;;;;;;;;;;;;;;;;;;;;;;;;;;;;;;;;;;;;;;;;;;;;;;
;; Generating PRIORITY CMM by BUS_PMT
;; Generating Time : 2021-11-11 09:31:04
;; Project : O24
;;;;;;;;;;;;;;;;;;;;;;;;;;;;;;;;;;;;;;;;;;;;;;;;;;;;;;;

;GPU0
D.S ASD:0xC40F10D0 %LONG 0x10001000		;;MODE
D.S ASD:0xC40F10D4 %LONG 0x30303030		;;M0/M1
D.S ASD:0xC40F11D4 %LONG 0x30003000		;;M2

;GPU1
D.S ASD:0xC40F12D0 %LONG 0x10001000		;;MODE
D.S ASD:0xC40F12D4 %LONG 0x30303030		;;M0/M1
D.S ASD:0xC40F13D4 %LONG 0x30003000		;;M2

;GFX
D.S ASD:0xC40F14D0 %LONG 0x10001000		;;MODE
D.S ASD:0xC40F14D4 %LONG 0x30303030		;;M0/M1
D.S ASD:0xC40F15D4 %LONG 0x30003000		;;M2

;LOWBW
D.S ASD:0xC40F16D0 %LONG 0x10001000		;;MODE
D.S ASD:0xC40F16D4 %LONG 0x30303030		;;M0/M1
D.S ASD:0xC40F17D4 %LONG 0x30003000		;;M2

;ICVENC
D.S ASD:0xC40F18D0 %LONG 0x10001000		;;MODE
D.S ASD:0xC40F18D4 %LONG 0x30303030		;;M0/M1
D.S ASD:0xC40F19D4 %LONG 0x30003000		;;M2

;MEFMS
D.S ASD:0xC40F1AD0 %LONG 0x10001000		;;MODE
D.S ASD:0xC40F1AD4 %LONG 0x30303030		;;M0/M1
D.S ASD:0xC40F1BD4 %LONG 0x30003000		;;M2

;FMGSSR0
D.S ASD:0xC40F1CD0 %LONG 0x10001000		;;MODE
D.S ASD:0xC40F1CD4 %LONG 0xF0F03030		;;M0/M1
D.S ASD:0xC40F1DD4 %LONG 0xF0003000		;;M2

;FMGSSR1
D.S ASD:0xC40F1ED0 %LONG 0x10001000		;;MODE
D.S ASD:0xC40F1ED4 %LONG 0xF0F03030		;;M0/M1
D.S ASD:0xC40F1FD4 %LONG 0xF0003000		;;M2

;FMGSSR2
D.S ASD:0xC40F20D0 %LONG 0x10001000		;;MODE
D.S ASD:0xC40F20D4 %LONG 0xF0F03030		;;M0/M1
D.S ASD:0xC40F21D4 %LONG 0xF0003000		;;M2

;FMGSSR3
D.S ASD:0xC40F22D0 %LONG 0x10001000		;;MODE
D.S ASD:0xC40F22D4 %LONG 0xF0F03030		;;M0/M1
D.S ASD:0xC40F23D4 %LONG 0xF0003000		;;M2

;FMGSSR4
D.S ASD:0xC40F24D0 %LONG 0x10001000		;;MODE
D.S ASD:0xC40F24D4 %LONG 0xF0F03030		;;M0/M1
D.S ASD:0xC40F25D4 %LONG 0xF0003000		;;M2

;CCO0
D.S ASD:0xC40F26D0 %LONG 0x10001000		;;MODE
D.S ASD:0xC40F26D4 %LONG 0x30303030		;;M0/M1
D.S ASD:0xC40F27D4 %LONG 0x30003000		;;M2

;CCO1
D.S ASD:0xC40F28D0 %LONG 0x10001000		;;MODE
D.S ASD:0xC40F28D4 %LONG 0x30303030		;;M0/M1
D.S ASD:0xC40F29D4 %LONG 0x30003000		;;M2

;ND0
D.S ASD:0xC40F2AD0 %LONG 0x10001000		;;MODE
D.S ASD:0xC40F2AD4 %LONG 0x30303030		;;M0/M1
D.S ASD:0xC40F2BD4 %LONG 0x30003000		;;M2

;ND1
D.S ASD:0xC40F2CD0 %LONG 0x10001000		;;MODE
D.S ASD:0xC40F2CD4 %LONG 0x30303030		;;M0/M1
D.S ASD:0xC40F2DD4 %LONG 0x30003000		;;M2

;VDOIMXW0
D.S ASD:0xC40F2ED0 %LONG 0x10001000		;;MODE
D.S ASD:0xC40F2ED4 %LONG 0x3030F0F0		;;M0/M1
D.S ASD:0xC40F2FD4 %LONG 0x3000F000		;;M2

;VDOIMXW1
D.S ASD:0xC40F30D0 %LONG 0x10001000		;;MODE
D.S ASD:0xC40F30D4 %LONG 0x3030F0F0		;;M0/M1
D.S ASD:0xC40F31D4 %LONG 0x3000F000		;;M2

;VDOIMXW2
D.S ASD:0xC40F32D0 %LONG 0x10001000		;;MODE
D.S ASD:0xC40F32D4 %LONG 0x3030F0F0		;;M0/M1
D.S ASD:0xC40F33D4 %LONG 0x3000F000		;;M2

;VDOIMXW3
D.S ASD:0xC40F34D0 %LONG 0x10001000		;;MODE
D.S ASD:0xC40F34D4 %LONG 0x3030F0F0		;;M0/M1
D.S ASD:0xC40F35D4 %LONG 0x3000F000		;;M2

;IMXR01
D.S ASD:0xC40F36D0 %LONG 0x10001000		;;MODE
D.S ASD:0xC40F36D4 %LONG 0x30303030		;;M0/M1
D.S ASD:0xC40F37D4 %LONG 0x30003000		;;M2

;IMXR23
D.S ASD:0xC40F38D0 %LONG 0x10001000		;;MODE
D.S ASD:0xC40F38D4 %LONG 0x30303030		;;M0/M1
D.S ASD:0xC40F39D4 %LONG 0x30003000		;;M2

;TCON
D.S ASD:0xC40F3AD0 %LONG 0x10001000		;;MODE
D.S ASD:0xC40F3AD4 %LONG 0x30303030		;;M0/M1
D.S ASD:0xC40F3BD4 %LONG 0x30003000		;;M2

;AUD
D.S ASD:0xC40F3CD0 %LONG 0x10001000		;;MODE
D.S ASD:0xC40F3CD4 %LONG 0x30303030		;;M0/M1
D.S ASD:0xC40F3DD4 %LONG 0x30003000		;;M2

;LNX0
D.S ASD:0xC40F3ED0 %LONG 0x10001000		;;MODE
D.S ASD:0xC40F3ED4 %LONG 0x30303030		;;M0/M1
D.S ASD:0xC40F3FD4 %LONG 0x30003000		;;M2

;LNX1
D.S ASD:0xC40F40D0 %LONG 0x10001000		;;MODE
D.S ASD:0xC40F40D4 %LONG 0x30303030		;;M0/M1
D.S ASD:0xC40F41D4 %LONG 0x30003000		;;M2

;LNX2
D.S ASD:0xC40F42D0 %LONG 0x10001000		;;MODE
D.S ASD:0xC40F42D4 %LONG 0x30303030		;;M0/M1
D.S ASD:0xC40F43D4 %LONG 0x30003000		;;M2

;VD0A
D.S ASD:0xC40F44D0 %LONG 0x10001000		;;MODE
D.S ASD:0xC40F44D4 %LONG 0x30303030		;;M0/M1
D.S ASD:0xC40F45D4 %LONG 0x30003000		;;M2

;VD0B
D.S ASD:0xC40F46D0 %LONG 0x10001000		;;MODE
D.S ASD:0xC40F46D4 %LONG 0x30303030		;;M0/M1
D.S ASD:0xC40F47D4 %LONG 0x30003000		;;M2

;VD1A
D.S ASD:0xC40F48D0 %LONG 0x10001000		;;MODE
D.S ASD:0xC40F48D4 %LONG 0x30303030		;;M0/M1
D.S ASD:0xC40F49D4 %LONG 0x30003000		;;M2

;VD1B
D.S ASD:0xC40F4AD0 %LONG 0x10001000		;;MODE
D.S ASD:0xC40F4AD4 %LONG 0x30303030		;;M0/M1
D.S ASD:0xC40F4BD4 %LONG 0x30003000		;;M2

;VD2VMCU
D.S ASD:0xC40F4CD0 %LONG 0x10001000		;;MODE
D.S ASD:0xC40F4CD4 %LONG 0x30303030		;;M0/M1
D.S ASD:0xC40F4DD4 %LONG 0x30003000		;;M2

;VD2B
D.S ASD:0xC40F4ED0 %LONG 0x10001000		;;MODE
D.S ASD:0xC40F4ED4 %LONG 0x30303030		;;M0/M1
D.S ASD:0xC40F4FD4 %LONG 0x30003000		;;M2

;CPU_CORE
;D.S ASD:0xCA2010D0 %LONG 0x00000000		;;MODE
D.S ASD:0xCA2010D4 %LONG 0xC0C0C0C0		;;M0/M1
D.S ASD:0xCA2011D4 %LONG 0xC000C000		;;M2

;PERI_AXI
D.S ASD:0xCA2000D0 %LONG 0x10001000		;;MODE
D.S ASD:0xCA2000D4 %LONG 0x30303030		;;M0/M1
D.S ASD:0xCA2001D4 %LONG 0x30003000		;;M2

;PERI_AHB
D.S ASD:0xCA2020D0 %LONG 0x10001000		;;MODE
D.S ASD:0xCA2020D4 %LONG 0x30303030		;;M0/M1
D.S ASD:0xCA2021D4 %LONG 0x30003000		;;M2

;LZMA
D.S ASD:0xCA2012D0 %LONG 0x10001000		;;MODE
D.S ASD:0xCA2012D4 %LONG 0x30303030		;;M0/M1
D.S ASD:0xCA2013D4 %LONG 0x30003000		;;M2

;CPU_FAST
D.S ASD:0xCA2014D0 %LONG 0x10001000		;;MODE
D.S ASD:0xCA2014D4 %LONG 0xC0C0C0C0		;;M0/M1
D.S ASD:0xCA2015D4 %LONG 0xC000C000		;;M2

;;;;;;;;;;;;;;;;;;;;;;;;;;;;;;;;;;;;;;;;;;;;;;;;;;;;;;;
;; Generating SUBPRIORITY CMM by BUS_PMT
;; Generating Time : 2022-12-14 11:12:58
;; Project : O24
;;;;;;;;;;;;;;;;;;;;;;;;;;;;;;;;;;;;;;;;;;;;;;;;;;;;;;;
;; 12	s0 aruser sel	0x0	"ArUser 신호의 control mode 설정
;;                                 - 1'b0 : bypass
;;                                 - 1'b1 : 외부에서 들어오는 User signal 을 차단하고 rf_uc_user_R_s*  
;;                                    register 에 설정한 값으로 대체"
;; 11:9	reserved0		
;; 8	s0 awuser sel	0x0	"AwUser 신호의 control mode 설정
;;                                 - 1'b0 : bypass
;;                                 - 1'b1 : 외부에서 들어오는 User signal 을 차단하고 rf_uc_user_W_s*  
;;                                    register 에 설정한 값으로 대체"
;; 7:4	s0_aruser	0x3	Read, ArUser 신호를 대체할 값 User값
;; 3:0	s0 awuser	0x3	Write, AwUser 신호를 대체할 값 User값


;LOWBW0_CVI
D.S ASD:0xCCDE10D0 %LONG 0x00000033		;;MODE|PVALUE

;LOWBW0_HDMI
D.S ASD:0xCCDE10D4 %LONG 0x00000033		;;MODE|PVALUE

;LOWBW0_TE
D.S ASD:0xCCDE10D8 %LONG 0x00000033		;;MODE|PVALUE

;LOWBW0_DBB
D.S ASD:0xCCDE10DC %LONG 0x00000000		;;MODE|PVALUE

;LOWBW1_DNSR
D.S ASD:0xCC5510D0 %LONG 0x00000033		;;MODE|PVALUE

;LOWBW1_DNNR
D.S ASD:0xCC5510D4 %LONG 0x00000033		;;MODE|PVALUE

;LOWBW1_PMCU
D.S ASD:0xCC5510D8 %LONG 0x00000000		;;MODE|PVALUE

;MEFMS_ME0A
D.S ASD:0xCC9A20D0 %LONG 0x00000033		;;MODE|PVALUE

;MEFMS_ME0B
D.S ASD:0xCC9A20D4 %LONG 0x00000033		;;MODE|PVALUE

;MEFMS_ME1
D.S ASD:0xCC9A20D8 %LONG 0x00000033		;;MODE|PVALUE

;MEFMS_FMS
D.S ASD:0xCC9A20DC %LONG 0x00000033		;;MODE|PVALUE

;FMGSSR_FMC0
D.S ASD:0xCC5310D0 %LONG 0x00000033		;;MODE|PVALUE

;FMGSSR_FMC1
D.S ASD:0xCC5310D4 %LONG 0x00000033		;;MODE|PVALUE

;FMGSSR_FMC2
D.S ASD:0xCC5310D8 %LONG 0x00000033		;;MODE|PVALUE

;FMGSSR_FMC3
D.S ASD:0xCC5310DC %LONG 0x00000033		;;MODE|PVALUE

;FMGSSR_GSC0
D.S ASD:0xCC5310E0 %LONG 0x00000033		;;MODE|PVALUE

;FMGSSR_GSC1
D.S ASD:0xCC5310E4 %LONG 0x00000033		;;MODE|PVALUE

;FMGSSR_SRE0
D.S ASD:0xCC5310E8 %LONG 0x00000033		;;MODE|PVALUE

;FMGSSR_SRE1
D.S ASD:0xCC5310EC %LONG 0x00000000		;;MODE|PVALUE

;IMXR01_R0
D.S ASD:0xCC9820D0 %LONG 0x00000033		;;MODE|PVALUE

;IMXR01_R1
D.S ASD:0xCC9820D4 %LONG 0x00000033		;;MODE|PVALUE

;IMXR23_R2
D.S ASD:0xCC9850D0 %LONG 0x00000033		;;MODE|PVALUE

;IMXR23_R3
D.S ASD:0xCC9850D4 %LONG 0x00000033		;;MODE|PVALUE

;VMCUVDEC_VMCU
D.S ASD:0xCECE10D0 %LONG 0x00000033		;;MODE|PVALUE

;VMCUVDEC_VDEC
D.S ASD:0xCECE10D4 %LONG 0x00000000		;;MODE|PVALUE


;; ;;;;;;;;;;;;;;;;;;;;;;;;;;;;;;;;;;;;;;;;;;;;;;;;;;;
;; ;M23 FPGA BUS PRIORITY reference 
;; ;;;;;;;;;;;;;;;;;;;;;;;;;;;;;;;;;;;;;;;;;;;;;;;;;;;;
;; ;211111 bus pmt default file
;; 
;; ;GPU
;; D.S ASD:0xC45030D0 %LONG 0x00000000		;;MODE
;; D.S ASD:0xC45030D4 %LONG 0x30003000		;;M0/M1   //PRT  RD M0 Main=3, Wr M0 Main=3  
;; 
;; ;GFX
;; D.S ASD:0xC45032D0 %LONG 0x00000000		;;MODE
;; D.S ASD:0xC45032D4 %LONG 0x30003000		;;M0/M1   //PRT  RD M0 Main=3, Wr M0 Main=3
;; 
;; ;TIV
;; D.S ASD:0xC45034D0 %LONG 0x00000000		;;MODE
;; D.S ASD:0xC45034D4 %LONG 0x30003000		;;M0/M1   //PRT  RD M0 Main=3, Wr M0 Main=3
;; 
;; ;DBB
;; D.S ASD:0xC45036D0 %LONG 0x00000000		;;MODE
;; D.S ASD:0xC45036D4 %LONG 0x30003000		;;M0/M1   //PRT  RD M0 Main=3, Wr M0 Main=3
;; 
;; ;TCON
;; D.S ASD:0xC45038D0 %LONG 0x00000000		;;MODE
;; D.S ASD:0xC45038D4 %LONG 0x30003000		;;M0/M1   //PRT  RD M0 Main=3, Wr M0 Main=3
;; 
;; ;LNE
;; D.S ASD:0xC4503AD0 %LONG 0x00000000		;;MODE
;; D.S ASD:0xC4503AD4 %LONG 0x30003000		;;M0/M1   //PRT  RD M0 Main=3, Wr M0 Main=3
;; 
;; ;PQE_MCU
;; D.S ASD:0xC4503CD0 %LONG 0x00000000		;;MODE
;; D.S ASD:0xC4503CD4 %LONG 0x30003000		;;M0/M1   //PRT  RD M0 Main=3, Wr M0 Main=3
;; 
;; ;FMC0
;; D.S ASD:0xC4503ED0 %LONG 0x00000000		;;MODE
;; D.S ASD:0xC4503ED4 %LONG 0x30003000		;;M0/M1   //PRT  RD M0 Main=3, Wr M0 Main=3
;; 
;; ;FMC1
;; D.S ASD:0xC45040D0 %LONG 0x00000000		;;MODE
;; D.S ASD:0xC45040D4 %LONG 0x30003000		;;M0/M1   //PRT  RD M0 Main=3, Wr M0 Main=3
;; 
;; ;CCO0
;; D.S ASD:0xC45042D0 %LONG 0x00000000		;;MODE
;; D.S ASD:0xC45042D4 %LONG 0x30003000		;;M0/M1   //PRT  RD M0 Main=3, Wr M0 Main=3
;; 
;; ;SRE
;; D.S ASD:0xC45044D0 %LONG 0x00000000		;;MODE
;; D.S ASD:0xC45044D4 %LONG 0x30003000		;;M0/M1   //PRT  RD M0 Main=3, Wr M0 Main=3
;; 
;; ;ND0
;; D.S ASD:0xC45046D0 %LONG 0x00000000		;;MODE
;; D.S ASD:0xC45046D4 %LONG 0x30003000		;;M0/M1   //PRT  RD M0 Main=3, Wr M0 Main=3
;; 
;; ;ME0
;; D.S ASD:0xC45048D0 %LONG 0x00000000		;;MODE
;; D.S ASD:0xC45048D4 %LONG 0x30003000		;;M0/M1   //PRT  RD M0 Main=3, Wr M0 Main=3
;; 
;; ;FMS
;; D.S ASD:0xC4504AD0 %LONG 0x00000000		;;MODE
;; D.S ASD:0xC4504AD4 %LONG 0x30003000		;;M0/M1   //PRT  RD M0 Main=3, Wr M0 Main=3
;; 
;; ;CVD
;; D.S ASD:0xC4504CD0 %LONG 0x00000000		;;MODE
;; D.S ASD:0xC4504CD4 %LONG 0x30003000		;;M0/M1   //PRT  RD M0 Main=3, Wr M0 Main=3
;; 
;; ;VDO0
;; D.S ASD:0xC4504ED0 %LONG 0x00000000		;;MODE
;; D.S ASD:0xC4504ED4 %LONG 0x30003000		;;M0/M1   //PRT  RD M0 Main=3, Wr M0 Main=3
;; 
;; ;VDO1
;; D.S ASD:0xC45050D0 %LONG 0x00000000		;;MODE
;; D.S ASD:0xC45050D4 %LONG 0x30003000		;;M0/M1   //PRT  RD M0 Main=3, Wr M0 Main=3
;; 
;; ;SMX0
;; D.S ASD:0xC45052D0 %LONG 0x00000000		;;MODE
;; D.S ASD:0xC45052D4 %LONG 0x30003000		;;M0/M1   //PRT  RD M0 Main=3, Wr M0 Main=3
;; 
;; ;SMX1
;; D.S ASD:0xC45054D0 %LONG 0x00000000		;;MODE
;; D.S ASD:0xC45054D4 %LONG 0x30003000		;;M0/M1   //PRT  RD M0 Main=3, Wr M0 Main=3
;; 
;; ;DNE0
;; D.S ASD:0xC45056D0 %LONG 0x00000000		;;MODE
;; D.S ASD:0xC45056D4 %LONG 0x30003000		;;M0/M1   //PRT  RD M0 Main=3, Wr M0 Main=3
;; 
;; ;AUD0
;; D.S ASD:0xC45058D0 %LONG 0x00000000		;;MODE
;; D.S ASD:0xC45058D4 %LONG 0x30003000		;;M0/M1   //PRT  RD M0 Main=3, Wr M0 Main=3
;; 
;; ;AUD1
;; D.S ASD:0xC4505AD0 %LONG 0x00000000		;;MODE
;; D.S ASD:0xC4505AD4 %LONG 0x30003000		;;M0/M1   //PRT  RD M0 Main=3, Wr M0 Main=3
;; 
;; ;VDEC0_M0
;; D.S ASD:0xC4505CD0 %LONG 0x00000000		;;MODE
;; D.S ASD:0xC4505CD4 %LONG 0x30003000		;;M0/M1   //PRT  RD M0 Main=3, Wr M0 Main=3
;; 
;; ;VDEC0_M1
;; D.S ASD:0xC4505ED0 %LONG 0x00000000		;;MODE
;; D.S ASD:0xC4505ED4 %LONG 0x30003000		;;M0/M1   //PRT  RD M0 Main=3, Wr M0 Main=3
;; 
;; ;VDEC1_M0
;; D.S ASD:0xC45060D0 %LONG 0x00000000		;;MODE
;; D.S ASD:0xC45060D4 %LONG 0x30003000		;;M0/M1   //PRT  RD M0 Main=3, Wr M0 Main=3
;; 
;; ;VDEC1_M1
;; D.S ASD:0xC45062D0 %LONG 0x00000000		;;MODE
;; D.S ASD:0xC45062D4 %LONG 0x30003000		;;M0/M1   //PRT  RD M0 Main=3, Wr M0 Main=3
;; 
;; ;VDEC_MCU
;; D.S ASD:0xC45064D0 %LONG 0x00000000		;;MODE
;; D.S ASD:0xC45064D4 %LONG 0x30003000		;;M0/M1   //PRT  RD M0 Main=3, Wr M0 Main=3
;; 
;; ;CPU_CORE
;; D.S ASD:0xCA2010D0 %LONG 0x00000000		;;MODE
;; D.S ASD:0xCA2010D4 %LONG 0xD000D000		;;M0/M1   //PRT  RD M0 Main=D, Wr M0 Main=D
;; 
;; ;PERI_AXI
;; D.S ASD:0xCA2002D0 %LONG 0x00000000		;;MODE
;; D.S ASD:0xCA2002D4 %LONG 0x30003000		;;M0/M1   //PRT  RD M0 Main=3, Wr M0 Main=3
;; 
;; ;PERI_AHB
;; D.S ASD:0xCA2004D0 %LONG 0x00000000		;;MODE
;; D.S ASD:0xCA2004D4 %LONG 0x30003000		;;M0/M1   //PRT  RD M0 Main=3, Wr M0 Main=3
;; 
;; ;LZMA
;; D.S ASD:0xCA2012D0 %LONG 0x00000000		;;MODE
;; D.S ASD:0xCA2012D4 %LONG 0x30003000		;;M0/M1   //PRT  RD M0 Main=3, Wr M0 Main=3
;; 
;; ;CPU_FAST
;; D.S ASD:0xCA2014D0 %LONG 0x00000000		;;MODE
;; D.S ASD:0xCA2014D4 %LONG 0xD000D000		;;M0/M1   //PRT  RD M0 Main=D, Wr M0 Main=D





;O22 FPGA BUS PRIORITY 설정 
;201123 Hoon.Oh

;CPU 추가//jungdb
;CPU new priority value -> Occurs EMMC related fail.  This  must be tested @ASIC chip, expecting no error!!
;D.S A:0xCAA010D0  %LE %LONG 0x10001000  // CPU  [28]Rd BUS register/ [12]Wr BUS register
;D.S A:0xCAA010D4  %LE %LONG 0x30303030  // CPU  PRT  RD M0 Main=3,M1 Main=3, Wr M0 Main=3, Wr M1 Main =3

;CPU default vuale -> works well
;D.S A:0xCAA010D0  %LE %LONG 0x003F003F  // CPU  [28]Rd BUS register/ [12]Wr BUS register
;D.S A:0xCAA010D4  %LE %LONG 0x35353535  // CPU  PRT  RD M0 Main=3,M1 Main=3, Wr M0 Main=3, Wr M1 Main =3

 ; ;IP
 ; D.S A:0xC60010D0  %LE %LONG 0x10001000  // GPU  
 ; D.S A:0xC60010D4  %LE %LONG 0x30303030  // GPU  PRT  RD M0 Main=3,M1 Main=3, Wr M0 Main=3, Wr M1 Main =3  
 ; D.S A:0xC60012D0  %LE %LONG 0x10001000  // GFX  
 ; D.S A:0xC60012D4  %LE %LONG 0x30303030  // GFX  PRT  RD M0 Main=3,M1 Main=3, Wr M0 Main=3, Wr M1 Main =3  
 ; 
 ; D.S A:0xC60014D0  %LE %LONG 0x10001000  // TIV_venc 
 ; D.S A:0xC60014D4  %LE %LONG 0x30303030  // TIV  PRT  RD M0 Main=3,M1 Main=3, Wr M0 Main=3, Wr M1 Main =3  
 ; ;D.S A:0xC60014B0  %LE %LONG 0x10001000  // TIV_icod 
 ; D.S A:0xC60014D8  %LE %LONG 0x30303030  // TIV  PRT  RD M0 Main=3,M1 Main=3, Wr M0 Main=3, Wr M1 Main =3  
 ; ;D.S A:0xC60014B4  %LE %LONG 0x10001000  // TIV_te   
 ; D.S A:0xC60014DC  %LE %LONG 0x30303030  // TIV  PRT  RD M0 Main=3,M1 Main=3, Wr M0 Main=3, Wr M1 Main =3  
 ; 
 ; D.S A:0xC600C2D0  %LE %LONG 0x10001000  // AUD0     
 ; D.S A:0xC600C2D4  %LE %LONG 0x30303030  // AUD  PRT  RD M0 Main=3,M1 Main=3, Wr M0 Main=3, Wr M1 Main =3  
 ; D.S A:0xC600C4D0  %LE %LONG 0x10001000  // AUD1     
 ; D.S A:0xC600C4D4  %LE %LONG 0x30303030  // AUD  PRT  RD M0 Main=3,M1 Main=3, Wr M0 Main=3, Wr M1 Main =3  
 ; D.S A:0xC6001AD0  %LE %LONG 0x10001000  // DBB      
 ; D.S A:0xC6001AD4  %LE %LONG 0x30303030  // DBB  PRT  RD M0 Main=3,M1 Main=3, Wr M0 Main=3, Wr M1 Main =3  
 ; D.S A:0xC6001CD0  %LE %LONG 0x10001000  // SRNR     
 ; D.S A:0xC6001CD4  %LE %LONG 0x30303030  // SRN  PRT  RD M0 Main=3,M1 Main=3, Wr M0 Main=3, Wr M1 Main =3  
 ; D.S A:0xC6001ED0  %LE %LONG 0x10001000  // LNE      
 ; D.S A:0xC6001ED4  %LE %LONG 0x30303030  // LNE  PRT  RD M0 Main=3,M1 Main=3, Wr M0 Main=3, Wr M1 Main =3  
 ; D.S A:0xC60020D0  %LE %LONG 0x10001000  // PQE_MCU  
 ; D.S A:0xC60020D4  %LE %LONG 0x30303030  // PQE  PRT  RD M0 Main=3,M1 Main=3, Wr M0 Main=3, Wr M1 Main =3  
 ; D.S A:0xC60022D0  %LE %LONG 0x10001000  // FMC0     
 ; D.S A:0xC60022D4  %LE %LONG 0x30303030  // FMC  PRT  RD M0 Main=3,M1 Main=3, Wr M0 Main=3, Wr M1 Main =3  
 ; D.S A:0xC60024D0  %LE %LONG 0x10001000  // FMC1     
 ; D.S A:0xC60024D4  %LE %LONG 0x30303030  // FMC  PRT  RD M0 Main=3,M1 Main=3, Wr M0 Main=3, Wr M1 Main =3  
 ; D.S A:0xC60026D0  %LE %LONG 0x10001000  // FMC2     
 ; D.S A:0xC60026D4  %LE %LONG 0x30303030  // FMC  PRT  RD M0 Main=3,M1 Main=3, Wr M0 Main=3, Wr M1 Main =3  
 ; D.S A:0xC60028D0  %LE %LONG 0x10001000  // FMC3     
 ; D.S A:0xC60028D4  %LE %LONG 0x30303030  // FMC  PRT  RD M0 Main=3,M1 Main=3, Wr M0 Main=3, Wr M1 Main =3  
 ; D.S A:0xC6002AD0  %LE %LONG 0x10001000  // CCO0     
 ; D.S A:0xC6002AD4  %LE %LONG 0x30303030  // CCO  PRT  RD M0 Main=3,M1 Main=3, Wr M0 Main=3, Wr M1 Main =3  
 ; D.S A:0xC6002CD0  %LE %LONG 0x10001000  // CCO1     
 ; D.S A:0xC6002CD4  %LE %LONG 0x30303030  // CCO  PRT  RD M0 Main=3,M1 Main=3, Wr M0 Main=3, Wr M1 Main =3  
 ; D.S A:0xC6002ED0  %LE %LONG 0x10001000  // SRE      
 ; D.S A:0xC6002ED4  %LE %LONG 0x30303030  // SRE  PRT  RD M0 Main=3,M1 Main=3, Wr M0 Main=3, Wr M1 Main =3  
 ; D.S A:0xC60030D0  %LE %LONG 0x10001000  // ND0      
 ; D.S A:0xC60030D4  %LE %LONG 0x30303030  // ND0  PRT  RD M0 Main=3,M1 Main=3, Wr M0 Main=3, Wr M1 Main =3  
 ; D.S A:0xC60032D0  %LE %LONG 0x10001000  // ND1      
 ; D.S A:0xC60032D4  %LE %LONG 0x30303030  // ND1  PRT  RD M0 Main=3,M1 Main=3, Wr M0 Main=3, Wr M1 Main =3  
 ; D.S A:0xC60034D0  %LE %LONG 0x10001000  // ME0      
 ; D.S A:0xC60034D4  %LE %LONG 0x30303030  // ME0  PRT  RD M0 Main=3,M1 Main=3, Wr M0 Main=3, Wr M1 Main =3  
 ; D.S A:0xC60036D0  %LE %LONG 0x10001000  // ME1      
 ; D.S A:0xC60036D4  %LE %LONG 0x30303030  // ME1  PRT  RD M0 Main=3,M1 Main=3, Wr M0 Main=3, Wr M1 Main =3  
 ; D.S A:0xC60038D0  %LE %LONG 0x10001000  // SSD      
 ; D.S A:0xC60038D4  %LE %LONG 0x30303030  // SSD  PRT  RD M0 Main=3,M1 Main=3, Wr M0 Main=3, Wr M1 Main =3  
 ; D.S A:0xC6003AD0  %LE %LONG 0x10001000  // FMS      
 ; D.S A:0xC6003AD4  %LE %LONG 0x30303030  // FMS  PRT  RD M0 Main=3,M1 Main=3, Wr M0 Main=3, Wr M1 Main =3  
 ; D.S A:0xC6003CD0  %LE %LONG 0x10001000  // GSC0     
 ; D.S A:0xC6003CD4  %LE %LONG 0x30303030  // GSC  PRT  RD M0 Main=3,M1 Main=3, Wr M0 Main=3, Wr M1 Main =3  
 ; D.S A:0xC6003ED0  %LE %LONG 0x10001000  // GSC1     
 ; D.S A:0xC6003ED4  %LE %LONG 0x30303030  // GSC  PRT  RD M0 Main=3,M1 Main=3, Wr M0 Main=3, Wr M1 Main =3  
 ; D.S A:0xC60040D0  %LE %LONG 0x10001000  // DNE0     
 ; D.S A:0xC60040D4  %LE %LONG 0x30303030  // DNE  PRT  RD M0 Main=3,M1 Main=3, Wr M0 Main=3, Wr M1 Main =3  
 ; D.S A:0xC60042D0  %LE %LONG 0x10001000  // DNE1     
 ; D.S A:0xC60042D4  %LE %LONG 0x30303030  // DNE  PRT  RD M0 Main=3,M1 Main=3, Wr M0 Main=3, Wr M1 Main =3  
 ; D.S A:0xC60044D0  %LE %LONG 0x10001000  // CVD      
 ; D.S A:0xC60044D4  %LE %LONG 0x30303030  // CVD  PRT  RD M0 Main=3,M1 Main=3, Wr M0 Main=3, Wr M1 Main =3  
 ; D.S A:0xC60046D0  %LE %LONG 0x10001000  // VDO0     
 ; D.S A:0xC60046D4  %LE %LONG 0x30303030  // VDO  PRT  RD M0 Main=3,M1 Main=3, Wr M0 Main=3, Wr M1 Main =3  
 ; D.S A:0xC60048D0  %LE %LONG 0x10001000  // VDO1     
 ; D.S A:0xC60048D4  %LE %LONG 0x30303030  // VDO  PRT  RD M0 Main=3,M1 Main=3, Wr M0 Main=3, Wr M1 Main =3  
 ; D.S A:0xC6004AD0  %LE %LONG 0x10001000  // VDO2     
 ; D.S A:0xC6004AD4  %LE %LONG 0x30303030  // VDO  PRT  RD M0 Main=3,M1 Main=3, Wr M0 Main=3, Wr M1 Main =3  
 ; D.S A:0xC6004CD0  %LE %LONG 0x10001000  // VDO3     
 ; D.S A:0xC6004CD4  %LE %LONG 0x30303030  // VDO  PRT  RD M0 Main=3,M1 Main=3, Wr M0 Main=3, Wr M1 Main =3  
 ; D.S A:0xC6004ED0  %LE %LONG 0x10001000  // SMX0     
 ; D.S A:0xC6004ED4  %LE %LONG 0x30303030  // SMX  PRT  RD M0 Main=3,M1 Main=3, Wr M0 Main=3, Wr M1 Main =3  
 ; D.S A:0xC60050D0  %LE %LONG 0x10001000  // SMX1     
 ; D.S A:0xC60050D4  %LE %LONG 0x30303030  // SMX  PRT  RD M0 Main=3,M1 Main=3, Wr M0 Main=3, Wr M1 Main =3  
 ; D.S A:0xC60052D0  %LE %LONG 0x10001000  // SMX2     
 ; D.S A:0xC60052D4  %LE %LONG 0x30303030  // SMX  PRT  RD M0 Main=3,M1 Main=3, Wr M0 Main=3, Wr M1 Main =3  
 ; D.S A:0xC60054D0  %LE %LONG 0x10001000  // SMX3     
 ; D.S A:0xC60054D4  %LE %LONG 0x30303030  // SMX  PRT  RD M0 Main=3,M1 Main=3, Wr M0 Main=3, Wr M1 Main =3  
 ; D.S A:0xC600B0D0  %LE %LONG 0x10001000  // VDEC0_M0 
 ; D.S A:0xC600B0D4  %LE %LONG 0x30303030  // VDE  PRT  RD M0 Main=3,M1 Main=3, Wr M0 Main=3, Wr M1 Main =3  
 ; D.S A:0xC600B2D0  %LE %LONG 0x10001000  // VDEC0_M1 
 ; D.S A:0xC600B2D4  %LE %LONG 0x30303030  // VDE  PRT  RD M0 Main=3,M1 Main=3, Wr M0 Main=3, Wr M1 Main =3  
 ; D.S A:0xC600B4D0  %LE %LONG 0x10001000  // VDEC1_M0 
 ; D.S A:0xC600B4D4  %LE %LONG 0x30303030  // VDE  PRT  RD M0 Main=3,M1 Main=3, Wr M0 Main=3, Wr M1 Main =3  
 ; D.S A:0xC600B6D0  %LE %LONG 0x10001000  // VDEC1_M1 
 ; D.S A:0xC600B6D4  %LE %LONG 0x30303030  // VDE  PRT  RD M0 Main=3,M1 Main=3, Wr M0 Main=3, Wr M1 Main =3  
 ; D.S A:0xC600B8D0  %LE %LONG 0x10001000  // VDEC2_M0 
 ; D.S A:0xC600B8D4  %LE %LONG 0x30303030  // VDE  PRT  RD M0 Main=3,M1 Main=3, Wr M0 Main=3, Wr M1 Main =3  
 ; D.S A:0xC600BAD0  %LE %LONG 0x10001000  // VDEC2_M1 
 ; D.S A:0xC600BAD4  %LE %LONG 0x30303030  // VDE  PRT  RD M0 Main=3,M1 Main=3, Wr M0 Main=3, Wr M1 Main =3  
 ; D.S A:0xC600BCD0  %LE %LONG 0x10001000  // VDEC3_M0 
 ; D.S A:0xC600BCD4  %LE %LONG 0x30303030  // VDE  PRT  RD M0 Main=3,M1 Main=3, Wr M0 Main=3, Wr M1 Main =3  
 ; D.S A:0xC600BED0  %LE %LONG 0x10001000  // VDEC3_M1 
 ; D.S A:0xC600BED4  %LE %LONG 0x30303030  // VDE  PRT  RD M0 Main=3,M1 Main=3, Wr M0 Main=3, Wr M1 Main =3  
 ; D.S A:0xC600C0D0  %LE %LONG 0x10001000  // VDEC_MCU 
 ; D.S A:0xC600C0D4  %LE %LONG 0x30303030  // VDE  PRT  RD M0 Main=3,M1 Main=3, Wr M0 Main=3, Wr M1 Main =3  




; ;E60 ASIC BUS PRT 설정 
; D.S A:0xC98230D0 %LE %LONG 0x10001000   // GPU PRT 3/3
; D.S A:0xC98230D4 %LE %LONG 0x30303030
; D.S A:0xC98234D0 %LE %LONG 0x10001000   // TIV PRT 3/3
; D.S A:0xC98234D4 %LE %LONG 0x30303030
; D.S A:0xC98238D0 %LE %LONG 0x10001000   // WOV PRT 3/3
; D.S A:0xC98238D4 %LE %LONG 0x30303030
; D.S A:0xC9823CD0 %LE %LONG 0x10001000   // LGSR PRT 3/3
; D.S A:0xC9823CD4 %LE %LONG 0x30304040
; D.S A:0xC98240D0 %LE %LONG 0x10001000   // LNE PRT 3/3
; D.S A:0xC98240D4 %LE %LONG 0x30303030
; D.S A:0xC98244D0 %LE %LONG 0x10001000   // VDEC0_M1 PRT 3/3
; D.S A:0xC98244D4 %LE %LONG 0x30303030
; D.S A:0xC98248D0 %LE %LONG 0x10001000   // VDEC1_M1 PRT 3/3
; D.S A:0xC98248D4 %LE %LONG 0x30303030
; D.S A:0xC9824CD0 %LE %LONG 0x10001000   // VDEC2A_M1 PRT 3/3
; D.S A:0xC9824CD4 %LE %LONG 0x30303030
; D.S A:0xC98250D0 %LE %LONG 0x10001000   // VDEC2B_M1 PRT 3/3
; D.S A:0xC98250D4 %LE %LONG 0x30303030
; D.S A:0xC98254D0 %LE %LONG 0x10001000   // VDEC3A_M1 PRT 3/0
; D.S A:0xC98254D4 %LE %LONG 0x30300000
; D.S A:0xC98258D0 %LE %LONG 0x10001000   // VDEC3B_M1 PRT 3/3
; D.S A:0xC98258D4 %LE %LONG 0x30303030
; D.S A:0xC98260D0 %LE %LONG 0x10001000   // FMC0 PRT 7/7
; D.S A:0xC98260D4 %LE %LONG 0x70707070
; D.S A:0xC98264D0 %LE %LONG 0x10001000   // FMC2 PRT 7/7
; D.S A:0xC98264D4 %LE %LONG 0x70707070
; D.S A:0xC98268D0 %LE %LONG 0x10001000   // FMC4 PRT 7/7
; D.S A:0xC98268D4 %LE %LONG 0x70707070
; D.S A:0xC9826CD0 %LE %LONG 0x10001000   // FMC6 PRT 7/7
; D.S A:0xC9826CD4 %LE %LONG 0x70707070
; D.S A:0xC98270D0 %LE %LONG 0x10001000   // GSC0 PRT 7/7
; D.S A:0xC98270D4 %LE %LONG 0x70707070
; D.S A:0xC98274D0 %LE %LONG 0x10001000   // GSC2 PRT 7/7
; D.S A:0xC98274D4 %LE %LONG 0x70707070
; D.S A:0xC98278D0 %LE %LONG 0x10001000   // GSC4 PRT 7/7
; D.S A:0xC98278D4 %LE %LONG 0x70705050
; D.S A:0xC9827CD0 %LE %LONG 0x10001000   // CCO0 PRT 7/7
; D.S A:0xC9827CD4 %LE %LONG 0x70707070
; D.S A:0xC98280D0 %LE %LONG 0x10001000   // SMX0 PRT 4/4
; D.S A:0xC98280D4 %LE %LONG 0x40404040
; D.S A:0xC98284D0 %LE %LONG 0x10001000   // SMX2 PRT 4/4
; D.S A:0xC98284D4 %LE %LONG 0x40404040
; D.S A:0xC98288D0 %LE %LONG 0x10001000   // SMX4 PRT 4/4
; D.S A:0xC98288D4 %LE %LONG 0x40404040
; D.S A:0xC9828CD0 %LE %LONG 0x10001000   // SMX6 PRT 4/4
; D.S A:0xC9828CD4 %LE %LONG 0x40404040
; D.S A:0xC98278D0 %LE %LONG 0x10001000   // SRE0 PRT 5/5
; D.S A:0xC98278D4 %LE %LONG 0x70705050
; D.S A:0xC98290D0 %LE %LONG 0x10001000   // VDM0 PRT C/4
; D.S A:0xC98290D4 %LE %LONG 0xC0C04040
; D.S A:0xC98286D0 %LE %LONG 0x10001000   // VDM2 PRT C/4
; D.S A:0xC98286D4 %LE %LONG 0xC0C04040
; D.S A:0xC98294D0 %LE %LONG 0x10001000   // ND0 PRT C/5
; D.S A:0xC98294D4 %LE %LONG 0xC0C05050
; D.S A:0xC98298D0 %LE %LONG 0x10001000   // ND2 PRT C/5
; D.S A:0xC98298D4 %LE %LONG 0xC0C04040
; D.S A:0xC9829CD0 %LE %LONG 0x10001000   // SSD PRT 3/3
; D.S A:0xC9829CD4 %LE %LONG 0x30303030
; D.S A:0xC982A0D0 %LE %LONG 0x10001000   // FMS0 PRT 3/3
; D.S A:0xC982A0D4 %LE %LONG 0x30303030
; D.S A:0xC982A4D0 %LE %LONG 0x10001000   // CVD PRT 3/3
; D.S A:0xC982A4D4 %LE %LONG 0x30303030
; D.S A:0xC98232D0 %LE %LONG 0x10001000   // GFX PRT 3/3
; D.S A:0xC98232D4 %LE %LONG 0x30303030
; D.S A:0xC98236D0 %LE %LONG 0x10001000   // AUD PRT 3/3
; D.S A:0xC98236D4 %LE %LONG 0x30303030
; D.S A:0xC9823AD0 %LE %LONG 0x10001000   // DBB PRT 3/3
; D.S A:0xC9823AD4 %LE %LONG 0x30303030
; D.S A:0xC9823ED0 %LE %LONG 0x10001000   // OASR PRT 3/3
; D.S A:0xC9823ED4 %LE %LONG 0x30303030
; D.S A:0xC98242D0 %LE %LONG 0x10001000   // VDEC0_M0 PRT 3/3
; D.S A:0xC98242D4 %LE %LONG 0x30303030
; D.S A:0xC98246D0 %LE %LONG 0x10001000   // VDEC1_M0 PRT 3/3
; D.S A:0xC98246D4 %LE %LONG 0x30303030
; D.S A:0xC9824AD0 %LE %LONG 0x10001000   // VDEC2A_M0 PRT 3/3
; D.S A:0xC9824AD4 %LE %LONG 0x30303030
; D.S A:0xC9824ED0 %LE %LONG 0x10001000   // VDEC2B_M0 PRT 3/3
; D.S A:0xC9824ED4 %LE %LONG 0x30303030
; D.S A:0xC98252D0 %LE %LONG 0x10001000   // VDEC3A_M0 PRT 3/0
; D.S A:0xC98252D4 %LE %LONG 0x30300000
; D.S A:0xC98256D0 %LE %LONG 0x10001000   // VDEC3B_M0 PRT 3/3
; D.S A:0xC98256D4 %LE %LONG 0x30303030
; D.S A:0xC9825AD0 %LE %LONG 0x10001000   // MCU PRT 3/3
; D.S A:0xC9825AD4 %LE %LONG 0x30303030
; D.S A:0xC98262D0 %LE %LONG 0x10001000   // FMC1 PRT 7/7
; D.S A:0xC98262D4 %LE %LONG 0x70707070
; D.S A:0xC98266D0 %LE %LONG 0x10001000   // FMC3 PRT 7/7
; D.S A:0xC98266D4 %LE %LONG 0x70707070
; D.S A:0xC9826AD0 %LE %LONG 0x10001000   // FMC5 PRT 7/7
; D.S A:0xC9826AD4 %LE %LONG 0x70707070
; D.S A:0xC9826ED0 %LE %LONG 0x10001000   // FMC7 PRT 7/7
; D.S A:0xC9826ED4 %LE %LONG 0x70707070
; D.S A:0xC98272D0 %LE %LONG 0x10001000   // GSC1 PRT 7/7
; D.S A:0xC98272D4 %LE %LONG 0x70707070
; D.S A:0xC98276D0 %LE %LONG 0x10001000   // GSC3 PRT 7/7
; D.S A:0xC98276D4 %LE %LONG 0x70707070
; D.S A:0xC9827AD0 %LE %LONG 0x10001000   // GSC5 PRT 7/7
; D.S A:0xC9827AD4 %LE %LONG 0x70705050
; D.S A:0xC9827ED0 %LE %LONG 0x10001000   // CCO1 PRT 7/7
; D.S A:0xC9827ED4 %LE %LONG 0x70707070
; D.S A:0xC98282D0 %LE %LONG 0x10001000   // SMX1 PRT 4/4
; D.S A:0xC98282D4 %LE %LONG 0x40404040
; D.S A:0xC9823CD0 %LE %LONG 0x10001000   // SMX3 PRT 4/4
; D.S A:0xC9823CD4 %LE %LONG 0x30304040
; D.S A:0xC98298D0 %LE %LONG 0x10001000   // SMX5 PRT 4/4
; D.S A:0xC98298D4 %LE %LONG 0xC0C04040
; D.S A:0xC9828ED0 %LE %LONG 0x10001000   // SMX7 PRT 4/4
; D.S A:0xC9828ED4 %LE %LONG 0x40404040
; D.S A:0xC9827AD0 %LE %LONG 0x10001000   // SRE1 PRT 5/5
; D.S A:0xC9827AD4 %LE %LONG 0x70705050
; D.S A:0xC98292D0 %LE %LONG 0x10001000   // VDM1 PRT C/4
; D.S A:0xC98292D4 %LE %LONG 0xC0C04040
; D.S A:0xC9828AD0 %LE %LONG 0x10001000   // VDM3 PRT C/4
; D.S A:0xC9828AD4 %LE %LONG 0xC0C04040
; D.S A:0xC98296D0 %LE %LONG 0x10001000   // ND1 PRT C/5
; D.S A:0xC98296D4 %LE %LONG 0xC0C05050
; D.S A:0xC9829AD0 %LE %LONG 0x10001000   // ME0 PRT 3/3
; D.S A:0xC9829AD4 %LE %LONG 0x30303030
; D.S A:0xC9829ED0 %LE %LONG 0x10001000   // ME1 PRT 3/3
; D.S A:0xC9829ED4 %LE %LONG 0x30303030
; D.S A:0xC982A2D0 %LE %LONG 0x10001000   // FMS1 PRT 3/3
; D.S A:0xC982A2D4 %LE %LONG 0x30303030
; D.S A:0xC982A6D0 %LE %LONG 0x10001000   // OBD PRT 3/3
; D.S A:0xC982A6D4 %LE %LONG 0x30303030
