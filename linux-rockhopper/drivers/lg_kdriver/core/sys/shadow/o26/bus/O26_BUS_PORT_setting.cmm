;;;;;;;;;;;;;;;;;;;;;;;;;;;;;;;;;;;;;;;;;;;;;;;;;;;;;;;
;; Generating PORT CMM
;; Generating Time : 2024-07-04 
;; Modified time: 2025-04-08  ;; update FPGA optimization result for ASIC delivery
;; Project : O26
;;;;;;;;;;;;;;;;;;;;;;;;;;;;;;;;;;;;;;;;;;;;;;;;;;;;;;;
D.S ASD:0xC42084A0 %LONG 0x10001000     ;;GPU0      : 000000 (250408) <= 222222
D.S ASD:0xC42088A0 %LONG 0x10101110     ;;GPU1      : 010110 (250408) <= 110110
D.S ASD:0xC42104A0 %LONG 0x13301330     ;;GFX
D.S ASD:0xC4208CA0 %LONG 0x11101110     ;;LOWBW     : 111111(240704) <= 000000 
D.S ASD:0xC42108A0 %LONG 0x12201220     ;;TIVVMCU
D.S ASD:0xC42004A0 %LONG 0x11101110     ;;ME3X1
D.S ASD:0xC42008A0 %LONG 0x13301330     ;;FMC0
D.S ASD:0xC4200CA0 %LONG 0x12201220     ;;FMC1     :222222 (240704)<= 000000
D.S ASD:0xC42010A0 %LONG 0x12300000     ;;FMC2     :230000 (250408)<= 220000
D.S ASD:0xC42014A0 %LONG 0x11200000     ;;FMC3     :120000 (250408)<= 110000
D.S ASD:0xC42090A0 %LONG 0x10001000     ;;FMS      :000000 (250408)<= 330330
D.S ASD:0xC42018A0 %LONG 0x11101130     ;;SRE0     :110130 (250408)<= 110110
D.S ASD:0xC4201CA0 %LONG 0x13301130     ;;SRE1CCO  :330130 (250408)<= 330330
D.S ASD:0xC42094A0 %LONG 0x13201320     ;;ND0      :320320 (250408) <= 333333 (240704) <= 000000
D.S ASD:0xC42098A0 %LONG 0x11101110     ;;ND1
D.S ASD:0xC4209CA0 %LONG 0x12201220     ;;IMX0
D.S ASD:0xC420A0A0 %LONG 0x10101010     ;;IMX1     :010010 (250408) <= 110110
D.S ASD:0xC420A4A0 %LONG 0x11101110     ;;IMX2     :111111 (240704) <= 000000
D.S ASD:0xC420A8A0 %LONG 0x13301330     ;;IMX3
D.S ASD:0xC420ACA0 %LONG 0x13300000     ;;VDO0
D.S ASD:0xC420B0A0 %LONG 0x12200000     ;;VDO1
D.S ASD:0xC42020A0 %LONG 0x12200000     ;;GSC0
D.S ASD:0xC42024A0 %LONG 0x11100000     ;;GSC1
D.S ASD:0xC42028A0 %LONG 0x13300000     ;;GSC2
D.S ASD:0xC4202CA0 %LONG 0x12200000     ;;GSC3     :222222 (240704) <= 000000
D.S ASD:0xC4210CA0 %LONG 0x13301330     ;;AUD      :333333 (240704) <= 000000
D.S ASD:0xC42110A0 %LONG 0x11101110     ;;NPPTCU   :111111 (240704) <= 000000
D.S ASD:0xC42114A0 %LONG 0x13001300     ;;LNX0     :300300 (250408) <= 330330
D.S ASD:0xC42118A0 %LONG 0x12201220     ;;LNX1
D.S ASD:0xC4211CA0 %LONG 0x11101110     ;;LNX2
D.S ASD:0xC42120A0 %LONG 0x11101110     ;;VD0A
D.S ASD:0xC42124A0 %LONG 0x12201220     ;;VD0B     :222222 (240704) <= 000000 
D.S ASD:0xC42128A0 %LONG 0x12201220     ;;VD1A
D.S ASD:0xC4212CA0 %LONG 0x13001300     ;;VD1B     :300300 (250408) <= 330330


;;;;;;;;;;;;;;;;;;;;;;;;;;;;;;;;;;;;;;;;;;;;;;;;;;;;;;;
;; Generating PORT CMM by BUS_PMT
;; Generating Time : 2023-03-28 11:58:16
;; Project : O24
;;;;;;;;;;;;;;;;;;;;;;;;;;;;;;;;;;;;;;;;;;;;;;;;;;;;;;;

;;  D.S ASD:0xC40F10A0 %LONG 0x12201220		;;GPU0		: 220220 <- 222222 (230328 dongil.nam c)
;;  D.S ASD:0xC40F12A0 %LONG 0x11101110		;;GPU1		: 110110 <- 111111 (230328 dongil.nam c)
;;  D.S ASD:0xC40F14A0 %LONG 0x13331333		;;GFX		: 333333
;;  D.S ASD:0xC40F16A0 %LONG 0x10001000		;;LOWBW		: 000000
;;  D.S ASD:0xC40F18A0 %LONG 0x12221222		;;ICVENC	: 222222
;;  D.S ASD:0xC40F1AA0 %LONG 0x11131113		;;MEFMS		: 113113 <- 111111 (230328 dongil.nam c)
;;  D.S ASD:0xC40F1CA0 %LONG 0x13331333		;;FMGSSR0	: 333333
;;  D.S ASD:0xC40F1EA0 %LONG 0x10001000		;;FMGSSR1	: 000000
;;  D.S ASD:0xC40F20A0 %LONG 0x12221222		;;FMGSSR2	: 222222
;;  D.S ASD:0xC40F22A0 %LONG 0x11111111		;;FMGSSR3	: 111111
;;  D.S ASD:0xC40F24A0 %LONG 0x13331333		;;FMGSSR4	: 333333
;;  D.S ASD:0xC40F26A0 %LONG 0x11100000		;;CCO0		: 110xxx <- 111xxx (230328 dongil.nam c)
;;  D.S ASD:0xC40F28A0 %LONG 0x13330000		;;CCO1		: 333xxx 
;;  D.S ASD:0xC40F2AA0 %LONG 0x10001000		;;ND0		: 000000
;;  D.S ASD:0xC40F2CA0 %LONG 0x11111111		;;ND1		: 111111
;;  D.S ASD:0xC40F2EA0 %LONG 0x12221222		;;VDOIMXW0	: 222222
;;  D.S ASD:0xC40F30A0 %LONG 0x11111121		;;VDOIMXW1	: 111121 <- 111111 (230328 dongil.nam c)
;;  D.S ASD:0xC40F32A0 %LONG 0x10001030		;;VDOIMXW2	: 100030 <- 000000 (230328 dongil.nam c)
;;  D.S ASD:0xC40F34A0 %LONG 0x13331232		;;VDOIMXW3	: 333232 <- 333333 (230328 dongil.nam c)
;;  D.S ASD:0xC40F36A0 %LONG 0x13210000		;;IMXR01	: 321xxx <- 333xxx (230328 dongil.nam c)
;;  D.S ASD:0xC40F38A0 %LONG 0x12220000		;;IMXR23	: 222xxx <- 222xxx (230328 dongil.nam c)
;;  D.S ASD:0xC40F3AA0 %LONG 0x12201200		;;TCON		: 220200 <- 000000 (230328 dongil.nam c)
;;  D.S ASD:0xC40F3CA0 %LONG 0x11311131		;;AUD		: 111111 
;;  D.S ASD:0xC40F3EA0 %LONG 0x13331333		;;LNX0		: 333333
;;  D.S ASD:0xC40F40A0 %LONG 0x10001000		;;LNX1		: 000000
;;  D.S ASD:0xC40F42A0 %LONG 0x11121112		;;LNX2		: 112112 <- 111111 (230328 dongil.nam c)
;;  D.S ASD:0xC40F44A0 %LONG 0x11111111		;;VD0A		: 111111
;;  D.S ASD:0xC40F46A0 %LONG 0x10001000		;;VD0B		: 000000
;;  D.S ASD:0xC40F48A0 %LONG 0x12221222		;;VD1A		: 222222
;;  D.S ASD:0xC40F4AA0 %LONG 0x12221222		;;VD1B		: 222222
;;  D.S ASD:0xC40F4CA0 %LONG 0x13331333		;;VD2VMCU	: 333333
;;  D.S ASD:0xC40F4EA0 %LONG 0x11111111		;;VD2B		: 111111


;  ;;;;;;;;;;;;;;;;;;;;;;;;;;;;;;;;;;;;;;;;;;;;;;;;;;;;;;;
;  ;; Refrefence M23
;  ;;;;;;;;;;;;;;;;;;;;;;;;;;;;;;;;;;;;;;;;;;;;;;;;;;;;;;;
;  D.S ASD:0xC45030A0 %LONG 0x11001100		;;GPU       : 1
;  D.S ASD:0xC45032A0 %LONG 0x13001300		;;GFX       : 3
;  D.S ASD:0xC45034A0 %LONG 0x10001000		;;TIV       : 0
;  D.S ASD:0xC45036A0 %LONG 0x12001200		;;DBB       : 2
;  D.S ASD:0xC45038A0 %LONG 0x10001000		;;TCON      : 0
;  D.S ASD:0xC4503AA0 %LONG 0x13001300		;;LNE       : 3
;  D.S ASD:0xC4503CA0 %LONG 0x10001000		;;PQE_MCU   : 0
;  D.S ASD:0xC4503EA0 %LONG 0x13001300		;;FMC0      : 3 <- 1 211117 dongil.nam C
;  D.S ASD:0xC45040A0 %LONG 0x13001300		;;FMC1      : 3 <- 1 211117 dongil.nam C
;  D.S ASD:0xC45042A0 %LONG 0x12000000		;;CCO0      : 2
;  D.S ASD:0xC45044A0 %LONG 0x00001200		;;SRE       : 2
;  D.S ASD:0xC45046A0 %LONG 0x11001100		;;ND0       : 1
;  D.S ASD:0xC45048A0 %LONG 0x12001200		;;ME0       : 2
;  D.S ASD:0xC4504AA0 %LONG 0x11001100		;;FMS       : 1
;  D.S ASD:0xC4504CA0 %LONG 0x10001000		;;CVD       : 0
;  D.S ASD:0xC4504EA0 %LONG 0x13000000		;;VDO0      : 3
;  D.S ASD:0xC45050A0 %LONG 0x11000000		;;VDO1      : 1
;  D.S ASD:0xC45052A0 %LONG 0x12001200		;;SMX0      : 2
;  D.S ASD:0xC45054A0 %LONG 0x00001100		;;SMX1      : 1
;  D.S ASD:0xC45056A0 %LONG 0x10001000		;;DNE0      : 0
;  D.S ASD:0xC45058A0 %LONG 0x12001200		;;AUD0      : 2
;  D.S ASD:0xC4505AA0 %LONG 0x11001100		;;AUD1      : 1
;  D.S ASD:0xC4505CA0 %LONG 0x12001200		;;VDEC0_M0  : 2 <- 1 211207 sanghoon.byun C
;  D.S ASD:0xC4505EA0 %LONG 0x13001300		;;VDEC0_M1  : 3 <- 0 211207 sanghoon.byun C
;  D.S ASD:0xC45060A0 %LONG 0x10001000		;;VDEC1_M0  : 0 <- 2 211207 sanghoon.byun C
;  D.S ASD:0xC45062A0 %LONG 0x11001100		;;VDEC1_M1  : 1 <- 3 211207 sanghoon.byun C
;  D.S ASD:0xC45064A0 %LONG 0x10001000		;;VDEC_MCU  : 0

;;;;;;;;;;;;;;;;;;;;;;;;;;;;;;;;;;;;;;;;;;;;;;;;;;;;;;;
;; Refrefence O22
;;;;;;;;;;;;;;;;;;;;;;;;;;;;;;;;;;;;;;;;;;;;;;;;;;;;;;;
 ; D.S A:0xC60010A0  %LE %LONG 0x11101110 // GPU      : 1/1
 ; D.S A:0xC60012A0  %LE %LONG 0x13301330 // GFX      : 3/3
 ; D.S A:0xC60014A0  %LE %LONG 0x10001000 // TIV_venc : 0/0
 ; D.S A:0xC60014B0  %LE %LONG 0x10001000 // TIV_icod : 0/0
 ; D.S A:0xC60014B4  %LE %LONG 0x10001000 // TIV_te   : 0/0
 ; D.S A:0xC600C2A0  %LE %LONG 0x12201220 // AUD0     : 2/2
 ; D.S A:0xC600C4A0  %LE %LONG 0x11101110 // AUD1     : 1/1
 ; D.S A:0xC6001AA0  %LE %LONG 0x13001300 // DBB      : 3/0
 ; D.S A:0xC6001CA0  %LE %LONG 0x11301130 // SRNR     : 1/3
 ; D.S A:0xC6001EA0  %LE %LONG 0x12201220 // LNE      : 2/2
 ; D.S A:0xC60020A0  %LE %LONG 0x10001000 // PQE_MCU  : 0/0
 ; D.S A:0xC60022A0  %LE %LONG 0x11301130 // FMC0     : 1/3 <-1/0 201030 HoonOh
 ; D.S A:0xC60024A0  %LE %LONG 0x10201020 // FMC1     : 0/2
 ; D.S A:0xC60026A0  %LE %LONG 0x12301230 // FMC2     : 2/3
 ; D.S A:0xC60028A0  %LE %LONG 0x13001300 // FMC3     : 3/0 <-3/1 201030 HoonOh
 ; D.S A:0xC6002AA0  %LE %LONG 0x11101110 // CCO0     : 1/1 <- 2/1 201030 HoonOh
 ; D.S A:0xC6002CA0  %LE %LONG 0x12201220 // CCO1     : 2/2
 ; D.S A:0xC6002EA0  %LE %LONG 0x12201220 // SRE      : 2/2 <- 2/0 201030 HoonOh
 ; D.S A:0xC60030A0  %LE %LONG 0x11101110 // ND0      : 1/1
 ; D.S A:0xC60032A0  %LE %LONG 0x13301330 // ND1      : 3/3
 ; D.S A:0xC60034A0  %LE %LONG 0x12201220 // ME0      : 2/2
 ; D.S A:0xC60036A0  %LE %LONG 0x10001000 // ME1      : 0/0
 ; D.S A:0xC60038A0  %LE %LONG 0x10301030 // SSD      : 0/3
 ; D.S A:0xC6003AA0  %LE %LONG 0x11101110 // FMS      : 1/1
 ; D.S A:0xC6003CA0  %LE %LONG 0x12301230 // GSC0     : 2/3
 ; D.S A:0xC6003EA0  %LE %LONG 0x13301330 // GSC1     : 3/3
 ; D.S A:0xC60040A0  %LE %LONG 0x11301130 // DNE0     : 1/3
 ; D.S A:0xC60042A0  %LE %LONG 0x11301130 // DNE1     : 1/3
 ; D.S A:0xC60044A0  %LE %LONG 0x10001000 // CVD      : 0/0
 ; D.S A:0xC60046A0  %LE %LONG 0x13301330 // VDO0     : 3/3
 ; D.S A:0xC60048A0  %LE %LONG 0x12201220 // VDO1     : 2/2
 ; D.S A:0xC6004AA0  %LE %LONG 0x10001000 // VDO2     : 0/0
 ; D.S A:0xC6004CA0  %LE %LONG 0x11101110 // VDO3     : 1/1
 ; D.S A:0xC6004EA0  %LE %LONG 0x12301230 // SMX0     : 2/3
 ; D.S A:0xC60050A0  %LE %LONG 0x11101110 // SMX1     : 1/1
 ; D.S A:0xC60052A0  %LE %LONG 0x10001000 // SMX2     : 0/0
 ; D.S A:0xC60054A0  %LE %LONG 0x13301330 // SMX3     : 3/3
 ; D.S A:0xC600B0A0  %LE %LONG 0x11301130 // VDEC0_M0 : 1/3
 ; D.S A:0xC600B2A0  %LE %LONG 0x10201020 // VDEC0_M1 : 0/2
 ; D.S A:0xC600B4A0  %LE %LONG 0x12101210 // VDEC1_M0 : 2/1
 ; D.S A:0xC600B6A0  %LE %LONG 0x13001300 // VDEC1_M1 : 3/0
 ; D.S A:0xC600B8A0  %LE %LONG 0x11301130 // VDEC2_M0 : 1/3
 ; D.S A:0xC600BAA0  %LE %LONG 0x10201020 // VDEC2_M1 : 0/2
 ; D.S A:0xC600BCA0  %LE %LONG 0x12101210 // VDEC3_M0 : 2/1
 ; D.S A:0xC600BEA0  %LE %LONG 0x13001300 // VDEC3_M1 : 3/0
 ; D.S A:0xC600C0A0  %LE %LONG 0x10001000 // VDEC_MCU : 0/0
                
                
;;;;;;;;;;;;;;;;;;;;;;;;;;;;;;;;;;;;;;;;;;;;;;;;;;;;;;;
;; Refrefence E60
;;;;;;;;;;;;;;;;;;;;;;;;;;;;;;;;;;;;;;;;;;;;;;;;;;;;;;;
;; D.S A:0xC98230a0 %LE %LONG 0x12221222   // GPU 2/2/2
;; D.S A:0xC98234a0 %LE %LONG 0x11111111   // TIV 1/1/1
;; D.S A:0xC98238a0 %LE %LONG 0x10001000   // WOV 0/0/0
;; D.S A:0xC9823Ca0 %LE %LONG 0x13331333   // LGSR 3/3/3
;; D.S A:0xC98240a0 %LE %LONG 0x13331333   // LNE 3/3/3
;; D.S A:0xC98244a0 %LE %LONG 0x11111111   // VDEC0_M1 1/1/1
;; D.S A:0xC98248a0 %LE %LONG 0x13331333   // VDEC1_M1 3/3/3
;; D.S A:0xC9824Ca0 %LE %LONG 0x12111211   // VDEC2A_M1 2/1/1
;; D.S A:0xC98250a0 %LE %LONG 0x13231323   // VDEC2B_M1 3/2/3
;; D.S A:0xC98254a0 %LE %LONG 0x10001000   // VDEC3A_M1 0/0/0
;; D.S A:0xC98258a0 %LE %LONG 0x12221222   // VDEC3B_M1 2/2/2
;; D.S A:0xC98260A0 %LE %LONG 0x11111113   // FMC0 1/1/1
;; D.S A:0xC98264a0 %LE %LONG 0x13221333   // FMC2 3/2/2/3/3/3
;; D.S A:0xC98268a0 %LE %LONG 0x13331333   // FMC4 3/3/3
;; D.S A:0xC9826Ca0 %LE %LONG 0x11001111   // FMC6 1/0/0/1/1/1
;; D.S A:0xC98270a0 %LE %LONG 0x11111111   // GSC0 1/1/1
;; D.S A:0xC98274a0 %LE %LONG 0x13331333   // GSC2 3/3/3
;; D.S A:0xC98278a0 %LE %LONG 0x11111332   // GSC4 1/1/1
;; D.S A:0xC9827Ca0 %LE %LONG 0x10331033   // CCO0 0/3/3
;; D.S A:0xC98280a0 %LE %LONG 0x10001000   // SMX0 0/0/0
;; D.S A:0xC98284a0 %LE %LONG 0x12221222   // SMX2 2/2/2
;; D.S A:0xC98288a0 %LE %LONG 0x11101110   // SMX4 1/1/1
;; D.S A:0xC9828Ca0 %LE %LONG 0x10001000   // SMX6 0/0/0
;; D.S A:0xC98278a0 %LE %LONG 0x11111332   // SRE0 3/3/3
;; D.S A:0xC98290a0 %LE %LONG 0x10001000   // VDM0 0/0/0
;; D.S A:0xC98286a0 %LE %LONG 0x12221222   // VDM2 2/2/2
;; D.S A:0xC98294a0 %LE %LONG 0x10001000   // ND0 0/0/0
;; D.S A:0xC98298a0 %LE %LONG 0x12221223   // ND2 2/2/2
;; D.S A:0xC9829Ca0 %LE %LONG 0x13331330   // SSD 3/3/3
;; D.S A:0xC982A0a0 %LE %LONG 0x11111111   // FMS0 1/1/1
;; D.S A:0xC982A4a0 %LE %LONG 0x11111111   // CVD 1/1/1
;; D.S A:0xC98232a0 %LE %LONG 0x11111111   // GFX 1/1/1
;; D.S A:0xC98236a0 %LE %LONG 0x11311131   // AUD 1/3/1
;; D.S A:0xC9823Aa0 %LE %LONG 0x12221222   // DBB 2/2/2
;; D.S A:0xC9823Ea0 %LE %LONG 0x10001000   // OASR 0/0/0
;; D.S A:0xC98242a0 %LE %LONG 0x12221222   // VDEC0_M0 2/2/2
;; D.S A:0xC98246a0 %LE %LONG 0x13331333   // VDEC1_M0 3/3/3
;; D.S A:0xC9824Aa0 %LE %LONG 0x10001000   // VDEC2A_M0 0/0/0
;; D.S A:0xC9824Ea0 %LE %LONG 0x11321132   // VDEC2B_M0 1/3/2
;; D.S A:0xC98252a0 %LE %LONG 0x11111111   // VDEC3A_M0 1/1/1
;; D.S A:0xC98256a0 %LE %LONG 0x13331333   // VDEC3B_M0 3/3/3
;; D.S A:0xC9825Aa0 %LE %LONG 0x10001000   // MCU 0/0/0
;; D.S A:0xC98262a0 %LE %LONG 0x12111222   // FMC1 2/1/1/2/2/2
;; D.S A:0xC98266a0 %LE %LONG 0x10221000   // FMC3 0/2/2/0/0/0
;; D.S A:0xC9826Aa0 %LE %LONG 0x10331000   // FMC5 0/3/3/0/0/0
;; D.S A:0xC9826Ea0 %LE %LONG 0x12001222   // FMC7 2/0/0/2/2/2
;; D.S A:0xC98272a0 %LE %LONG 0x12221222   // GSC1 2/2/2
;; D.S A:0xC98276a0 %LE %LONG 0x10001000   // GSC3 0/0/0
;; D.S A:0xC9827Aa0 %LE %LONG 0x12221001   // GSC5 2/2/2
;; D.S A:0xC9827Ea0 %LE %LONG 0x12221222   // CCO1 2/2/2
;; D.S A:0xC98282a0 %LE %LONG 0x11111111   // SMX1 1/1/1
;; D.S A:0xC9823Ca0 %LE %LONG 0x13331333   // SMX3 3/3/3
;; D.S A:0xC98298a0 %LE %LONG 0x12221223   // SMX5 2/2/2
;; D.S A:0xC9828Ea0 %LE %LONG 0x13331333   // SMX7 3/3/3
;; D.S A:0xC9827Aa0 %LE %LONG 0x12221001   // SRE1 0/0/0
;; D.S A:0xC98292a0 %LE %LONG 0x11111111   // VDM1 1/1/1
;; D.S A:0xC9828Aa0 %LE %LONG 0x13331333   // VDM3 3/3/3
;; D.S A:0xC98296a0 %LE %LONG 0x11111111   // ND1 1/1/1
;; D.S A:0xC9829Aa0 %LE %LONG 0x11101110   // ME0 1/1/1
;; D.S A:0xC9829Ea0 %LE %LONG 0x12221223   // ME1 2/2/2
;; D.S A:0xC982A2a0 %LE %LONG 0x13331333   // FMS1 3/3/3
;; D.S A:0xC982A6a0 %LE %LONG 0x12221222   // OBD 2/2/2
