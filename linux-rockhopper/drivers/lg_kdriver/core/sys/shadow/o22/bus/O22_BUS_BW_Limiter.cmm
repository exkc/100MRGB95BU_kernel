;;;;;;;;;;;;;;;;;;;;;;;;;;;;;;;;;;;;;;;;;;;;;;;;;;;;;;;
;; Generating LIMITER CMM by BUS_PMT
;; Generating Time : 2021-07-23 16:43:54
;; Project : O22
;;;;;;;;;;;;;;;;;;;;;;;;;;;;;;;;;;;;;;;;;;;;;;;;;;;;;;;
;; 210723 Hoon.Oh updated
;; 210827 Hoon.Oh updated  : VDEC BW Limit added

;; 211008 hwang.hayun updated : remove BW Limit CPU/GPU/GFX
;; http://clm.lge.com/issue/browse/SICDTV-10281, set BW Limit by request of driver


;VDEC0_M0
D.S ASD:0xC600B018 %LONG 0x00001188		;;Time(us)  9.35us
D.S ASD:0xC600B078 %LONG 0x30007FD5		;;FIRST LIMITER READ_BW(MB)  3.5GB
D.S ASD:0xC600B07C %LONG 0x30005B4F		;;FIRST LIMITER WRITE_BW(MB) 2.5GB

;VDEC0_M1
D.S ASD:0xC600B218 %LONG 0x00001188		;;Time(us)  9.35us
D.S ASD:0xC600B278 %LONG 0x30007FD5		;;FIRST LIMITER READ_BW(MB)  3.5GB
D.S ASD:0xC600B27C %LONG 0x30005B4F		;;FIRST LIMITER WRITE_BW(MB) 2.5GB

;VDEC1_M0
D.S ASD:0xC600B418 %LONG 0x00001188		;;Time(us)  9.35us
D.S ASD:0xC600B478 %LONG 0x30007FD5		;;FIRST LIMITER READ_BW(MB)  3.5GB
D.S ASD:0xC600B47C %LONG 0x30005B4F		;;FIRST LIMITER WRITE_BW(MB) 2.5GB

;VDEC1_M1
D.S ASD:0xC600B618 %LONG 0x00001188		;;Time(us)  9.35us
D.S ASD:0xC600B678 %LONG 0x30007FD5		;;FIRST LIMITER READ_BW(MB)  3.5GB
D.S ASD:0xC600B67C %LONG 0x30005B4F		;;FIRST LIMITER WRITE_BW(MB) 2.5GB

;VDEC2_M0
D.S ASD:0xC600B818 %LONG 0x00001188		;;Time(us)  9.35us
D.S ASD:0xC600B878 %LONG 0x3000B69E		;;FIRST LIMITER READ_BW(MB)  5.0GB
D.S ASD:0xC600B87C %LONG 0x30005B4F		;;FIRST LIMITER WRITE_BW(MB) 2.5GB

;VDEC2_M1
D.S ASD:0xC600BA18 %LONG 0x00001188		;;Time(us)  9.35us
D.S ASD:0xC600BA78 %LONG 0x30007FD5		;;FIRST LIMITER READ_BW(MB)  3.5GB
D.S ASD:0xC600BA7C %LONG 0x30005B4F		;;FIRST LIMITER WRITE_BW(MB) 2.5GB

;VDEC3_M0
D.S ASD:0xC600BC18 %LONG 0x00001188		;;Time(us)  9.35us
D.S ASD:0xC600BC78 %LONG 0x3000B69E		;;FIRST LIMITER READ_BW(MB)  5.0GB
D.S ASD:0xC600BC7C %LONG 0x30005B4F		;;FIRST LIMITER WRITE_BW(MB) 2.5GB

;VDEC3_M1
D.S ASD:0xC600BE18 %LONG 0x00001188		;;Time(us)  9.35us
D.S ASD:0xC600BE78 %LONG 0x30007FD5		;;FIRST LIMITER READ_BW(MB)  3.5GB
D.S ASD:0xC600BE7C %LONG 0x30005B4F		;;FIRST LIMITER WRITE_BW(MB) 2.5GB


