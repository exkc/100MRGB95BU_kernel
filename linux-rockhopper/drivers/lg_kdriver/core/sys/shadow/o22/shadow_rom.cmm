;;;;;;;;;;;;;;;;;;;;;;;;;;;;;;;;;;;;;;;;;;;;;;;;;;;;;;;
;; Generating Port CMM by Performance Monitor
;; Generating Time : 2020-09-07 
;; Project : O22
;;;;;;;;;;;;;;;;;;;;;;;;;;;;;;;;;;;;;;;;;;;;;;;;;;;;;;;
;; 210806 Hoon.Oh ND0,DNE0,DNE1 changed
;; 210806 Hoon.Oh ND0,DNE0,DNE1 changed
;;

D.S A:0xC60010A0  %LE %LONG 0x11101000 // GPU      : 1/0 <- 1/1 220112 Hoon.Oh : Wr port changed
D.S A:0xC60012A0  %LE %LONG 0x13301330 // GFX      : 3/3
D.S A:0xC60014A0  %LE %LONG 0x10001000 // TIV_venc : 0/0
D.S A:0xC60014B0  %LE %LONG 0x10001000 // TIV_icod : 0/0
D.S A:0xC60014B4  %LE %LONG 0x10001000 // TIV_te   : 0/0
D.S A:0xC600C2A0  %LE %LONG 0x12201220 // AUD0     : 2/2
D.S A:0xC600C4A0  %LE %LONG 0x11101110 // AUD1     : 1/1
D.S A:0xC6001AA0  %LE %LONG 0x13001300 // DBB      : 3/0
D.S A:0xC6001CA0  %LE %LONG 0x11301130 // SRNR     : 1/3
D.S A:0xC6001EA0  %LE %LONG 0x12201220 // LNE      : 2/2
D.S A:0xC60020A0  %LE %LONG 0x10001000 // PQE_MCU  : 0/0
D.S A:0xC60022A0  %LE %LONG 0x11301130 // FMC0     : 1/3 <-1/0 201030 Hoon.Oh
D.S A:0xC60024A0  %LE %LONG 0x10201020 // FMC1     : 0/2
D.S A:0xC60026A0  %LE %LONG 0x12301230 // FMC2     : 2/3
D.S A:0xC60028A0  %LE %LONG 0x13001300 // FMC3     : 3/0 <-3/1 201030 Hoon.Oh
D.S A:0xC6002AA0  %LE %LONG 0x11101110 // CCO0     : 1/1 <- 2/1 201030 Hoon.Oh
D.S A:0xC6002CA0  %LE %LONG 0x12201220 // CCO1     : 2/2
D.S A:0xC6002EA0  %LE %LONG 0x12201220 // SRE      : 2/2 <- 2/0 201030 Hoon.Oh
D.S A:0xC60030A0  %LE %LONG 0x13101310 // ND0      : 1/1 <-110,110/1 210806 Hoon.Oh
D.S A:0xC60032A0  %LE %LONG 0x13301330 // ND1      : 3/3
D.S A:0xC60034A0  %LE %LONG 0x12201220 // ME0      : 2/2
D.S A:0xC60036A0  %LE %LONG 0x10001000 // ME1      : 0/0
D.S A:0xC60038A0  %LE %LONG 0x10301030 // SSD      : 0/3
D.S A:0xC6003AA0  %LE %LONG 0x11101110 // FMS      : 1/1
D.S A:0xC6003CA0  %LE %LONG 0x12301230 // GSC0     : 2/3
D.S A:0xC6003EA0  %LE %LONG 0x13301330 // GSC1     : 3/3
D.S A:0xC60040A0  %LE %LONG 0x11201120 // DNE0     : 1/3 <-130,130 210806 Hoon.Oh
D.S A:0xC60042A0  %LE %LONG 0x11201120 // DNE1     : 1/3 <-130,130 210806 Hoon.Oh
D.S A:0xC60044A0  %LE %LONG 0x10001000 // CVD      : 0/0
D.S A:0xC60046A0  %LE %LONG 0x13301330 // VDO0     : 3/3
D.S A:0xC60048A0  %LE %LONG 0x12201220 // VDO1     : 2/2
D.S A:0xC6004AA0  %LE %LONG 0x10001000 // VDO2     : 0/0
D.S A:0xC6004CA0  %LE %LONG 0x11101110 // VDO3     : 1/1
D.S A:0xC6004EA0  %LE %LONG 0x12301230 // SMX0     : 2/3
D.S A:0xC60050A0  %LE %LONG 0x11101110 // SMX1     : 1/1
D.S A:0xC60052A0  %LE %LONG 0x10001000 // SMX2     : 0/0
D.S A:0xC60054A0  %LE %LONG 0x13301330 // SMX3     : 3/3
D.S A:0xC600B0A0  %LE %LONG 0x11301130 // VDEC0_M0 : 1/3
D.S A:0xC600B2A0  %LE %LONG 0x10201020 // VDEC0_M1 : 0/2
D.S A:0xC600B4A0  %LE %LONG 0x12101210 // VDEC1_M0 : 2/1
D.S A:0xC600B6A0  %LE %LONG 0x13001300 // VDEC1_M1 : 3/0
D.S A:0xC600B8A0  %LE %LONG 0x11301130 // VDEC2_M0 : 1/3
D.S A:0xC600BAA0  %LE %LONG 0x10201020 // VDEC2_M1 : 0/2
D.S A:0xC600BCA0  %LE %LONG 0x12101210 // VDEC3_M0 : 2/1
D.S A:0xC600BEA0  %LE %LONG 0x13001300 // VDEC3_M1 : 3/0
D.S A:0xC600C0A0  %LE %LONG 0x10001000 // VDEC_MCU : 0/0
                
                
;;;;;;;;;;;;;;;;;;;;;;;;;;;;;;;;;;;;;;;;;;;;;;;;;;;;;;;
;; Refrefence E60
;;;;;;;;;;;;;;;;;;;;;;;;;;;;;;;;;;;;;;;;;;;;;;;;;;;;;;;
;; D.S A:0xC98230a0 %LE %LONG 0x12221222   // GPU 2/2/2
;; D.S A:0xC98234a0 %LE %LONG 0x11111111   // TIV 1/1/1
;; D.S A:0xC98238a0 %LE %LONG 0x10001000   // WOV 0/0/0
;; D.S A:0xC9823Ca0 %LE %LONG 0x13331333   // LGSR 3/3/3
;; D.S A:0xC98240a0 %LE %LONG 0x13331333   // LNE 3/3/3
;; D.S A:0xC98244a0 %LE %LONG 0x11111111   // VDEC0_M1 1/1/1
;; D.S A:0xC98248a0 %LE %LONG 0x13331333   // VDEC1_M1 3/3/3
;; D.S A:0xC9824Ca0 %LE %LONG 0x12111211   // VDEC2A_M1 2/1/1
;; D.S A:0xC98250a0 %LE %LONG 0x13231323   // VDEC2B_M1 3/2/3
;; D.S A:0xC98254a0 %LE %LONG 0x10001000   // VDEC3A_M1 0/0/0
;; D.S A:0xC98258a0 %LE %LONG 0x12221222   // VDEC3B_M1 2/2/2
;; D.S A:0xC98260A0 %LE %LONG 0x11111113   // FMC0 1/1/1
;; D.S A:0xC98264a0 %LE %LONG 0x13221333   // FMC2 3/2/2/3/3/3
;; D.S A:0xC98268a0 %LE %LONG 0x13331333   // FMC4 3/3/3
;; D.S A:0xC9826Ca0 %LE %LONG 0x11001111   // FMC6 1/0/0/1/1/1
;; D.S A:0xC98270a0 %LE %LONG 0x11111111   // GSC0 1/1/1
;; D.S A:0xC98274a0 %LE %LONG 0x13331333   // GSC2 3/3/3
;; D.S A:0xC98278a0 %LE %LONG 0x11111332   // GSC4 1/1/1
;; D.S A:0xC9827Ca0 %LE %LONG 0x10331033   // CCO0 0/3/3
;; D.S A:0xC98280a0 %LE %LONG 0x10001000   // SMX0 0/0/0
;; D.S A:0xC98284a0 %LE %LONG 0x12221222   // SMX2 2/2/2
;; D.S A:0xC98288a0 %LE %LONG 0x11101110   // SMX4 1/1/1
;; D.S A:0xC9828Ca0 %LE %LONG 0x10001000   // SMX6 0/0/0
;; D.S A:0xC98278a0 %LE %LONG 0x11111332   // SRE0 3/3/3
;; D.S A:0xC98290a0 %LE %LONG 0x10001000   // VDM0 0/0/0
;; D.S A:0xC98286a0 %LE %LONG 0x12221222   // VDM2 2/2/2
;; D.S A:0xC98294a0 %LE %LONG 0x10001000   // ND0 0/0/0
;; D.S A:0xC98298a0 %LE %LONG 0x12221223   // ND2 2/2/2
;; D.S A:0xC9829Ca0 %LE %LONG 0x13331330   // SSD 3/3/3
;; D.S A:0xC982A0a0 %LE %LONG 0x11111111   // FMS0 1/1/1
;; D.S A:0xC982A4a0 %LE %LONG 0x11111111   // CVD 1/1/1
;; D.S A:0xC98232a0 %LE %LONG 0x11111111   // GFX 1/1/1
;; D.S A:0xC98236a0 %LE %LONG 0x11311131   // AUD 1/3/1
;; D.S A:0xC9823Aa0 %LE %LONG 0x12221222   // DBB 2/2/2
;; D.S A:0xC9823Ea0 %LE %LONG 0x10001000   // OASR 0/0/0
;; D.S A:0xC98242a0 %LE %LONG 0x12221222   // VDEC0_M0 2/2/2
;; D.S A:0xC98246a0 %LE %LONG 0x13331333   // VDEC1_M0 3/3/3
;; D.S A:0xC9824Aa0 %LE %LONG 0x10001000   // VDEC2A_M0 0/0/0
;; D.S A:0xC9824Ea0 %LE %LONG 0x11321132   // VDEC2B_M0 1/3/2
;; D.S A:0xC98252a0 %LE %LONG 0x11111111   // VDEC3A_M0 1/1/1
;; D.S A:0xC98256a0 %LE %LONG 0x13331333   // VDEC3B_M0 3/3/3
;; D.S A:0xC9825Aa0 %LE %LONG 0x10001000   // MCU 0/0/0
;; D.S A:0xC98262a0 %LE %LONG 0x12111222   // FMC1 2/1/1/2/2/2
;; D.S A:0xC98266a0 %LE %LONG 0x10221000   // FMC3 0/2/2/0/0/0
;; D.S A:0xC9826Aa0 %LE %LONG 0x10331000   // FMC5 0/3/3/0/0/0
;; D.S A:0xC9826Ea0 %LE %LONG 0x12001222   // FMC7 2/0/0/2/2/2
;; D.S A:0xC98272a0 %LE %LONG 0x12221222   // GSC1 2/2/2
;; D.S A:0xC98276a0 %LE %LONG 0x10001000   // GSC3 0/0/0
;; D.S A:0xC9827Aa0 %LE %LONG 0x12221001   // GSC5 2/2/2
;; D.S A:0xC9827Ea0 %LE %LONG 0x12221222   // CCO1 2/2/2
;; D.S A:0xC98282a0 %LE %LONG 0x11111111   // SMX1 1/1/1
;; D.S A:0xC9823Ca0 %LE %LONG 0x13331333   // SMX3 3/3/3
;; D.S A:0xC98298a0 %LE %LONG 0x12221223   // SMX5 2/2/2
;; D.S A:0xC9828Ea0 %LE %LONG 0x13331333   // SMX7 3/3/3
;; D.S A:0xC9827Aa0 %LE %LONG 0x12221001   // SRE1 0/0/0
;; D.S A:0xC98292a0 %LE %LONG 0x11111111   // VDM1 1/1/1
;; D.S A:0xC9828Aa0 %LE %LONG 0x13331333   // VDM3 3/3/3
;; D.S A:0xC98296a0 %LE %LONG 0x11111111   // ND1 1/1/1
;; D.S A:0xC9829Aa0 %LE %LONG 0x11101110   // ME0 1/1/1
;; D.S A:0xC9829Ea0 %LE %LONG 0x12221223   // ME1 2/2/2
;; D.S A:0xC982A2a0 %LE %LONG 0x13331333   // FMS1 3/3/3
;; D.S A:0xC982A6a0 %LE %LONG 0x12221222   // OBD 2/2/2

;O22 FPGA BUS PRIORITY 설정 
;201123 Hoon.Oh
;210723 FMC0,1,2,3  CCO0,1 GSC0,1 updated

;CPU 추가//jungdb
;CPU new priority value -> Occurs EMMC related fail.  This  must be tested @ASIC chip, expecting no error!!
;D.S A:0xCAA010D0  %LE %LONG 0x10001000  // CPU  [28]Rd BUS register/ [12]Wr BUS register
;D.S A:0xCAA010D4  %LE %LONG 0x30303030  // CPU  PRT  RD M0 Main=3,M1 Main=3, Wr M0 Main=3, Wr M1 Main =3

;CPU default vuale -> works well
;D.S A:0xCAA010D0  %LE %LONG 0x003F003F  // CPU  [28]Rd BUS register/ [12]Wr BUS register
;D.S A:0xCAA010D4  %LE %LONG 0x35353535  // CPU  PRT  RD M0 Main=3,M1 Main=3, Wr M0 Main=3, Wr M1 Main =3

;IP
D.S A:0xC60010D0  %LE %LONG 0x10001000  // GPU  
D.S A:0xC60010D4  %LE %LONG 0x30303030  // GPU  PRT  RD M0 Main=3,M1 Main=3, Wr M0 Main=3, Wr M1 Main =3  
D.S A:0xC60012D0  %LE %LONG 0x10001000  // GFX  
D.S A:0xC60012D4  %LE %LONG 0x30303030  // GFX  PRT  RD M0 Main=3,M1 Main=3, Wr M0 Main=3, Wr M1 Main =3  

D.S A:0xC60014D0  %LE %LONG 0x10001000  // TIV_venc 
D.S A:0xC60014D4  %LE %LONG 0x30303030  // TIV  PRT  RD M0 Main=3,M1 Main=3, Wr M0 Main=3, Wr M1 Main =3  
;D.S A:0xC60014B0  %LE %LONG 0x10001000  // TIV_icod 
D.S A:0xC60014D8  %LE %LONG 0x30303030  // TIV  PRT  RD M0 Main=3,M1 Main=3, Wr M0 Main=3, Wr M1 Main =3  
;D.S A:0xC60014B4  %LE %LONG 0x10001000  // TIV_te   
D.S A:0xC60014DC  %LE %LONG 0x30303030  // TIV  PRT  RD M0 Main=3,M1 Main=3, Wr M0 Main=3, Wr M1 Main =3  

D.S A:0xC600C2D0  %LE %LONG 0x10001000  // AUD0     
D.S A:0xC600C2D4  %LE %LONG 0x30303030  // AUD  PRT  RD M0 Main=3,M1 Main=3, Wr M0 Main=3, Wr M1 Main =3  
D.S A:0xC600C4D0  %LE %LONG 0x10001000  // AUD1     
D.S A:0xC600C4D4  %LE %LONG 0x30303030  // AUD  PRT  RD M0 Main=3,M1 Main=3, Wr M0 Main=3, Wr M1 Main =3  
D.S A:0xC6001AD0  %LE %LONG 0x10001000  // DBB      
D.S A:0xC6001AD4  %LE %LONG 0x30303030  // DBB  PRT  RD M0 Main=3,M1 Main=3, Wr M0 Main=3, Wr M1 Main =3  
D.S A:0xC6001CD0  %LE %LONG 0x10001000  // SRNR     
D.S A:0xC6001CD4  %LE %LONG 0x30303030  // SRN  PRT  RD M0 Main=3,M1 Main=3, Wr M0 Main=3, Wr M1 Main =3  
D.S A:0xC6001ED0  %LE %LONG 0x10001000  // LNE      
D.S A:0xC6001ED4  %LE %LONG 0x30303030  // LNE  PRT  RD M0 Main=3,M1 Main=3, Wr M0 Main=3, Wr M1 Main =3  
D.S A:0xC60020D0  %LE %LONG 0x10001000  // PQE_MCU  
D.S A:0xC60020D4  %LE %LONG 0x30303030  // PQE  PRT  RD M0 Main=3,M1 Main=3, Wr M0 Main=3, Wr M1 Main =3  
D.S A:0xC60022D0  %LE %LONG 0x10001000  // FMC0 //210723 update    
D.S A:0xC60022D4  %LE %LONG 0xF0F03030  // FMC  PRT  RD M0 Main=3,M1 Main=3, Wr M0 Main=3, Wr M1 Main =3  
D.S A:0xC60024D0  %LE %LONG 0x10001000  // FMC1 //210723 update    
D.S A:0xC60024D4  %LE %LONG 0xF0F03030  // FMC  PRT  RD M0 Main=3,M1 Main=3, Wr M0 Main=3, Wr M1 Main =3  
D.S A:0xC60026D0  %LE %LONG 0x10001000  // FMC2 //210723 update    
D.S A:0xC60026D4  %LE %LONG 0xF0F03030  // FMC  PRT  RD M0 Main=3,M1 Main=3, Wr M0 Main=3, Wr M1 Main =3  
D.S A:0xC60028D0  %LE %LONG 0x10001000  // FMC3 //210723 update    
D.S A:0xC60028D4  %LE %LONG 0xF0F03030  // FMC  PRT  RD M0 Main=3,M1 Main=3, Wr M0 Main=3, Wr M1 Main =3  
D.S A:0xC6002AD0  %LE %LONG 0x10001000  // CCO0 //210723 update    
D.S A:0xC6002AD4  %LE %LONG 0xF0303030  // CCO  PRT  RD M0 Main=3,M1 Main=3, Wr M0 Main=3, Wr M1 Main =3  
D.S A:0xC6002CD0  %LE %LONG 0x10001000  // CCO1 //210723 update    
D.S A:0xC6002CD4  %LE %LONG 0xF0303030  // CCO  PRT  RD M0 Main=3,M1 Main=3, Wr M0 Main=3, Wr M1 Main =3  
D.S A:0xC6002ED0  %LE %LONG 0x10001000  // SRE      
D.S A:0xC6002ED4  %LE %LONG 0x30303030  // SRE  PRT  RD M0 Main=3,M1 Main=3, Wr M0 Main=3, Wr M1 Main =3  
D.S A:0xC60030D0  %LE %LONG 0x10001000  // ND0      
D.S A:0xC60030D4  %LE %LONG 0x30303030  // ND0  PRT  RD M0 Main=3,M1 Main=3, Wr M0 Main=3, Wr M1 Main =3  
D.S A:0xC60032D0  %LE %LONG 0x10001000  // ND1      
D.S A:0xC60032D4  %LE %LONG 0x30303030  // ND1  PRT  RD M0 Main=3,M1 Main=3, Wr M0 Main=3, Wr M1 Main =3  
D.S A:0xC60034D0  %LE %LONG 0x10001000  // ME0      
D.S A:0xC60034D4  %LE %LONG 0x30303030  // ME0  PRT  RD M0 Main=3,M1 Main=3, Wr M0 Main=3, Wr M1 Main =3  
D.S A:0xC60036D0  %LE %LONG 0x10001000  // ME1      
D.S A:0xC60036D4  %LE %LONG 0x30303030  // ME1  PRT  RD M0 Main=3,M1 Main=3, Wr M0 Main=3, Wr M1 Main =3  
D.S A:0xC60038D0  %LE %LONG 0x10001000  // SSD      
D.S A:0xC60038D4  %LE %LONG 0x30303030  // SSD  PRT  RD M0 Main=3,M1 Main=3, Wr M0 Main=3, Wr M1 Main =3  
D.S A:0xC6003AD0  %LE %LONG 0x10001000  // FMS      
D.S A:0xC6003AD4  %LE %LONG 0x30303030  // FMS  PRT  RD M0 Main=3,M1 Main=3, Wr M0 Main=3, Wr M1 Main =3  
D.S A:0xC6003CD0  %LE %LONG 0x10001000  // GSC0 //210723 update    
D.S A:0xC6003CD4  %LE %LONG 0xF0F03030  // GSC  PRT  RD M0 Main=3,M1 Main=3, Wr M0 Main=3, Wr M1 Main =3  
D.S A:0xC6003ED0  %LE %LONG 0x10001000  // GSC1 //210723 update    
D.S A:0xC6003ED4  %LE %LONG 0xF0F03030  // GSC  PRT  RD M0 Main=3,M1 Main=3, Wr M0 Main=3, Wr M1 Main =3  
D.S A:0xC60040D0  %LE %LONG 0x10001000  // DNE0     
D.S A:0xC60040D4  %LE %LONG 0x30303030  // DNE  PRT  RD M0 Main=3,M1 Main=3, Wr M0 Main=3, Wr M1 Main =3  
D.S A:0xC60042D0  %LE %LONG 0x10001000  // DNE1     
D.S A:0xC60042D4  %LE %LONG 0x30303030  // DNE  PRT  RD M0 Main=3,M1 Main=3, Wr M0 Main=3, Wr M1 Main =3  
D.S A:0xC60044D0  %LE %LONG 0x10001000  // CVD      
D.S A:0xC60044D4  %LE %LONG 0x30303030  // CVD  PRT  RD M0 Main=3,M1 Main=3, Wr M0 Main=3, Wr M1 Main =3  
D.S A:0xC60046D0  %LE %LONG 0x10001000  // VDO0     
D.S A:0xC60046D4  %LE %LONG 0x30303030  // VDO  PRT  RD M0 Main=3,M1 Main=3, Wr M0 Main=3, Wr M1 Main =3  
D.S A:0xC60048D0  %LE %LONG 0x10001000  // VDO1     
D.S A:0xC60048D4  %LE %LONG 0x30303030  // VDO  PRT  RD M0 Main=3,M1 Main=3, Wr M0 Main=3, Wr M1 Main =3  
D.S A:0xC6004AD0  %LE %LONG 0x10001000  // VDO2     
D.S A:0xC6004AD4  %LE %LONG 0x30303030  // VDO  PRT  RD M0 Main=3,M1 Main=3, Wr M0 Main=3, Wr M1 Main =3  
D.S A:0xC6004CD0  %LE %LONG 0x10001000  // VDO3     
D.S A:0xC6004CD4  %LE %LONG 0x30303030  // VDO  PRT  RD M0 Main=3,M1 Main=3, Wr M0 Main=3, Wr M1 Main =3  
D.S A:0xC6004ED0  %LE %LONG 0x10001000  // SMX0     
D.S A:0xC6004ED4  %LE %LONG 0x30303030  // SMX  PRT  RD M0 Main=3,M1 Main=3, Wr M0 Main=3, Wr M1 Main =3  
D.S A:0xC60050D0  %LE %LONG 0x10001000  // SMX1     
D.S A:0xC60050D4  %LE %LONG 0x30303030  // SMX  PRT  RD M0 Main=3,M1 Main=3, Wr M0 Main=3, Wr M1 Main =3  
D.S A:0xC60052D0  %LE %LONG 0x10001000  // SMX2     
D.S A:0xC60052D4  %LE %LONG 0x30303030  // SMX  PRT  RD M0 Main=3,M1 Main=3, Wr M0 Main=3, Wr M1 Main =3  
D.S A:0xC60054D0  %LE %LONG 0x10001000  // SMX3     
D.S A:0xC60054D4  %LE %LONG 0x30303030  // SMX  PRT  RD M0 Main=3,M1 Main=3, Wr M0 Main=3, Wr M1 Main =3  
D.S A:0xC600B0D0  %LE %LONG 0x10001000  // VDEC0_M0 
D.S A:0xC600B0D4  %LE %LONG 0x30303030  // VDE  PRT  RD M0 Main=3,M1 Main=3, Wr M0 Main=3, Wr M1 Main =3  
D.S A:0xC600B2D0  %LE %LONG 0x10001000  // VDEC0_M1 
D.S A:0xC600B2D4  %LE %LONG 0x30303030  // VDE  PRT  RD M0 Main=3,M1 Main=3, Wr M0 Main=3, Wr M1 Main =3  
D.S A:0xC600B4D0  %LE %LONG 0x10001000  // VDEC1_M0 
D.S A:0xC600B4D4  %LE %LONG 0x30303030  // VDE  PRT  RD M0 Main=3,M1 Main=3, Wr M0 Main=3, Wr M1 Main =3  
D.S A:0xC600B6D0  %LE %LONG 0x10001000  // VDEC1_M1 
D.S A:0xC600B6D4  %LE %LONG 0x30303030  // VDE  PRT  RD M0 Main=3,M1 Main=3, Wr M0 Main=3, Wr M1 Main =3  
D.S A:0xC600B8D0  %LE %LONG 0x10001000  // VDEC2_M0 
D.S A:0xC600B8D4  %LE %LONG 0x30303030  // VDE  PRT  RD M0 Main=3,M1 Main=3, Wr M0 Main=3, Wr M1 Main =3  
D.S A:0xC600BAD0  %LE %LONG 0x10001000  // VDEC2_M1 
D.S A:0xC600BAD4  %LE %LONG 0x30303030  // VDE  PRT  RD M0 Main=3,M1 Main=3, Wr M0 Main=3, Wr M1 Main =3  
D.S A:0xC600BCD0  %LE %LONG 0x10001000  // VDEC3_M0 
D.S A:0xC600BCD4  %LE %LONG 0x30303030  // VDE  PRT  RD M0 Main=3,M1 Main=3, Wr M0 Main=3, Wr M1 Main =3  
D.S A:0xC600BED0  %LE %LONG 0x10001000  // VDEC3_M1 
D.S A:0xC600BED4  %LE %LONG 0x30303030  // VDE  PRT  RD M0 Main=3,M1 Main=3, Wr M0 Main=3, Wr M1 Main =3  
D.S A:0xC600C0D0  %LE %LONG 0x10001000  // VDEC_MCU 
D.S A:0xC600C0D4  %LE %LONG 0x30303030  // VDE  PRT  RD M0 Main=3,M1 Main=3, Wr M0 Main=3, Wr M1 Main =3  




; ;E60 ASIC BUS PRT 설정 
; D.S A:0xC98230D0 %LE %LONG 0x10001000   // GPU PRT 3/3
; D.S A:0xC98230D4 %LE %LONG 0x30303030
; D.S A:0xC98234D0 %LE %LONG 0x10001000   // TIV PRT 3/3
; D.S A:0xC98234D4 %LE %LONG 0x30303030
; D.S A:0xC98238D0 %LE %LONG 0x10001000   // WOV PRT 3/3
; D.S A:0xC98238D4 %LE %LONG 0x30303030
; D.S A:0xC9823CD0 %LE %LONG 0x10001000   // LGSR PRT 3/3
; D.S A:0xC9823CD4 %LE %LONG 0x30304040
; D.S A:0xC98240D0 %LE %LONG 0x10001000   // LNE PRT 3/3
; D.S A:0xC98240D4 %LE %LONG 0x30303030
; D.S A:0xC98244D0 %LE %LONG 0x10001000   // VDEC0_M1 PRT 3/3
; D.S A:0xC98244D4 %LE %LONG 0x30303030
; D.S A:0xC98248D0 %LE %LONG 0x10001000   // VDEC1_M1 PRT 3/3
; D.S A:0xC98248D4 %LE %LONG 0x30303030
; D.S A:0xC9824CD0 %LE %LONG 0x10001000   // VDEC2A_M1 PRT 3/3
; D.S A:0xC9824CD4 %LE %LONG 0x30303030
; D.S A:0xC98250D0 %LE %LONG 0x10001000   // VDEC2B_M1 PRT 3/3
; D.S A:0xC98250D4 %LE %LONG 0x30303030
; D.S A:0xC98254D0 %LE %LONG 0x10001000   // VDEC3A_M1 PRT 3/0
; D.S A:0xC98254D4 %LE %LONG 0x30300000
; D.S A:0xC98258D0 %LE %LONG 0x10001000   // VDEC3B_M1 PRT 3/3
; D.S A:0xC98258D4 %LE %LONG 0x30303030
; D.S A:0xC98260D0 %LE %LONG 0x10001000   // FMC0 PRT 7/7
; D.S A:0xC98260D4 %LE %LONG 0x70707070
; D.S A:0xC98264D0 %LE %LONG 0x10001000   // FMC2 PRT 7/7
; D.S A:0xC98264D4 %LE %LONG 0x70707070
; D.S A:0xC98268D0 %LE %LONG 0x10001000   // FMC4 PRT 7/7
; D.S A:0xC98268D4 %LE %LONG 0x70707070
; D.S A:0xC9826CD0 %LE %LONG 0x10001000   // FMC6 PRT 7/7
; D.S A:0xC9826CD4 %LE %LONG 0x70707070
; D.S A:0xC98270D0 %LE %LONG 0x10001000   // GSC0 PRT 7/7
; D.S A:0xC98270D4 %LE %LONG 0x70707070
; D.S A:0xC98274D0 %LE %LONG 0x10001000   // GSC2 PRT 7/7
; D.S A:0xC98274D4 %LE %LONG 0x70707070
; D.S A:0xC98278D0 %LE %LONG 0x10001000   // GSC4 PRT 7/7
; D.S A:0xC98278D4 %LE %LONG 0x70705050
; D.S A:0xC9827CD0 %LE %LONG 0x10001000   // CCO0 PRT 7/7
; D.S A:0xC9827CD4 %LE %LONG 0x70707070
; D.S A:0xC98280D0 %LE %LONG 0x10001000   // SMX0 PRT 4/4
; D.S A:0xC98280D4 %LE %LONG 0x40404040
; D.S A:0xC98284D0 %LE %LONG 0x10001000   // SMX2 PRT 4/4
; D.S A:0xC98284D4 %LE %LONG 0x40404040
; D.S A:0xC98288D0 %LE %LONG 0x10001000   // SMX4 PRT 4/4
; D.S A:0xC98288D4 %LE %LONG 0x40404040
; D.S A:0xC9828CD0 %LE %LONG 0x10001000   // SMX6 PRT 4/4
; D.S A:0xC9828CD4 %LE %LONG 0x40404040
; D.S A:0xC98278D0 %LE %LONG 0x10001000   // SRE0 PRT 5/5
; D.S A:0xC98278D4 %LE %LONG 0x70705050
; D.S A:0xC98290D0 %LE %LONG 0x10001000   // VDM0 PRT C/4
; D.S A:0xC98290D4 %LE %LONG 0xC0C04040
; D.S A:0xC98286D0 %LE %LONG 0x10001000   // VDM2 PRT C/4
; D.S A:0xC98286D4 %LE %LONG 0xC0C04040
; D.S A:0xC98294D0 %LE %LONG 0x10001000   // ND0 PRT C/5
; D.S A:0xC98294D4 %LE %LONG 0xC0C05050
; D.S A:0xC98298D0 %LE %LONG 0x10001000   // ND2 PRT C/5
; D.S A:0xC98298D4 %LE %LONG 0xC0C04040
; D.S A:0xC9829CD0 %LE %LONG 0x10001000   // SSD PRT 3/3
; D.S A:0xC9829CD4 %LE %LONG 0x30303030
; D.S A:0xC982A0D0 %LE %LONG 0x10001000   // FMS0 PRT 3/3
; D.S A:0xC982A0D4 %LE %LONG 0x30303030
; D.S A:0xC982A4D0 %LE %LONG 0x10001000   // CVD PRT 3/3
; D.S A:0xC982A4D4 %LE %LONG 0x30303030
; D.S A:0xC98232D0 %LE %LONG 0x10001000   // GFX PRT 3/3
; D.S A:0xC98232D4 %LE %LONG 0x30303030
; D.S A:0xC98236D0 %LE %LONG 0x10001000   // AUD PRT 3/3
; D.S A:0xC98236D4 %LE %LONG 0x30303030
; D.S A:0xC9823AD0 %LE %LONG 0x10001000   // DBB PRT 3/3
; D.S A:0xC9823AD4 %LE %LONG 0x30303030
; D.S A:0xC9823ED0 %LE %LONG 0x10001000   // OASR PRT 3/3
; D.S A:0xC9823ED4 %LE %LONG 0x30303030
; D.S A:0xC98242D0 %LE %LONG 0x10001000   // VDEC0_M0 PRT 3/3
; D.S A:0xC98242D4 %LE %LONG 0x30303030
; D.S A:0xC98246D0 %LE %LONG 0x10001000   // VDEC1_M0 PRT 3/3
; D.S A:0xC98246D4 %LE %LONG 0x30303030
; D.S A:0xC9824AD0 %LE %LONG 0x10001000   // VDEC2A_M0 PRT 3/3
; D.S A:0xC9824AD4 %LE %LONG 0x30303030
; D.S A:0xC9824ED0 %LE %LONG 0x10001000   // VDEC2B_M0 PRT 3/3
; D.S A:0xC9824ED4 %LE %LONG 0x30303030
; D.S A:0xC98252D0 %LE %LONG 0x10001000   // VDEC3A_M0 PRT 3/0
; D.S A:0xC98252D4 %LE %LONG 0x30300000
; D.S A:0xC98256D0 %LE %LONG 0x10001000   // VDEC3B_M0 PRT 3/3
; D.S A:0xC98256D4 %LE %LONG 0x30303030
; D.S A:0xC9825AD0 %LE %LONG 0x10001000   // MCU PRT 3/3
; D.S A:0xC9825AD4 %LE %LONG 0x30303030
; D.S A:0xC98262D0 %LE %LONG 0x10001000   // FMC1 PRT 7/7
; D.S A:0xC98262D4 %LE %LONG 0x70707070
; D.S A:0xC98266D0 %LE %LONG 0x10001000   // FMC3 PRT 7/7
; D.S A:0xC98266D4 %LE %LONG 0x70707070
; D.S A:0xC9826AD0 %LE %LONG 0x10001000   // FMC5 PRT 7/7
; D.S A:0xC9826AD4 %LE %LONG 0x70707070
; D.S A:0xC9826ED0 %LE %LONG 0x10001000   // FMC7 PRT 7/7
; D.S A:0xC9826ED4 %LE %LONG 0x70707070
; D.S A:0xC98272D0 %LE %LONG 0x10001000   // GSC1 PRT 7/7
; D.S A:0xC98272D4 %LE %LONG 0x70707070
; D.S A:0xC98276D0 %LE %LONG 0x10001000   // GSC3 PRT 7/7
; D.S A:0xC98276D4 %LE %LONG 0x70707070
; D.S A:0xC9827AD0 %LE %LONG 0x10001000   // GSC5 PRT 7/7
; D.S A:0xC9827AD4 %LE %LONG 0x70705050
; D.S A:0xC9827ED0 %LE %LONG 0x10001000   // CCO1 PRT 7/7
; D.S A:0xC9827ED4 %LE %LONG 0x70707070
; D.S A:0xC98282D0 %LE %LONG 0x10001000   // SMX1 PRT 4/4
; D.S A:0xC98282D4 %LE %LONG 0x40404040
; D.S A:0xC9823CD0 %LE %LONG 0x10001000   // SMX3 PRT 4/4
; D.S A:0xC9823CD4 %LE %LONG 0x30304040
; D.S A:0xC98298D0 %LE %LONG 0x10001000   // SMX5 PRT 4/4
; D.S A:0xC98298D4 %LE %LONG 0xC0C04040
; D.S A:0xC9828ED0 %LE %LONG 0x10001000   // SMX7 PRT 4/4
; D.S A:0xC9828ED4 %LE %LONG 0x40404040
; D.S A:0xC9827AD0 %LE %LONG 0x10001000   // SRE1 PRT 5/5
; D.S A:0xC9827AD4 %LE %LONG 0x70705050
; D.S A:0xC98292D0 %LE %LONG 0x10001000   // VDM1 PRT C/4
; D.S A:0xC98292D4 %LE %LONG 0xC0C04040
; D.S A:0xC9828AD0 %LE %LONG 0x10001000   // VDM3 PRT C/4
; D.S A:0xC9828AD4 %LE %LONG 0xC0C04040
; D.S A:0xC98296D0 %LE %LONG 0x10001000   // ND1 PRT C/5
; D.S A:0xC98296D4 %LE %LONG 0xC0C05050
; D.S A:0xC9829AD0 %LE %LONG 0x10001000   // ME0 PRT 3/3
; D.S A:0xC9829AD4 %LE %LONG 0x30303030
; D.S A:0xC9829ED0 %LE %LONG 0x10001000   // ME1 PRT 3/3
; D.S A:0xC9829ED4 %LE %LONG 0x30303030
; D.S A:0xC982A2D0 %LE %LONG 0x10001000   // FMS1 PRT 3/3
; D.S A:0xC982A2D4 %LE %LONG 0x30303030
; D.S A:0xC982A6D0 %LE %LONG 0x10001000   // OBD PRT 3/3
; D.S A:0xC982A6D4 %LE %LONG 0x30303030
;;;;;;;;;;;;;;;;;;;;;;;;;;;;;;;;;;;;;;;;;;;;;;;;;;;;;;;
;; Generating LIMITER CMM by BUS_PMT
;; Generating Time : 2021-07-23 16:43:54
;; Project : O22
;;;;;;;;;;;;;;;;;;;;;;;;;;;;;;;;;;;;;;;;;;;;;;;;;;;;;;;
;; 210723 Hoon.Oh updated
;; 210827 Hoon.Oh updated  : VDEC BW Limit added

;; 211008 hwang.hayun updated : remove BW Limit CPU/GPU/GFX
;; http://clm.lge.com/issue/browse/SICDTV-10281, set BW Limit by request of driver


;VDEC0_M0
D.S ASD:0xC600B018 %LONG 0x00001188		;;Time(us)  9.35us
D.S ASD:0xC600B078 %LONG 0x30007FD5		;;FIRST LIMITER READ_BW(MB)  3.5GB
D.S ASD:0xC600B07C %LONG 0x30005B4F		;;FIRST LIMITER WRITE_BW(MB) 2.5GB

;VDEC0_M1
D.S ASD:0xC600B218 %LONG 0x00001188		;;Time(us)  9.35us
D.S ASD:0xC600B278 %LONG 0x30007FD5		;;FIRST LIMITER READ_BW(MB)  3.5GB
D.S ASD:0xC600B27C %LONG 0x30005B4F		;;FIRST LIMITER WRITE_BW(MB) 2.5GB

;VDEC1_M0
D.S ASD:0xC600B418 %LONG 0x00001188		;;Time(us)  9.35us
D.S ASD:0xC600B478 %LONG 0x30007FD5		;;FIRST LIMITER READ_BW(MB)  3.5GB
D.S ASD:0xC600B47C %LONG 0x30005B4F		;;FIRST LIMITER WRITE_BW(MB) 2.5GB

;VDEC1_M1
D.S ASD:0xC600B618 %LONG 0x00001188		;;Time(us)  9.35us
D.S ASD:0xC600B678 %LONG 0x30007FD5		;;FIRST LIMITER READ_BW(MB)  3.5GB
D.S ASD:0xC600B67C %LONG 0x30005B4F		;;FIRST LIMITER WRITE_BW(MB) 2.5GB

;VDEC2_M0
D.S ASD:0xC600B818 %LONG 0x00001188		;;Time(us)  9.35us
D.S ASD:0xC600B878 %LONG 0x3000B69E		;;FIRST LIMITER READ_BW(MB)  5.0GB
D.S ASD:0xC600B87C %LONG 0x30005B4F		;;FIRST LIMITER WRITE_BW(MB) 2.5GB

;VDEC2_M1
D.S ASD:0xC600BA18 %LONG 0x00001188		;;Time(us)  9.35us
D.S ASD:0xC600BA78 %LONG 0x30007FD5		;;FIRST LIMITER READ_BW(MB)  3.5GB
D.S ASD:0xC600BA7C %LONG 0x30005B4F		;;FIRST LIMITER WRITE_BW(MB) 2.5GB

;VDEC3_M0
D.S ASD:0xC600BC18 %LONG 0x00001188		;;Time(us)  9.35us
D.S ASD:0xC600BC78 %LONG 0x3000B69E		;;FIRST LIMITER READ_BW(MB)  5.0GB
D.S ASD:0xC600BC7C %LONG 0x30005B4F		;;FIRST LIMITER WRITE_BW(MB) 2.5GB

;VDEC3_M1
D.S ASD:0xC600BE18 %LONG 0x00001188		;;Time(us)  9.35us
D.S ASD:0xC600BE78 %LONG 0x30007FD5		;;FIRST LIMITER READ_BW(MB)  3.5GB
D.S ASD:0xC600BE7C %LONG 0x30005B4F		;;FIRST LIMITER WRITE_BW(MB) 2.5GB


