;;;;;;;;;;;;;;;;;;;;;;;;;;;;;;;;;;;;;;;;;;;;;;;;;;;;;;;
;; Generating Port CMM by Performance Monitor
;; Generating Time : 2021-11-11 09:30:44
;; Project : M23
;;;;;;;;;;;;;;;;;;;;;;;;;;;;;;;;;;;;;;;;;;;;;;;;;;;;;;;

D.S ASD:0xC45030A0 %LONG 0x11001100		;;GPU       : 1

D.S ASD:0xC45032A0 %LONG 0x13001300		;;GFX       : 3

D.S ASD:0xC45034A0 %LONG 0x10001000		;;TIV       : 0

D.S ASD:0xC45036A0 %LONG 0x12001200		;;DBB       : 2

D.S ASD:0xC45038A0 %LONG 0x11001100		;;TCON      : 1 <-0 220914 kyungmin.choi 

D.S ASD:0xC4503AA0 %LONG 0x10001000		;;LNE       : 0 <-3 220825 kyungmin.choi

D.S ASD:0xC4503CA0 %LONG 0x10001000		;;PQE_MCU   : 0

D.S ASD:0xC4503EA0 %LONG 0x13001300		;;FMC0      : 3 <- 1 211117 dongil.nam C

D.S ASD:0xC45040A0 %LONG 0x13001300		;;FMC1      : 3 <- 1 211117 dongil.nam C

D.S ASD:0xC45042A0 %LONG 0x12000000		;;CCO0      : 2

D.S ASD:0xC45044A0 %LONG 0x00001200		;;SRE       : 2

D.S ASD:0xC45046A0 %LONG 0x11001100		;;ND0       : 1

D.S ASD:0xC45048A0 %LONG 0x12001200		;;ME0       : 2

D.S ASD:0xC4504AA0 %LONG 0x11001100		;;FMS       : 1

D.S ASD:0xC4504CA0 %LONG 0x10001000		;;CVD       : 0

D.S ASD:0xC4504EA0 %LONG 0x13000000		;;VDO0      : 3

D.S ASD:0xC45050A0 %LONG 0x11000000		;;VDO1      : 1

D.S ASD:0xC45052A0 %LONG 0x12001200		;;SMX0      : 2

D.S ASD:0xC45054A0 %LONG 0x00001100		;;SMX1      : 1

D.S ASD:0xC45056A0 %LONG 0x10001000		;;DNE0      : 0

D.S ASD:0xC45058A0 %LONG 0x10001000		;;AUD0      : 0 <-2 220825 kyungmin.choi

D.S ASD:0xC4505AA0 %LONG 0x11001100		;;AUD1      : 1

D.S ASD:0xC4505CA0 %LONG 0x12001200		;;VDEC0_M0  : 2 <- 1 211207 sanghoon.byun C

D.S ASD:0xC4505EA0 %LONG 0x13001300		;;VDEC0_M1  : 3 <- 0 211207 sanghoon.byun C

D.S ASD:0xC45060A0 %LONG 0x10001000		;;VDEC1_M0  : 0 <- 2 211207 sanghoon.byun C

D.S ASD:0xC45062A0 %LONG 0x11001100		;;VDEC1_M1  : 1 <- 3 211207 sanghoon.byun C

D.S ASD:0xC45064A0 %LONG 0x10001000		;;VDEC_MCU  : 0

;;;;;;;;;;;;;;;;;;;;;;;;;;;;;;;;;;;;;;;;;;;;;;;;;;;;;;;
;; Refrefence O22
;;;;;;;;;;;;;;;;;;;;;;;;;;;;;;;;;;;;;;;;;;;;;;;;;;;;;;;
 ; D.S A:0xC60010A0  %LE %LONG 0x11101110 // GPU      : 1/1
 ; D.S A:0xC60012A0  %LE %LONG 0x13301330 // GFX      : 3/3
 ; D.S A:0xC60014A0  %LE %LONG 0x10001000 // TIV_venc : 0/0
 ; D.S A:0xC60014B0  %LE %LONG 0x10001000 // TIV_icod : 0/0
 ; D.S A:0xC60014B4  %LE %LONG 0x10001000 // TIV_te   : 0/0
 ; D.S A:0xC600C2A0  %LE %LONG 0x12201220 // AUD0     : 2/2
 ; D.S A:0xC600C4A0  %LE %LONG 0x11101110 // AUD1     : 1/1
 ; D.S A:0xC6001AA0  %LE %LONG 0x13001300 // DBB      : 3/0
 ; D.S A:0xC6001CA0  %LE %LONG 0x11301130 // SRNR     : 1/3
 ; D.S A:0xC6001EA0  %LE %LONG 0x12201220 // LNE      : 2/2
 ; D.S A:0xC60020A0  %LE %LONG 0x10001000 // PQE_MCU  : 0/0
 ; D.S A:0xC60022A0  %LE %LONG 0x11301130 // FMC0     : 1/3 <-1/0 201030 HoonOh
 ; D.S A:0xC60024A0  %LE %LONG 0x10201020 // FMC1     : 0/2
 ; D.S A:0xC60026A0  %LE %LONG 0x12301230 // FMC2     : 2/3
 ; D.S A:0xC60028A0  %LE %LONG 0x13001300 // FMC3     : 3/0 <-3/1 201030 HoonOh
 ; D.S A:0xC6002AA0  %LE %LONG 0x11101110 // CCO0     : 1/1 <- 2/1 201030 HoonOh
 ; D.S A:0xC6002CA0  %LE %LONG 0x12201220 // CCO1     : 2/2
 ; D.S A:0xC6002EA0  %LE %LONG 0x12201220 // SRE      : 2/2 <- 2/0 201030 HoonOh
 ; D.S A:0xC60030A0  %LE %LONG 0x11101110 // ND0      : 1/1
 ; D.S A:0xC60032A0  %LE %LONG 0x13301330 // ND1      : 3/3
 ; D.S A:0xC60034A0  %LE %LONG 0x12201220 // ME0      : 2/2
 ; D.S A:0xC60036A0  %LE %LONG 0x10001000 // ME1      : 0/0
 ; D.S A:0xC60038A0  %LE %LONG 0x10301030 // SSD      : 0/3
 ; D.S A:0xC6003AA0  %LE %LONG 0x11101110 // FMS      : 1/1
 ; D.S A:0xC6003CA0  %LE %LONG 0x12301230 // GSC0     : 2/3
 ; D.S A:0xC6003EA0  %LE %LONG 0x13301330 // GSC1     : 3/3
 ; D.S A:0xC60040A0  %LE %LONG 0x11301130 // DNE0     : 1/3
 ; D.S A:0xC60042A0  %LE %LONG 0x11301130 // DNE1     : 1/3
 ; D.S A:0xC60044A0  %LE %LONG 0x10001000 // CVD      : 0/0
 ; D.S A:0xC60046A0  %LE %LONG 0x13301330 // VDO0     : 3/3
 ; D.S A:0xC60048A0  %LE %LONG 0x12201220 // VDO1     : 2/2
 ; D.S A:0xC6004AA0  %LE %LONG 0x10001000 // VDO2     : 0/0
 ; D.S A:0xC6004CA0  %LE %LONG 0x11101110 // VDO3     : 1/1
 ; D.S A:0xC6004EA0  %LE %LONG 0x12301230 // SMX0     : 2/3
 ; D.S A:0xC60050A0  %LE %LONG 0x11101110 // SMX1     : 1/1
 ; D.S A:0xC60052A0  %LE %LONG 0x10001000 // SMX2     : 0/0
 ; D.S A:0xC60054A0  %LE %LONG 0x13301330 // SMX3     : 3/3
 ; D.S A:0xC600B0A0  %LE %LONG 0x11301130 // VDEC0_M0 : 1/3
 ; D.S A:0xC600B2A0  %LE %LONG 0x10201020 // VDEC0_M1 : 0/2
 ; D.S A:0xC600B4A0  %LE %LONG 0x12101210 // VDEC1_M0 : 2/1
 ; D.S A:0xC600B6A0  %LE %LONG 0x13001300 // VDEC1_M1 : 3/0
 ; D.S A:0xC600B8A0  %LE %LONG 0x11301130 // VDEC2_M0 : 1/3
 ; D.S A:0xC600BAA0  %LE %LONG 0x10201020 // VDEC2_M1 : 0/2
 ; D.S A:0xC600BCA0  %LE %LONG 0x12101210 // VDEC3_M0 : 2/1
 ; D.S A:0xC600BEA0  %LE %LONG 0x13001300 // VDEC3_M1 : 3/0
 ; D.S A:0xC600C0A0  %LE %LONG 0x10001000 // VDEC_MCU : 0/0
                
                
;;;;;;;;;;;;;;;;;;;;;;;;;;;;;;;;;;;;;;;;;;;;;;;;;;;;;;;
;; Refrefence E60
;;;;;;;;;;;;;;;;;;;;;;;;;;;;;;;;;;;;;;;;;;;;;;;;;;;;;;;
;; D.S A:0xC98230a0 %LE %LONG 0x12221222   // GPU 2/2/2
;; D.S A:0xC98234a0 %LE %LONG 0x11111111   // TIV 1/1/1
;; D.S A:0xC98238a0 %LE %LONG 0x10001000   // WOV 0/0/0
;; D.S A:0xC9823Ca0 %LE %LONG 0x13331333   // LGSR 3/3/3
;; D.S A:0xC98240a0 %LE %LONG 0x13331333   // LNE 3/3/3
;; D.S A:0xC98244a0 %LE %LONG 0x11111111   // VDEC0_M1 1/1/1
;; D.S A:0xC98248a0 %LE %LONG 0x13331333   // VDEC1_M1 3/3/3
;; D.S A:0xC9824Ca0 %LE %LONG 0x12111211   // VDEC2A_M1 2/1/1
;; D.S A:0xC98250a0 %LE %LONG 0x13231323   // VDEC2B_M1 3/2/3
;; D.S A:0xC98254a0 %LE %LONG 0x10001000   // VDEC3A_M1 0/0/0
;; D.S A:0xC98258a0 %LE %LONG 0x12221222   // VDEC3B_M1 2/2/2
;; D.S A:0xC98260A0 %LE %LONG 0x11111113   // FMC0 1/1/1
;; D.S A:0xC98264a0 %LE %LONG 0x13221333   // FMC2 3/2/2/3/3/3
;; D.S A:0xC98268a0 %LE %LONG 0x13331333   // FMC4 3/3/3
;; D.S A:0xC9826Ca0 %LE %LONG 0x11001111   // FMC6 1/0/0/1/1/1
;; D.S A:0xC98270a0 %LE %LONG 0x11111111   // GSC0 1/1/1
;; D.S A:0xC98274a0 %LE %LONG 0x13331333   // GSC2 3/3/3
;; D.S A:0xC98278a0 %LE %LONG 0x11111332   // GSC4 1/1/1
;; D.S A:0xC9827Ca0 %LE %LONG 0x10331033   // CCO0 0/3/3
;; D.S A:0xC98280a0 %LE %LONG 0x10001000   // SMX0 0/0/0
;; D.S A:0xC98284a0 %LE %LONG 0x12221222   // SMX2 2/2/2
;; D.S A:0xC98288a0 %LE %LONG 0x11101110   // SMX4 1/1/1
;; D.S A:0xC9828Ca0 %LE %LONG 0x10001000   // SMX6 0/0/0
;; D.S A:0xC98278a0 %LE %LONG 0x11111332   // SRE0 3/3/3
;; D.S A:0xC98290a0 %LE %LONG 0x10001000   // VDM0 0/0/0
;; D.S A:0xC98286a0 %LE %LONG 0x12221222   // VDM2 2/2/2
;; D.S A:0xC98294a0 %LE %LONG 0x10001000   // ND0 0/0/0
;; D.S A:0xC98298a0 %LE %LONG 0x12221223   // ND2 2/2/2
;; D.S A:0xC9829Ca0 %LE %LONG 0x13331330   // SSD 3/3/3
;; D.S A:0xC982A0a0 %LE %LONG 0x11111111   // FMS0 1/1/1
;; D.S A:0xC982A4a0 %LE %LONG 0x11111111   // CVD 1/1/1
;; D.S A:0xC98232a0 %LE %LONG 0x11111111   // GFX 1/1/1
;; D.S A:0xC98236a0 %LE %LONG 0x11311131   // AUD 1/3/1
;; D.S A:0xC9823Aa0 %LE %LONG 0x12221222   // DBB 2/2/2
;; D.S A:0xC9823Ea0 %LE %LONG 0x10001000   // OASR 0/0/0
;; D.S A:0xC98242a0 %LE %LONG 0x12221222   // VDEC0_M0 2/2/2
;; D.S A:0xC98246a0 %LE %LONG 0x13331333   // VDEC1_M0 3/3/3
;; D.S A:0xC9824Aa0 %LE %LONG 0x10001000   // VDEC2A_M0 0/0/0
;; D.S A:0xC9824Ea0 %LE %LONG 0x11321132   // VDEC2B_M0 1/3/2
;; D.S A:0xC98252a0 %LE %LONG 0x11111111   // VDEC3A_M0 1/1/1
;; D.S A:0xC98256a0 %LE %LONG 0x13331333   // VDEC3B_M0 3/3/3
;; D.S A:0xC9825Aa0 %LE %LONG 0x10001000   // MCU 0/0/0
;; D.S A:0xC98262a0 %LE %LONG 0x12111222   // FMC1 2/1/1/2/2/2
;; D.S A:0xC98266a0 %LE %LONG 0x10221000   // FMC3 0/2/2/0/0/0
;; D.S A:0xC9826Aa0 %LE %LONG 0x10331000   // FMC5 0/3/3/0/0/0
;; D.S A:0xC9826Ea0 %LE %LONG 0x12001222   // FMC7 2/0/0/2/2/2
;; D.S A:0xC98272a0 %LE %LONG 0x12221222   // GSC1 2/2/2
;; D.S A:0xC98276a0 %LE %LONG 0x10001000   // GSC3 0/0/0
;; D.S A:0xC9827Aa0 %LE %LONG 0x12221001   // GSC5 2/2/2
;; D.S A:0xC9827Ea0 %LE %LONG 0x12221222   // CCO1 2/2/2
;; D.S A:0xC98282a0 %LE %LONG 0x11111111   // SMX1 1/1/1
;; D.S A:0xC9823Ca0 %LE %LONG 0x13331333   // SMX3 3/3/3
;; D.S A:0xC98298a0 %LE %LONG 0x12221223   // SMX5 2/2/2
;; D.S A:0xC9828Ea0 %LE %LONG 0x13331333   // SMX7 3/3/3
;; D.S A:0xC9827Aa0 %LE %LONG 0x12221001   // SRE1 0/0/0
;; D.S A:0xC98292a0 %LE %LONG 0x11111111   // VDM1 1/1/1
;; D.S A:0xC9828Aa0 %LE %LONG 0x13331333   // VDM3 3/3/3
;; D.S A:0xC98296a0 %LE %LONG 0x11111111   // ND1 1/1/1
;; D.S A:0xC9829Aa0 %LE %LONG 0x11101110   // ME0 1/1/1
;; D.S A:0xC9829Ea0 %LE %LONG 0x12221223   // ME1 2/2/2
;; D.S A:0xC982A2a0 %LE %LONG 0x13331333   // FMS1 3/3/3
;; D.S A:0xC982A6a0 %LE %LONG 0x12221222   // OBD 2/2/2
