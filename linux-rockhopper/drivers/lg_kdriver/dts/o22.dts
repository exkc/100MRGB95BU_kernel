#include "../lg1213-psci-aarch64.dts"

/ {
	soc {
		gpu@c4250000 {
			compatible = "arm,mali-midgard";
			reg = <0x0 0xc4250000 0x0 0x10000>;
			interrupts = <GIC_SPI 146 IRQ_TYPE_LEVEL_HIGH>,
			             <GIC_SPI 145 IRQ_TYPE_LEVEL_HIGH>,
			             <GIC_SPI 144 IRQ_TYPE_LEVEL_HIGH>;
			interrupt-names = "JOB", "MMU", "GPU";
		};

		lgedrm0: display {
			compatible = "lge,lgsoc-dp";
		};
	};
};
