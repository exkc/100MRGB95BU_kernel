#include "../lg1315-psci-aarch64.dts"

/ {
	soc {
		gpu@c40a0000 {
			compatible = "arm,mali-midgard";
			reg = <0x0 0xc40a0000 0x0 0x10000>;
			interrupts = <GIC_SPI 133 IRQ_TYPE_LEVEL_HIGH>,
			             <GIC_SPI 134 IRQ_TYPE_LEVEL_HIGH>,
			             <GIC_SPI 135 IRQ_TYPE_LEVEL_HIGH>;
			interrupt-names = "JOB", "MMU", "GPU";
		};

		lgedrm0: display {
			compatible = "lge,lgsoc-dp";
		};
	};
};
